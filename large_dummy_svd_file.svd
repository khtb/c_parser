# LargeDummyDevice register map
File version: 1.0
Registers are 32-bit, read-write, no defined reset value unless marked. A register's access mark holds for its fields unless they carry their own. Offsets are from the block's base; [hi:lo] are bit positions.

## PERIPHERAL_16
Base 0x4000F000
0x04 REG_1 — Register 1
  [31:30] FIELD_25, [29:28] FIELD_17, [31:28] FIELD_28, [30:26] FIELD_1, [26:25] FIELD_3, [26:25] FIELD_6, [26:25] FIELD_9, [29:25] FIELD_23, [26:23] FIELD_8, [22] FIELD_11, [23:21] FIELD_21, [23:19] FIELD_29, [18] FIELD_7, [18] FIELD_15, [21:17] FIELD_30, [18:16] FIELD_4, [19:16] FIELD_12, [20:16] FIELD_24, [17:14] FIELD_10, [16:13] FIELD_19, [17:13] FIELD_26, [9:8] FIELD_13, [9:8] FIELD_22, [5] FIELD_2, [6:5] FIELD_18, [6:5] FIELD_20, [4:3] FIELD_5, [2] FIELD_16, [2] FIELD_27, [2:1] FIELD_14, [5:1] FIELD_31
0x08 REG_2 — Register 2
  [31] FIELD_13, [29] FIELD_4, [29] FIELD_15, [33:29] FIELD_20, [27] FIELD_17, [28:26] FIELD_3, [26] FIELD_10, [25] FIELD_14, [28:25] FIELD_16, [25:23] FIELD_5, [19:17] FIELD_2, [17:16] FIELD_11, [14:13] FIELD_1, [14:10] FIELD_6, [9] FIELD_7, [13:9] FIELD_19, [8] FIELD_12, [7:4] FIELD_8, [6:2] FIELD_9, [2:0] FIELD_18
0x0C REG_3 — Register 3
  [33:31] FIELD_6, [34:31] FIELD_9, [35:31] FIELD_16, [32:29] FIELD_7, [30:28] FIELD_12, [31:27] FIELD_21, [25] FIELD_1, [25:22] FIELD_25, [24:21] FIELD_13, [21:18] FIELD_8, [21:18] FIELD_17, [20:16] FIELD_20, [15] FIELD_14, [16:14] FIELD_28, [13] FIELD_29, [13:12] FIELD_30, [14:11] FIELD_3, [11] FIELD_22, [15:11] FIELD_23, [15:11] FIELD_24, [9] FIELD_31, [12:8] FIELD_10, [12:8] FIELD_26, [9:7] FIELD_15, [9:7] FIELD_18, [9:5] FIELD_19, [6:3] FIELD_27, [5:2] FIELD_11, [3:1] FIELD_4, [2:1] FIELD_5, [2:0] FIELD_2
0x10 REG_4 — Register 4
  [31] FIELD_6, [30] FIELD_9, [33:30] FIELD_11, [25] FIELD_12, [24] FIELD_4, [23:21] FIELD_8, [17:16] FIELD_5, [16:13] FIELD_10, [11] FIELD_2, [13:11] FIELD_3, [3] FIELD_7, [4:2] FIELD_1
0x14 REG_5 — Register 5
  [32:30] FIELD_16, [32:29] FIELD_11, [28] FIELD_9, [28] FIELD_25, [26] FIELD_1, [26:24] FIELD_12, [24] FIELD_22, [25:21] FIELD_5, [20] FIELD_6, [23:20] FIELD_7, [23:19] FIELD_2, [19:18] FIELD_26, [19:18] FIELD_27, [19:15] FIELD_15, [17:14] FIELD_20, [18:14] FIELD_21, [12:11] FIELD_10, [12:9] FIELD_14, [9:7] FIELD_8, [9:6] FIELD_18, [7:5] FIELD_13, [8:5] FIELD_17, [3:1] FIELD_3, [1] FIELD_4, [4:0] FIELD_19, [2:0] FIELD_23, [0] FIELD_24
0x18 REG_6 — Register 6
  [32:31] FIELD_13, [35:31] FIELD_15, [33:29] FIELD_8, [30:29] FIELD_30, [30:27] FIELD_2, [25] FIELD_12, [25:24] FIELD_22, [26:23] FIELD_24, [24:23] FIELD_27, [25:22] FIELD_5, [25:22] FIELD_25, [23:21] FIELD_23, [22:21] FIELD_29, [19:18] FIELD_3, [16] FIELD_7, [16] FIELD_17, [17:15] FIELD_26, [15:14] FIELD_21, [13] FIELD_6, [13:12] FIELD_16, [11] FIELD_9, [13:10] FIELD_18, [8] FIELD_10, [7] FIELD_4, [8:6] FIELD_1, [10:6] FIELD_19, [5] FIELD_20, [7:4] FIELD_14, [7:4] FIELD_28, [5:1] FIELD_11
0x1C REG_7 — Register 7
  [31:29] FIELD_1, [28:26] FIELD_7, [23] FIELD_2, [24:21] FIELD_6, [22:20] FIELD_3, [13:9] FIELD_4, [5] FIELD_5
0x20 REG_8 — Register 8
  [26:25] FIELD_3, [21:18] FIELD_1, [19:18] FIELD_8, [21:18] FIELD_11, [19:15] FIELD_6, [16:14] FIELD_2, [13:9] FIELD_9, [10:8] FIELD_7, [6:3] FIELD_4, [4:1] FIELD_5, [3:0] FIELD_10
0x24 REG_9 — Register 9
  [34:30] FIELD_1, [28:27] FIELD_2, [31:27] FIELD_4, [24:22] FIELD_5, [20:17] FIELD_8, [17:16] FIELD_7, [15:14] FIELD_3, [4] FIELD_6, [4:3] FIELD_9
0x28 REG_10 — Register 10
  [34:31] FIELD_18, [34:30] FIELD_5, [34:30] FIELD_7, [29:26] FIELD_4, [25] FIELD_11, [28:25] FIELD_14, [22:21] FIELD_12, [25:21] FIELD_16, [20] FIELD_15, [22:19] FIELD_6, [17] FIELD_21, [17:14] FIELD_3, [15:11] FIELD_23, [13:9] FIELD_1, [9] FIELD_2, [8:7] FIELD_17, [7] FIELD_20, [6] FIELD_19, [9:6] FIELD_22, [8:5] FIELD_8, [4:3] FIELD_9, [7:3] FIELD_13, [5:1] FIELD_10, [5:1] FIELD_24
0x2C REG_11 — Register 11
  [31:28] FIELD_1, [27:25] FIELD_6, [24] FIELD_10, [26:23] FIELD_2, [20] FIELD_7, [19:17] FIELD_3, [17] FIELD_5, [14:13] FIELD_8, [14:13] FIELD_9, [14:10] FIELD_4
0x30 REG_12 — Register 12
  [32:31] FIELD_2, [33:30] FIELD_5, [13:9] FIELD_3, [8:7] FIELD_7, [3:1] FIELD_4, [2:1] FIELD_6, [3:0] FIELD_1
0x34 REG_13 — Register 13
  [34:30] FIELD_6, [31:29] FIELD_1, [25:24] FIELD_3, [25:22] FIELD_5, [23:19] FIELD_10, [16] FIELD_7, [19:15] FIELD_2, [9:6] FIELD_9, [7:5] FIELD_8, [4] FIELD_4
0x38 REG_14 — Register 14
  [27:24] FIELD_4, [9:7] FIELD_2, [8:7] FIELD_3, [6:3] FIELD_5, [4:2] FIELD_1
0x3C REG_15 — Register 15
  [29:27] FIELD_4, [11:7] FIELD_3, [1] FIELD_1, [1:0] FIELD_2
0x40 REG_16 — Register 16
  [30] FIELD_7, [25] FIELD_11, [26:25] FIELD_16, [21] FIELD_5, [20] FIELD_12, [20:19] FIELD_19, [22:18] FIELD_6, [21:18] FIELD_18, [19:17] FIELD_4, [19:17] FIELD_10, [21:17] FIELD_14, [19:17] FIELD_17, [17:15] FIELD_1, [17:15] FIELD_8, [14:13] FIELD_13, [10:8] FIELD_9, [9:8] FIELD_15, [7] FIELD_2, [11:7] FIELD_3
