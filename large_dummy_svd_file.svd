# LargeDummyDevice register map
File version: 1.0
Registers are 32-bit, read-write, no defined reset value unless marked. A register's access mark holds for its fields unless they carry their own. Offsets are from the block's base; [hi:lo] are bit positions.

## PERIPHERAL_59
Base 0x4003A000
0x04 REG_1 — Register 1
  [24:23] FIELD_4, [25:21] FIELD_7, [23:21] FIELD_10, [24:20] FIELD_3, [18:16] FIELD_11, [18:15] FIELD_2, [17:14] FIELD_5, [16:14] FIELD_6, [14:10] FIELD_9, [9:5] FIELD_8, [5:3] FIELD_1
0x08 REG_2 — Register 2
  [35:31] FIELD_20, [30] FIELD_2, [29:27] FIELD_22, [28:25] FIELD_8, [26:25] FIELD_16, [27:24] FIELD_18, [23] FIELD_12, [24:20] FIELD_24, [23:19] FIELD_3, [22:19] FIELD_27, [18:15] FIELD_14, [16:14] FIELD_5, [14] FIELD_7, [15:13] FIELD_19, [12] FIELD_13, [10] FIELD_26, [11:9] FIELD_28, [10:9] FIELD_29, [12:8] FIELD_6, [12:8] FIELD_17, [8:5] FIELD_9, [9:5] FIELD_23, [6:4] FIELD_15, [7:3] FIELD_11, [7:3] FIELD_25, [3:2] FIELD_10, [3:2] FIELD_21, [3:1] FIELD_4, [0] FIELD_1
0x0C REG_3 — Register 3
  [30] FIELD_16, [30:29] FIELD_10, [32:28] FIELD_7, [26:22] FIELD_8, [20] FIELD_2, [17:16] FIELD_12, [18:14] FIELD_14, [16:12] FIELD_1, [15:12] FIELD_6, [12] FIELD_15, [13:10] FIELD_19, [9:8] FIELD_20, [9:7] FIELD_11, [10:7] FIELD_17, [6] FIELD_3, [10:6] FIELD_5, [6] FIELD_13, [6:5] FIELD_18, [8:4] FIELD_4, [4] FIELD_21, [7:3] FIELD_9
0x10 REG_4 — Register 4
  [28:27] FIELD_4, [12:10] FIELD_3, [10:6] FIELD_1, [6:5] FIELD_6, [3:2] FIELD_5, [2:0] FIELD_2
0x14 REG_5 — Register 5
  [30:28] FIELD_11, [30:28] FIELD_12, [27:26] FIELD_3, [20:16] FIELD_9, [15:11] FIELD_2, [13:10] FIELD_6, [10:9] FIELD_10, [11:7] FIELD_5, [7:5] FIELD_1, [7:3] FIELD_8, [4:0] FIELD_4, [3:0] FIELD_7
0x18 REG_6 — Register 6
  [33:31] FIELD_3, [31:30] FIELD_1, [30:26] FIELD_4, [18:15] FIELD_2
0x1C REG_7 — Register 7
  [31:30] FIELD_7, [30:29] FIELD_2, [19:16] FIELD_6, [12:10] FIELD_4, [7:6] FIELD_1, [4] FIELD_5, [5:3] FIELD_3
0x20 REG_8 — Register 8
  [32:30] FIELD_4, [30:29] FIELD_6, [30:27] FIELD_2, [18] FIELD_5, [18:17] FIELD_8, [11:10] FIELD_7, [0] FIELD_1, [4:0] FIELD_3
0x24 REG_9 — Register 9
  [31] FIELD_19, [31:30] FIELD_2, [32:30] FIELD_23, [29:28] FIELD_17, [31:27] FIELD_4, [30:27] FIELD_7, [27:25] FIELD_12, [27:24] FIELD_10, [27:24] FIELD_21, [26:24] FIELD_22, [25:23] FIELD_6, [22:20] FIELD_3, [22:20] FIELD_5, [21:19] FIELD_1, [17:15] FIELD_8, [16:12] FIELD_16, [11:9] FIELD_18, [11:7] FIELD_13, [10:6] FIELD_15, [5:3] FIELD_20, [1] FIELD_9, [3:0] FIELD_11, [0] FIELD_14
0x28 REG_10 — Register 10
  [34:30] FIELD_22, [30:29] FIELD_2, [29:28] FIELD_4, [30:27] FIELD_27, [28:27] FIELD_30, [29:25] FIELD_15, [25] FIELD_29, [25] FIELD_32, [27:24] FIELD_5, [26:24] FIELD_12, [24:22] FIELD_1, [20:19] FIELD_31, [19:17] FIELD_9, [18:17] FIELD_28, [17:15] FIELD_26, [14] FIELD_11, [14:13] FIELD_20, [13:10] FIELD_14, [13:9] FIELD_13, [9:8] FIELD_8, [7] FIELD_3, [9:7] FIELD_16, [9:6] FIELD_25, [7:5] FIELD_19, [4] FIELD_6, [7:4] FIELD_10, [4] FIELD_21, [4:3] FIELD_7, [2] FIELD_18, [6:2] FIELD_23, [3:2] FIELD_24, [2:1] FIELD_17
0x2C REG_11 — Register 11
  [29:25] FIELD_2, [23:22] FIELD_1, [20:19] FIELD_3, [19:17] FIELD_4
0x30 REG_12 — Register 12
  [29:26] FIELD_7, [25] FIELD_9, [29:25] FIELD_11, [29:25] FIELD_21, [28:24] FIELD_22, [22:21] FIELD_6, [25:21] FIELD_17, [22:19] FIELD_2, [21:18] FIELD_1, [19:18] FIELD_4, [22:18] FIELD_16, [21:17] FIELD_5, [20:17] FIELD_15, [18:17] FIELD_23, [20:16] FIELD_20, [19:15] FIELD_14, [14:11] FIELD_12, [12:8] FIELD_8, [11:8] FIELD_19, [8:6] FIELD_10, [8:6] FIELD_24, [5] FIELD_3, [4] FIELD_13, [2:1] FIELD_18
0x34 REG_13 — Register 13
  [31] FIELD_18, [31] FIELD_21, [33:30] FIELD_4, [29] FIELD_13, [30:29] FIELD_20, [32:28] FIELD_9, [30:28] FIELD_12, [28:27] FIELD_10, [26] FIELD_7, [30:26] FIELD_19, [25] FIELD_15, [26:25] FIELD_16, [26:25] FIELD_27, [24:23] FIELD_8, [23:21] FIELD_23, [19] FIELD_24, [20:17] FIELD_14, [18:17] FIELD_17, [15:11] FIELD_25, [11] FIELD_28, [10] FIELD_22, [10:8] FIELD_5, [7:5] FIELD_2, [9:5] FIELD_11, [5] FIELD_26, [6:4] FIELD_6, [3] FIELD_3, [4:1] FIELD_1
