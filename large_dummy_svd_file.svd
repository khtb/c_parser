# LargeDummyDevice register map
File version: 1.0
Registers are 32-bit, read-write, no defined reset value unless marked. A register's access mark holds for its fields unless they carry their own. Offsets are from the block's base; [hi:lo] are bit positions.

## PERIPHERAL_97
Base 0x40060000
0x04 REG_1 — Register 1
  [31:30] FIELD_10, [31:30] FIELD_19, [32:29] FIELD_24, [30:28] FIELD_16, [28:27] FIELD_13, [28:26] FIELD_2, [29:26] FIELD_21, [28:24] FIELD_20, [22] FIELD_9, [22:21] FIELD_8, [25:21] FIELD_22, [17:16] FIELD_11, [15] FIELD_15, [15:14] FIELD_23, [13] FIELD_14, [15:11] FIELD_6, [7] FIELD_3, [7] FIELD_4, [6] FIELD_7, [6] FIELD_12, [8:4] FIELD_1, [6:4] FIELD_5, [6:4] FIELD_18, [5:3] FIELD_17
0x08 REG_2 — Register 2
  [31] FIELD_10, [27] FIELD_11, [27:26] FIELD_7, [26:25] FIELD_1, [26:24] FIELD_4, [23] FIELD_9, [23:19] FIELD_14, [22:18] FIELD_2, [19:16] FIELD_15, [18:15] FIELD_6, [19:15] FIELD_13, [12:10] FIELD_3, [14:10] FIELD_8, [10] FIELD_12, [10:8] FIELD_16, [5:4] FIELD_5
0x0C REG_3 — Register 3
  [29:27] FIELD_11, [30:26] FIELD_20, [29:25] FIELD_4, [25] FIELD_10, [25:23] FIELD_8, [26:23] FIELD_12, [25:23] FIELD_22, [26:23] FIELD_25, [21] FIELD_23, [20] FIELD_7, [21:18] FIELD_14, [19:18] FIELD_18, [17] FIELD_3, [19:17] FIELD_6, [20:17] FIELD_24, [15:13] FIELD_17, [17:13] FIELD_26, [16:12] FIELD_2, [10] FIELD_15, [10] FIELD_21, [13:10] FIELD_27, [10:9] FIELD_5, [11:8] FIELD_28, [6] FIELD_1, [10:6] FIELD_16, [5:4] FIELD_9, [2:0] FIELD_13, [0] FIELD_19
0x10 REG_4 — Register 4
  [32:30] FIELD_12, [28:26] FIELD_11, [24:23] FIELD_4, [24:22] FIELD_10, [22:20] FIELD_3, [24:20] FIELD_13, [18:17] FIELD_2, [20:16] FIELD_9, [16] FIELD_15, [16:15] FIELD_16, [7:6] FIELD_14, [6:5] FIELD_5, [5:4] FIELD_8, [3:2] FIELD_1, [3:2] FIELD_6, [1:0] FIELD_7
0x14 REG_5 — Register 5
  [33:31] FIELD_2, [28:27] FIELD_6, [29:26] FIELD_8, [19:17] FIELD_5, [7] FIELD_3, [3] FIELD_7, [2:0] FIELD_1, [0] FIELD_4
0x18 REG_6 — Register 6
  [24:23] FIELD_3, [11:8] FIELD_1, [10:8] FIELD_4, [4:3] FIELD_2, [5:2] FIELD_5
0x1C REG_7 — Register 7
  [33:30] FIELD_26, [33:29] FIELD_20, [29:28] FIELD_7, [28:27] FIELD_11, [28:25] FIELD_1, [25] FIELD_6, [24] FIELD_18, [28:24] FIELD_22, [24:23] FIELD_13, [26:22] FIELD_8, [22:21] FIELD_29, [19:18] FIELD_12, [21:17] FIELD_4, [17:16] FIELD_14, [18:14] FIELD_23, [17:14] FIELD_30, [16:13] FIELD_3, [16:13] FIELD_19, [14:12] FIELD_27, [14:11] FIELD_2, [13:11] FIELD_21, [11:9] FIELD_24, [8:7] FIELD_5, [5] FIELD_15, [7:5] FIELD_17, [6:5] FIELD_28, [4:3] FIELD_9, [3] FIELD_25, [4:1] FIELD_10, [4:0] FIELD_16
0x20 REG_8 — Register 8
  [30:28] FIELD_3, [25:24] FIELD_2, [27:23] FIELD_4, [18:14] FIELD_5, [9:7] FIELD_6, [3:0] FIELD_1, [0] FIELD_7
0x24 REG_9 — Register 9
  [30] FIELD_16, [30] FIELD_24, [33:29] FIELD_5, [31:27] FIELD_2, [29:27] FIELD_12, [28:27] FIELD_14, [29:25] FIELD_8, [26:25] FIELD_13, [23] FIELD_1, [27:23] FIELD_6, [27:23] FIELD_7, [26:23] FIELD_9, [20:18] FIELD_11, [20:18] FIELD_17, [21:17] FIELD_4, [13] FIELD_15, [15:13] FIELD_19, [16:13] FIELD_21, [15:12] FIELD_18, [12:9] FIELD_22, [12:8] FIELD_20, [9:7] FIELD_23, [7:5] FIELD_10, [8:4] FIELD_3
0x28 REG_10 — Register 10
  [35:31] FIELD_4, [22] FIELD_5, [21:17] FIELD_3, [15:14] FIELD_6, [17:13] FIELD_2, [8:6] FIELD_1
0x2C REG_11 — Register 11
  [33:31] FIELD_13, [34:31] FIELD_19, [32:30] FIELD_10, [32:30] FIELD_22, [32:29] FIELD_7, [31:29] FIELD_11, [28] FIELD_12, [32:28] FIELD_14, [25] FIELD_5, [23:22] FIELD_4, [22:21] FIELD_20, [23:19] FIELD_16, [22:18] FIELD_18, [22:18] FIELD_24, [17] FIELD_15, [18:16] FIELD_21, [15] FIELD_9, [16:14] FIELD_25, [15:11] FIELD_8, [7] FIELD_23, [7:5] FIELD_6, [6:4] FIELD_2, [6:3] FIELD_3, [5:1] FIELD_1, [5:1] FIELD_17
0x30 REG_12 — Register 12
  [33:29] FIELD_10, [26:24] FIELD_7, [24:21] FIELD_9, [20:19] FIELD_4, [18:17] FIELD_8, [18:14] FIELD_6, [12] FIELD_3, [6:4] FIELD_5, [7:3] FIELD_1, [6:2] FIELD_2
0x34 REG_13 — Register 13
  [31] FIELD_4, [33:31] FIELD_15, [30] FIELD_5, [29] FIELD_12, [30:28] FIELD_2, [28] FIELD_6, [28] FIELD_18, [31:28] FIELD_23, [31:28] FIELD_24, [29:28] FIELD_28, [28:24] FIELD_1, [22:21] FIELD_19, [22:21] FIELD_31, [23:20] FIELD_22, [20:19] FIELD_9, [20:19] FIELD_13, [21:18] FIELD_17, [19:16] FIELD_3, [18:16] FIELD_14, [14:13] FIELD_7, [12:11] FIELD_16, [14:10] FIELD_26, [11:8] FIELD_30, [4] FIELD_20, [5:4] FIELD_29, [5:3] FIELD_21, [5:3] FIELD_27, [1] FIELD_10, [3:1] FIELD_25, [0] FIELD_8, [2:0] FIELD_11
0x38 REG_14 — Register 14
  [33:31] FIELD_15, [31:28] FIELD_19, [26] FIELD_6, [29:25] FIELD_8, [23:22] FIELD_11, [22] FIELD_16, [22] FIELD_18, [21:20] FIELD_3, [24:20] FIELD_13, [15:14] FIELD_2, [14] FIELD_14, [9:8] FIELD_4, [9:6] FIELD_5, [7:6] FIELD_9, [8:6] FIELD_10, [9:5] FIELD_1, [3] FIELD_12, [5:2] FIELD_17, [4:0] FIELD_7
0x3C REG_15 — Register 15
  [31:29] FIELD_16, [28] FIELD_11, [31:27] FIELD_2, [29:27] FIELD_21, [28:26] FIELD_5, [28:26] FIELD_6, [28:25] FIELD_19, [26:24] FIELD_4, [28:24] FIELD_31, [24:21] FIELD_32, [23:20] FIELD_12, [21:20] FIELD_13, [23:20] FIELD_15, [19:18] FIELD_29, [21:17] FIELD_10, [20:17] FIELD_30, [18:16] FIELD_14, [19:16] FIELD_18, [17:15] FIELD_23, [17:15] FIELD_25, [13] FIELD_20, [12] FIELD_3, [14:12] FIELD_8, [12:10] FIELD_1, [9] FIELD_26, [9:7] FIELD_27, [7:6] FIELD_7, [7:5] FIELD_22, [8:5] FIELD_24, [4:2] FIELD_28, [3:1] FIELD_9, [1] FIELD_17
0x40 REG_16 — Register 16
  [26] FIELD_2, [26:22] FIELD_4, [22] FIELD_5, [13:9] FIELD_3, [4:0] FIELD_1
0x44 REG_17 — Register 17
  [33:30] FIELD_14, [27:26] FIELD_12, [30:26] FIELD_13, [27:24] FIELD_6, [22:20] FIELD_9, [18] FIELD_10, [19:15] FIELD_4, [14:11] FIELD_7, [13:9] FIELD_15, [8:7] FIELD_2, [8:5] FIELD_1, [7:4] FIELD_3, [7:3] FIELD_8, [5:3] FIELD_11, [5:2] FIELD_16, [4:0] FIELD_5
0x48 REG_18 — Register 18
  [26:25] FIELD_10, [15] FIELD_1, [15] FIELD_6, [13] FIELD_5, [16:13] FIELD_8, [12] FIELD_2, [16:12] FIELD_11, [14:12] FIELD_12, [10:6] FIELD_3, [7:6] FIELD_9, [2] FIELD_7, [4:1] FIELD_4
0x4C REG_19 — Register 19
  [30] FIELD_2, [30:27] FIELD_17, [27:26] FIELD_16, [28:26] FIELD_19, [23] FIELD_4, [26:23] FIELD_20, [25:22] FIELD_1, [21:19] FIELD_5, [21:17] FIELD_13, [20:16] FIELD_6, [12] FIELD_14, [14:12] FIELD_18, [11] FIELD_9, [13:9] FIELD_8, [13:9] FIELD_11, [12:9] FIELD_12, [6] FIELD_10, [5] FIELD_15, [4:2] FIELD_3, [3:2] FIELD_7
0x50 REG_20 — Register 20
  [29] FIELD_3, [29] FIELD_4, [18] FIELD_5, [18] FIELD_10, [18:16] FIELD_1, [12:10] FIELD_6, [9] FIELD_2, [10:9] FIELD_9, [11:8] FIELD_7, [3:1] FIELD_8
0x54 REG_21 — Register 21
  [31] FIELD_1, [33:31] FIELD_9, [30] FIELD_14, [30:29] FIELD_5, [29:27] FIELD_12, [28:27] FIELD_18, [29:25] FIELD_7, [26:23] FIELD_20, [26:22] FIELD_8, [20:19] FIELD_4, [16:14] FIELD_2, [14] FIELD_3, [15:14] FIELD_11, [14] FIELD_15, [12:10] FIELD_13, [12:10] FIELD_19, [11:9] FIELD_10, [6:5] FIELD_16, [3] FIELD_6, [3] FIELD_17, [4:1] FIELD_21
0x58 REG_22 — Register 22
  [10:6] FIELD_1
0x5C REG_23 — Register 23
  [32:31] FIELD_9, [32:31] FIELD_26, [33:30] FIELD_8, [31:28] FIELD_2, [26:25] FIELD_1, [28:25] FIELD_15, [27:25] FIELD_16, [23:22] FIELD_3, [25:22] FIELD_12, [26:22] FIELD_14, [23:22] FIELD_19, [23:21] FIELD_13, [21:19] FIELD_7, [21:19] FIELD_18, [21:18] FIELD_11, [16] FIELD_21, [18:14] FIELD_25, [17:13] FIELD_23, [14:13] FIELD_27, [12:10] FIELD_5, [11:10] FIELD_6, [10] FIELD_20, [12:9] FIELD_4, [9:8] FIELD_22, [10:7] FIELD_28, [7:3] FIELD_17, [7:3] FIELD_24, [4:2] FIELD_10
0x60 REG_24 — Register 24
  [33:31] FIELD_9, [31:30] FIELD_26, [33:30] FIELD_31, [33:29] FIELD_29, [32:28] FIELD_13, [32:28] FIELD_19, [30:28] FIELD_21, [28:27] FIELD_6, [29:27] FIELD_16, [25] FIELD_10, [24] FIELD_8, [23] FIELD_14, [27:23] FIELD_27, [26:22] FIELD_1, [22:20] FIELD_32, [18:16] FIELD_7, [17:16] FIELD_11, [19:16] FIELD_22, [18:16] FIELD_28, [16:15] FIELD_17, [14] FIELD_20, [16:13] FIELD_23, [15:11] FIELD_4, [12:11] FIELD_25, [13:10] FIELD_3, [12:10] FIELD_5, [13:10] FIELD_18, [13:9] FIELD_24, [7:6] FIELD_2, [9:6] FIELD_30, [6:5] FIELD_12, [5] FIELD_15
0x64 REG_25 — Register 25
  [22:21] FIELD_1
