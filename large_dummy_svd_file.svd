# LargeDummyDevice register map
File version: 1.0
Registers are 32-bit, read-write, no defined reset value unless marked. A register's access mark holds for its fields unless they carry their own. Offsets are from the block's base; [hi:lo] are bit positions.

## PERIPHERAL_37
Base 0x40024000
0x04 REG_1 — Register 1
  [32:28] FIELD_1, [19:15] FIELD_7, [14:11] FIELD_5, [12:10] FIELD_6, [11:8] FIELD_8, [11:7] FIELD_4, [10:6] FIELD_2, [4:3] FIELD_3
0x08 REG_2 — Register 2
  [31:29] FIELD_3, [20:16] FIELD_1, [17:13] FIELD_4, [0] FIELD_2
0x0C REG_3 — Register 3
  [32:31] FIELD_17, [29] FIELD_5, [33:29] FIELD_6, [31:29] FIELD_20, [30:29] FIELD_25, [31:28] FIELD_13, [27:25] FIELD_3, [23] FIELD_19, [21] FIELD_12, [21:20] FIELD_24, [19:18] FIELD_8, [21:17] FIELD_4, [18:15] FIELD_11, [16:15] FIELD_16, [17:15] FIELD_23, [12] FIELD_1, [16:12] FIELD_9, [13:9] FIELD_14, [10:7] FIELD_2, [10:7] FIELD_10, [10:7] FIELD_21, [6] FIELD_7, [6:3] FIELD_15, [5:3] FIELD_22, [3:2] FIELD_18
0x10 REG_4 — Register 4
  [33:29] FIELD_16, [29:26] FIELD_9, [26:25] FIELD_2, [18:17] FIELD_17, [14:11] FIELD_20, [13:10] FIELD_7, [14:10] FIELD_15, [11:9] FIELD_14, [10:9] FIELD_21, [10:8] FIELD_3, [8] FIELD_5, [10:6] FIELD_8, [6:3] FIELD_6, [7:3] FIELD_11, [3] FIELD_13, [3] FIELD_19, [5:2] FIELD_1, [4:1] FIELD_4, [1] FIELD_10, [2:0] FIELD_12, [0] FIELD_18
0x14 REG_5 — Register 5
  [12:8] FIELD_1
0x18 REG_6 — Register 6
  [33:31] FIELD_1, [33:30] FIELD_17, [30:29] FIELD_5, [29] FIELD_7, [29:28] FIELD_13, [28:26] FIELD_6, [26:24] FIELD_11, [25:22] FIELD_9, [18:17] FIELD_18, [19:16] FIELD_19, [15] FIELD_2, [14] FIELD_15, [12] FIELD_3, [15:11] FIELD_8, [9:6] FIELD_4, [8:6] FIELD_14, [5] FIELD_16, [7:3] FIELD_10, [4:3] FIELD_12
0x1C REG_7 — Register 7
  [33:29] FIELD_15, [30:28] FIELD_4, [27] FIELD_9, [17:16] FIELD_3, [15:13] FIELD_11, [13:12] FIELD_13, [11] FIELD_1, [13:9] FIELD_2, [12:9] FIELD_10, [10:9] FIELD_14, [7] FIELD_5, [5] FIELD_17, [5:4] FIELD_7, [3] FIELD_12, [6:3] FIELD_16, [5:3] FIELD_18, [4:1] FIELD_8, [1:0] FIELD_6
0x20 REG_8 — Register 8
  [31] FIELD_8, [32:30] FIELD_15, [30:29] FIELD_1, [31:29] FIELD_13, [30:27] FIELD_6, [29:25] FIELD_2, [24] FIELD_9, [27:23] FIELD_3, [24:23] FIELD_17, [18:17] FIELD_4, [16] FIELD_5, [16:13] FIELD_7, [13:11] FIELD_14, [15:11] FIELD_16, [12:8] FIELD_12, [8:6] FIELD_11, [2] FIELD_10
0x24 REG_9 — Register 9
  [30:29] FIELD_8, [30:28] FIELD_6, [32:28] FIELD_20, [27] FIELD_4, [25] FIELD_3, [25:24] FIELD_1, [27:24] FIELD_9, [26:24] FIELD_10, [28:24] FIELD_22, [24] FIELD_24, [26:23] FIELD_7, [23:21] FIELD_21, [22:20] FIELD_26, [21:19] FIELD_12, [19] FIELD_14, [20:19] FIELD_18, [21:17] FIELD_13, [21:17] FIELD_23, [19:16] FIELD_19, [19:15] FIELD_15, [15:11] FIELD_25, [9:7] FIELD_5, [8:7] FIELD_16, [7:6] FIELD_11, [7:4] FIELD_2, [5:2] FIELD_17
0x28 REG_10 — Register 10
  [34:31] FIELD_11, [34:30] FIELD_9, [32:30] FIELD_23, [28:27] FIELD_16, [28:27] FIELD_24, [28:27] FIELD_32, [29:25] FIELD_18, [25] FIELD_26, [27:23] FIELD_8, [22:20] FIELD_2, [22:20] FIELD_5, [21:20] FIELD_28, [20:18] FIELD_7, [19:18] FIELD_27, [18:16] FIELD_15, [18:14] FIELD_3, [15:14] FIELD_21, [17:13] FIELD_30, [12] FIELD_20, [14:11] FIELD_10, [12:11] FIELD_31, [10] FIELD_17, [7] FIELD_1, [8:6] FIELD_25, [6:5] FIELD_12, [7:5] FIELD_13, [8:5] FIELD_14, [6:4] FIELD_6, [4:3] FIELD_19, [6:3] FIELD_22, [3:1] FIELD_4, [1:0] FIELD_29
0x2C REG_11 — Register 11
  [33:30] FIELD_1, [32:28] FIELD_2, [30:28] FIELD_5, [29:28] FIELD_13, [28:27] FIELD_24, [26] FIELD_3, [28:26] FIELD_28, [26:25] FIELD_12, [28:24] FIELD_26, [25:23] FIELD_17, [22] FIELD_9, [23:21] FIELD_10, [22:20] FIELD_6, [20] FIELD_8, [20] FIELD_25, [22:19] FIELD_19, [17] FIELD_16, [18:16] FIELD_27, [18:14] FIELD_20, [15:13] FIELD_4, [12:9] FIELD_22, [11:7] FIELD_11, [8:6] FIELD_7, [6] FIELD_14, [8:5] FIELD_15, [5:4] FIELD_18, [8:4] FIELD_23, [6:3] FIELD_21
0x30 REG_12 — Register 12
  [35:31] FIELD_16, [30] FIELD_1, [32:30] FIELD_23, [33:29] FIELD_29, [30:27] FIELD_7, [28:27] FIELD_9, [29:25] FIELD_15, [25] FIELD_17, [28:25] FIELD_20, [26:24] FIELD_6, [23:22] FIELD_26, [21] FIELD_19, [20] FIELD_30, [23:19] FIELD_24, [20:16] FIELD_10, [20:16] FIELD_27, [17:15] FIELD_25, [17:13] FIELD_5, [14:11] FIELD_21, [13:10] FIELD_3, [13:10] FIELD_11, [12:9] FIELD_8, [13:9] FIELD_22, [11:7] FIELD_13, [8:7] FIELD_28, [6] FIELD_18, [7:5] FIELD_2, [5:1] FIELD_12, [0] FIELD_4, [0] FIELD_14
0x34 REG_13 — Register 13
  [29] FIELD_9, [31:28] FIELD_5, [25:24] FIELD_13, [27:23] FIELD_3, [23:22] FIELD_1, [22] FIELD_7, [21] FIELD_11, [17:15] FIELD_15, [15] FIELD_16, [17:13] FIELD_12, [12:8] FIELD_2, [7:5] FIELD_6, [5] FIELD_14, [7:4] FIELD_8, [7:3] FIELD_4, [4:3] FIELD_10
0x38 REG_14 — Register 14
  [34:31] FIELD_18, [34:31] FIELD_19, [33:31] FIELD_24, [31:29] FIELD_5, [31:28] FIELD_6, [29:28] FIELD_13, [27:26] FIELD_15, [27:24] FIELD_10, [28:24] FIELD_12, [28:24] FIELD_17, [28:24] FIELD_22, [24:22] FIELD_1, [22:21] FIELD_7, [16] FIELD_16, [16] FIELD_23, [16:14] FIELD_21, [13:11] FIELD_8, [12:11] FIELD_14, [9] FIELD_26, [9:8] FIELD_27, [9:6] FIELD_4, [6] FIELD_9, [6] FIELD_20, [7:5] FIELD_2, [4] FIELD_3, [6:2] FIELD_11, [5:1] FIELD_25
0x3C REG_15 — Register 15
  [34:30] FIELD_12, [32:28] FIELD_14, [28:25] FIELD_20, [26:24] FIELD_1, [28:24] FIELD_22, [24:22] FIELD_3, [24:22] FIELD_24, [23:22] FIELD_25, [22:21] FIELD_15, [21:20] FIELD_5, [20] FIELD_7, [23:20] FIELD_8, [19:16] FIELD_6, [16:15] FIELD_13, [12] FIELD_9, [12] FIELD_10, [11] FIELD_11, [12:10] FIELD_21, [9:8] FIELD_2, [11:7] FIELD_18, [8:6] FIELD_4, [8:6] FIELD_17, [5:4] FIELD_19, [1] FIELD_16, [1:0] FIELD_23
0x40 REG_16 — Register 16
  [32:30] FIELD_18, [29:27] FIELD_6, [29:25] FIELD_3, [24:22] FIELD_12, [21] FIELD_17, [19:18] FIELD_15, [20:16] FIELD_4, [16] FIELD_7, [18:14] FIELD_10, [14:13] FIELD_8, [10] FIELD_11, [11:9] FIELD_2, [11:9] FIELD_5, [13:9] FIELD_16, [8] FIELD_13, [8:5] FIELD_9, [1] FIELD_1, [1:0] FIELD_14
0x44 REG_17 — Register 17
  [33:31] FIELD_24, [32:29] FIELD_23, [29:28] FIELD_9, [29:26] FIELD_3, [29:26] FIELD_15, [28:25] FIELD_25, [27:23] FIELD_2, [25:22] FIELD_11, [24:21] FIELD_7, [23:21] FIELD_8, [22:19] FIELD_16, [18] FIELD_12, [19:17] FIELD_5, [18:17] FIELD_6, [20:17] FIELD_10, [12] FIELD_1, [10] FIELD_28, [11:9] FIELD_14, [8:7] FIELD_17, [11:7] FIELD_22, [7:6] FIELD_4, [8:6] FIELD_13, [6] FIELD_19, [6:3] FIELD_27, [2] FIELD_20, [6:2] FIELD_26, [3:1] FIELD_18, [1] FIELD_21, [2:1] FIELD_29, [4:0] FIELD_30
0x48 REG_18 — Register 18
  [30:29] FIELD_4, [31:29] FIELD_8, [29:28] FIELD_1, [26] FIELD_6, [27:26] FIELD_11, [27:24] FIELD_10, [25:22] FIELD_12, [19:17] FIELD_9, [18:14] FIELD_5, [15:11] FIELD_13, [12:9] FIELD_3, [5:4] FIELD_2, [2:0] FIELD_7
