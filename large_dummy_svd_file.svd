# LargeDummyDevice register map
File version: 1.0
Registers are 32-bit, read-write, no defined reset value unless marked. A register's access mark holds for its fields unless they carry their own. Offsets are from the block's base; [hi:lo] are bit positions.

## PERIPHERAL_5
Base 0x40004000
0x04 REG_1 — Register 1
  [34:31] FIELD_5, [33:31] FIELD_22, [29] FIELD_1, [30:29] FIELD_2, [28] FIELD_20, [30:27] FIELD_12, [27:25] FIELD_3, [26:25] FIELD_21, [25:24] FIELD_14, [24] FIELD_15, [24:22] FIELD_16, [21:20] FIELD_13, [22:19] FIELD_18, [21:17] FIELD_10, [18:16] FIELD_19, [14:11] FIELD_4, [14:11] FIELD_7, [11] FIELD_9, [14:10] FIELD_8, [11:10] FIELD_23, [9:8] FIELD_11, [10:7] FIELD_6, [7:5] FIELD_17
0x08 REG_2 — Register 2
  [30:27] FIELD_6, [28:25] FIELD_8, [17:16] FIELD_4, [14:10] FIELD_3, [11:9] FIELD_2, [9:8] FIELD_7, [11:7] FIELD_5, [0] FIELD_1
0x0C REG_3 — Register 3
  [28:26] FIELD_1, [27:25] FIELD_5, [22:20] FIELD_2, [14:13] FIELD_6, [4] FIELD_4, [3:1] FIELD_3
0x10 REG_4 — Register 4
  [34:31] FIELD_7, [27] FIELD_10, [29:27] FIELD_11, [28:27] FIELD_19, [26:23] FIELD_6, [19] FIELD_14, [21:17] FIELD_1, [17:16] FIELD_2, [17:16] FIELD_8, [18:16] FIELD_13, [17:14] FIELD_12, [16:12] FIELD_9, [14:12] FIELD_16, [12:11] FIELD_15, [14:11] FIELD_18, [12:10] FIELD_5, [7] FIELD_17, [6:5] FIELD_4, [8:5] FIELD_20, [3:2] FIELD_3
0x14 REG_5 — Register 5
  [35:31] FIELD_11, [34:31] FIELD_14, [33:31] FIELD_15, [30] FIELD_4, [34:30] FIELD_8, [30:28] FIELD_2, [30:27] FIELD_3, [24:23] FIELD_7, [25:22] FIELD_5, [23:20] FIELD_18, [19:18] FIELD_16, [21:17] FIELD_21, [17] FIELD_23, [17:15] FIELD_22, [13:12] FIELD_9, [8:6] FIELD_13, [5] FIELD_1, [4:1] FIELD_10, [2:1] FIELD_12, [2:1] FIELD_19, [4:1] FIELD_20, [3:0] FIELD_6, [3:0] FIELD_17
0x18 REG_6 — Register 6
  [34:30] FIELD_8, [28:27] FIELD_11, [25:23] FIELD_5, [24:23] FIELD_10, [24:20] FIELD_14, [21:19] FIELD_16, [19:18] FIELD_17, [19:15] FIELD_1, [14:13] FIELD_3, [12] FIELD_6, [14:12] FIELD_12, [12:11] FIELD_4, [8] FIELD_2, [5] FIELD_9, [6:4] FIELD_18, [5:2] FIELD_13, [4:2] FIELD_15, [2] FIELD_19, [1] FIELD_7
0x1C REG_7 — Register 7
  [33:31] FIELD_9, [34:31] FIELD_14, [25] FIELD_6, [26:22] FIELD_8, [24:22] FIELD_12, [18] FIELD_4, [18] FIELD_23, [15:14] FIELD_20, [15:13] FIELD_16, [15:11] FIELD_13, [10] FIELD_10, [12:10] FIELD_22, [11:9] FIELD_1, [8:7] FIELD_7, [7:5] FIELD_2, [6:5] FIELD_18, [5:4] FIELD_3, [2] FIELD_15, [5:2] FIELD_19, [5:1] FIELD_17, [3:1] FIELD_21, [3:0] FIELD_5, [2:0] FIELD_11
0x20 REG_8 — Register 8
  [34:30] FIELD_15, [32:28] FIELD_3, [24:23] FIELD_9, [24:21] FIELD_4, [20:18] FIELD_5, [17] FIELD_1, [19:17] FIELD_6, [20:16] FIELD_2, [16] FIELD_10, [14:11] FIELD_13, [10:9] FIELD_17, [10:7] FIELD_11, [7:5] FIELD_8, [5:4] FIELD_12, [7:3] FIELD_7, [7:3] FIELD_16, [2] FIELD_14
0x24 REG_9 — Register 9
  [31:28] FIELD_9, [30:28] FIELD_10, [29:26] FIELD_18, [25:23] FIELD_14, [26:22] FIELD_16, [23:20] FIELD_3, [16] FIELD_8, [16:14] FIELD_13, [16:13] FIELD_7, [13:12] FIELD_4, [12] FIELD_11, [13:11] FIELD_1, [10:8] FIELD_12, [11:7] FIELD_17, [5:2] FIELD_6, [4:1] FIELD_15, [4:0] FIELD_2, [4:0] FIELD_5
0x28 REG_10 — Register 10
  [32:29] FIELD_10, [33:29] FIELD_17, [29:26] FIELD_13, [28:26] FIELD_15, [27:25] FIELD_19, [25:22] FIELD_6, [25:21] FIELD_2, [22:21] FIELD_12, [22:19] FIELD_8, [21:17] FIELD_5, [16:15] FIELD_3, [18:14] FIELD_14, [15:12] FIELD_9, [13:11] FIELD_4, [10:8] FIELD_11, [11:7] FIELD_1, [9:7] FIELD_7, [11:7] FIELD_16, [2:1] FIELD_18
0x2C REG_11 — Register 11
  [33:30] FIELD_4, [26:23] FIELD_3, [14:13] FIELD_1, [9:7] FIELD_2
0x30 REG_12 — Register 12
  [30:29] FIELD_7, [32:29] FIELD_22, [30:28] FIELD_23, [30:27] FIELD_9, [26:24] FIELD_5, [28:24] FIELD_11, [24] FIELD_21, [23] FIELD_10, [23:21] FIELD_15, [19:18] FIELD_19, [19:15] FIELD_16, [17:15] FIELD_17, [17:14] FIELD_12, [15:13] FIELD_13, [14:12] FIELD_1, [15:11] FIELD_4, [11] FIELD_18, [12:8] FIELD_20, [8:6] FIELD_2, [4:3] FIELD_6, [4:3] FIELD_14, [3:0] FIELD_3, [3:0] FIELD_8
0x34 REG_13 — Register 13
  [33:30] FIELD_7, [34:30] FIELD_11, [28] FIELD_5, [27:26] FIELD_1, [28:25] FIELD_6, [22:20] FIELD_3, [21:20] FIELD_8, [23:19] FIELD_10, [21:17] FIELD_14, [20:16] FIELD_16, [15:14] FIELD_12, [17:13] FIELD_13, [13:9] FIELD_9, [10:6] FIELD_15, [5] FIELD_2, [3:1] FIELD_4
0x38 REG_14 — Register 14
  [26] FIELD_3, [25:22] FIELD_5, [22:20] FIELD_7, [18:15] FIELD_4, [16:15] FIELD_10, [15:12] FIELD_1, [10] FIELD_6, [11:10] FIELD_11, [8:7] FIELD_8, [10:7] FIELD_9, [7:4] FIELD_2
0x3C REG_15 — Register 15
  [27:25] FIELD_1, [28:25] FIELD_3, [25:24] FIELD_2
0x40 REG_16 — Register 16
  [33:31] FIELD_2, [30] FIELD_8, [30:29] FIELD_18, [29:27] FIELD_9, [25] FIELD_13, [29:25] FIELD_16, [25:23] FIELD_17, [22:20] FIELD_6, [20] FIELD_15, [19] FIELD_5, [15:14] FIELD_4, [13:10] FIELD_11, [10] FIELD_14, [12:9] FIELD_7, [12:8] FIELD_10, [8:6] FIELD_3, [3] FIELD_19, [6:2] FIELD_1, [6:2] FIELD_12
0x44 REG_17 — Register 17
  [35:31] FIELD_10, [29] FIELD_7, [29:25] FIELD_15, [24:21] FIELD_5, [24:20] FIELD_16, [17] FIELD_2, [19:17] FIELD_9, [21:17] FIELD_11, [18:16] FIELD_4, [16:13] FIELD_1, [8:6] FIELD_14, [6:5] FIELD_12, [7:4] FIELD_3, [3:2] FIELD_6, [5:2] FIELD_13, [1:0] FIELD_8
0x48 REG_18 — Register 18
  [33:30] FIELD_6, [33:30] FIELD_22, [32:29] FIELD_2, [29] FIELD_11, [30:29] FIELD_12, [29:28] FIELD_19, [31:27] FIELD_10, [29:26] FIELD_18, [25] FIELD_5, [24] FIELD_16, [26:22] FIELD_4, [25:22] FIELD_28, [21:18] FIELD_21, [19:18] FIELD_23, [19:17] FIELD_26, [17] FIELD_27, [14:13] FIELD_9, [13:12] FIELD_15, [13:10] FIELD_8, [11:9] FIELD_7, [12:9] FIELD_14, [8] FIELD_13, [8:6] FIELD_20, [9:5] FIELD_1, [4] FIELD_17, [3] FIELD_25, [2:1] FIELD_3, [4:0] FIELD_24
0x4C REG_19 — Register 19
  [25] FIELD_4, [25:23] FIELD_5, [10:6] FIELD_3, [3:2] FIELD_1, [3:0] FIELD_2
0x50 REG_20 — Register 20
  [33:31] FIELD_15, [33:30] FIELD_7, [34:30] FIELD_14, [33:29] FIELD_27, [29:26] FIELD_10, [30:26] FIELD_26, [27:25] FIELD_4, [27:25] FIELD_18, [27:25] FIELD_22, [22] FIELD_6, [25:22] FIELD_23, [22:21] FIELD_12, [22:18] FIELD_16, [22:18] FIELD_24, [21:17] FIELD_17, [19:16] FIELD_21, [16:14] FIELD_9, [15:12] FIELD_11, [14:12] FIELD_19, [12:11] FIELD_5, [12:11] FIELD_8, [11:9] FIELD_13, [11:9] FIELD_25, [12:8] FIELD_1, [10:7] FIELD_20, [5:4] FIELD_2, [4:3] FIELD_3
