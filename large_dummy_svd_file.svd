# LargeDummyDevice register map
File version: 1.0
Registers are 32-bit, read-write, no defined reset value unless marked. A register's access mark holds for its fields unless they carry their own. Offsets are from the block's base; [hi:lo] are bit positions.

## PERIPHERAL_42
Base 0x40029000
0x04 REG_1 — Register 1
  [35:31] FIELD_6, [32:29] FIELD_11, [29:28] FIELD_13, [28:26] FIELD_7, [22] FIELD_4, [25:22] FIELD_8, [25:21] FIELD_10, [19:18] FIELD_12, [16:13] FIELD_3, [15:13] FIELD_9, [11:7] FIELD_1, [9:7] FIELD_2, [6:3] FIELD_5
0x08 REG_2 — Register 2
  [34:31] FIELD_15, [32:30] FIELD_8, [31:28] FIELD_16, [31:28] FIELD_19, [32:28] FIELD_31, [25] FIELD_11, [28:25] FIELD_13, [27:25] FIELD_30, [28:24] FIELD_28, [22] FIELD_9, [25:21] FIELD_23, [23:21] FIELD_29, [24:20] FIELD_27, [21:19] FIELD_24, [21:17] FIELD_1, [20:16] FIELD_2, [18:16] FIELD_6, [20:16] FIELD_25, [15:13] FIELD_21, [11] FIELD_12, [14:10] FIELD_17, [14:10] FIELD_22, [8] FIELD_14, [8:6] FIELD_7, [8:5] FIELD_3, [8:4] FIELD_10, [7:4] FIELD_20, [3:2] FIELD_18, [4:1] FIELD_4, [1:0] FIELD_5, [0] FIELD_26
0x0C REG_3 — Register 3
  [34:31] FIELD_4, [32:29] FIELD_1, [15:12] FIELD_3, [16:12] FIELD_5, [11] FIELD_2, [6:5] FIELD_6
0x10 REG_4 — Register 4
  [35:31] FIELD_5, [32:31] FIELD_23, [32:31] FIELD_25, [32:30] FIELD_16, [31:30] FIELD_20, [32:29] FIELD_8, [30:29] FIELD_26, [29:27] FIELD_6, [30:27] FIELD_28, [30:26] FIELD_15, [26:25] FIELD_4, [25:24] FIELD_11, [26:24] FIELD_21, [23:22] FIELD_13, [24:21] FIELD_14, [19:18] FIELD_24, [20:17] FIELD_17, [16:12] FIELD_10, [12:11] FIELD_2, [12:11] FIELD_3, [13:11] FIELD_12, [8] FIELD_1, [6] FIELD_29, [5] FIELD_18, [6:5] FIELD_27, [5:4] FIELD_9, [3] FIELD_30, [3:1] FIELD_22, [2:1] FIELD_31, [1:0] FIELD_7, [2:0] FIELD_19
0x14 REG_5 — Register 5
  [35:31] FIELD_2, [31] FIELD_10, [31:30] FIELD_4, [33:30] FIELD_8, [27] FIELD_12, [22] FIELD_6, [17] FIELD_5, [18:17] FIELD_7, [18:16] FIELD_3, [15] FIELD_15, [15:12] FIELD_1, [15:11] FIELD_9, [10:9] FIELD_13, [9] FIELD_14, [7:4] FIELD_11
0x18 REG_6 — Register 6
  [34:30] FIELD_10, [29] FIELD_3, [28:27] FIELD_9, [29:26] FIELD_6, [24:23] FIELD_5, [22:19] FIELD_11, [18:15] FIELD_1, [18:15] FIELD_12, [13:11] FIELD_14, [10:9] FIELD_8, [9:8] FIELD_13, [9:7] FIELD_4, [10:7] FIELD_7, [9:7] FIELD_16, [6] FIELD_2, [7:5] FIELD_15, [9:5] FIELD_17
0x1C REG_7 — Register 7
  [32:30] FIELD_2, [26:23] FIELD_1, [17:16] FIELD_3
0x20 REG_8 — Register 8
  [33:30] FIELD_2, [26:24] FIELD_3, [11:10] FIELD_1, [4:1] FIELD_4
0x24 REG_9 — Register 9
  [29:25] FIELD_14, [26:25] FIELD_15, [24:20] FIELD_2, [20:19] FIELD_11, [18:17] FIELD_12, [19:15] FIELD_5, [16:13] FIELD_7, [14:11] FIELD_9, [13:10] FIELD_1, [10] FIELD_13, [14:10] FIELD_17, [9] FIELD_6, [7:6] FIELD_16, [6:4] FIELD_10, [6:2] FIELD_3, [6:2] FIELD_8, [4:0] FIELD_4
0x28 REG_10 — Register 10
  [27:26] FIELD_5, [24:23] FIELD_1, [14] FIELD_4, [10:6] FIELD_3, [6:5] FIELD_2
0x2C REG_11 — Register 11
  [33:31] FIELD_4, [33:31] FIELD_9, [32:30] FIELD_6, [27] FIELD_28, [27:25] FIELD_18, [24] FIELD_5, [26:23] FIELD_1, [22:20] FIELD_29, [18:15] FIELD_7, [14] FIELD_22, [18:14] FIELD_24, [15:13] FIELD_3, [17:13] FIELD_23, [15:12] FIELD_8, [13:12] FIELD_21, [11] FIELD_2, [14:11] FIELD_16, [14:11] FIELD_27, [13:10] FIELD_10, [14:10] FIELD_19, [10] FIELD_20, [12:9] FIELD_17, [7] FIELD_12, [7] FIELD_13, [6] FIELD_25, [6:5] FIELD_11, [3:2] FIELD_15, [2:1] FIELD_14, [1] FIELD_26
0x30 REG_12 — Register 12
  [32:31] FIELD_23, [32:29] FIELD_25, [29:28] FIELD_12, [23] FIELD_15, [22] FIELD_18, [25:21] FIELD_5, [23:21] FIELD_17, [20] FIELD_8, [18] FIELD_26, [17] FIELD_6, [20:16] FIELD_3, [13:12] FIELD_14, [13:11] FIELD_7, [11:8] FIELD_16, [10:8] FIELD_19, [10:8] FIELD_27, [9:7] FIELD_21, [9:6] FIELD_10, [9:6] FIELD_20, [5] FIELD_1, [3] FIELD_13, [6:2] FIELD_2, [3:2] FIELD_9, [3:2] FIELD_11, [5:1] FIELD_4, [2:1] FIELD_24, [2:0] FIELD_22
0x34 REG_13 — Register 13
  [33:31] FIELD_1
0x38 REG_14 — Register 14
  [31:27] FIELD_11, [23:21] FIELD_6, [22:20] FIELD_4, [24:20] FIELD_5, [18:16] FIELD_1, [15:12] FIELD_3, [11] FIELD_10, [9] FIELD_7, [11:8] FIELD_8, [7:6] FIELD_9, [8:5] FIELD_12, [1] FIELD_2
0x3C REG_15 — Register 15
  [30] FIELD_1, [30:28] FIELD_17, [30:27] FIELD_9, [27] FIELD_19, [26:25] FIELD_7, [26:25] FIELD_15, [25:24] FIELD_3, [26:23] FIELD_10, [24:23] FIELD_16, [23] FIELD_18, [24:22] FIELD_11, [22:19] FIELD_12, [17:14] FIELD_2, [13] FIELD_6, [15:12] FIELD_4, [14:12] FIELD_13, [15:11] FIELD_14, [8:5] FIELD_8, [4:3] FIELD_5
0x40 REG_16 — Register 16
  [30:26] FIELD_6, [26:25] FIELD_11, [21] FIELD_9, [21:17] FIELD_12, [17:13] FIELD_1, [14:12] FIELD_4, [10:9] FIELD_7, [7:5] FIELD_5, [9:5] FIELD_8, [3:1] FIELD_2, [1:0] FIELD_3, [1:0] FIELD_10
0x44 REG_17 — Register 17
  [32:29] FIELD_4, [32:28] FIELD_3, [24:23] FIELD_5, [21] FIELD_8, [19:15] FIELD_7, [13:11] FIELD_9, [12:10] FIELD_6, [12:9] FIELD_2, [11:7] FIELD_1
0x48 REG_18 — Register 18
  [22] FIELD_1
0x4C REG_19 — Register 19
  [14] FIELD_4, [14:13] FIELD_3, [15:12] FIELD_2, [2] FIELD_1
0x50 REG_20 — Register 20
  [34:31] FIELD_8, [27] FIELD_6, [30:26] FIELD_9, [23:19] FIELD_4, [20:17] FIELD_2, [21:17] FIELD_7, [14:13] FIELD_10, [12:8] FIELD_1, [5:2] FIELD_3, [2] FIELD_5
0x54 REG_21 — Register 21
  [27] FIELD_3, [28:25] FIELD_2, [27:25] FIELD_13, [25:24] FIELD_4, [23] FIELD_18, [25:22] FIELD_10, [22:21] FIELD_12, [23:19] FIELD_1, [20:18] FIELD_16, [20:16] FIELD_5, [17:16] FIELD_9, [16] FIELD_14, [18:15] FIELD_17, [16:13] FIELD_15, [16:12] FIELD_19, [11] FIELD_6, [10:9] FIELD_7, [7:5] FIELD_11, [4:3] FIELD_8
0x58 REG_22 — Register 22
  [31:29] FIELD_6, [32:29] FIELD_8, [26] FIELD_4, [21] FIELD_7, [20] FIELD_19, [19:17] FIELD_12, [17] FIELD_17, [19:16] FIELD_15, [16:15] FIELD_11, [12] FIELD_2, [13:10] FIELD_3, [11:7] FIELD_1, [8:6] FIELD_18, [8:4] FIELD_5, [6:4] FIELD_16, [7:3] FIELD_13, [6:3] FIELD_14, [4:2] FIELD_9, [3:0] FIELD_10
0x5C REG_23 — Register 23
  [34:31] FIELD_10, [31:29] FIELD_13, [31:27] FIELD_12, [29:25] FIELD_2, [25] FIELD_17, [26:23] FIELD_5, [25:23] FIELD_21, [22:21] FIELD_24, [18:15] FIELD_16, [17:13] FIELD_1, [14:12] FIELD_6, [15:12] FIELD_8, [15:12] FIELD_9, [11:10] FIELD_20, [9:8] FIELD_25, [8:7] FIELD_3, [6] FIELD_4, [7:6] FIELD_15, [8:5] FIELD_11, [6:5] FIELD_18, [5] FIELD_19, [6:3] FIELD_7, [3:2] FIELD_23, [1] FIELD_22, [0] FIELD_14
0x60 REG_24 — Register 24
  [32:31] FIELD_25, [32:30] FIELD_22, [29] FIELD_12, [33:29] FIELD_23, [30:28] FIELD_3, [32:28] FIELD_19, [30:27] FIELD_11, [24:23] FIELD_16, [20] FIELD_1, [24:20] FIELD_10, [21:20] FIELD_15, [19] FIELD_24, [19:17] FIELD_6, [17] FIELD_18, [16:15] FIELD_9, [18:15] FIELD_14, [18:14] FIELD_7, [14] FIELD_21, [16:13] FIELD_17, [13] FIELD_20, [10:9] FIELD_4, [8:7] FIELD_2, [9:7] FIELD_5, [4] FIELD_8, [5:4] FIELD_13
0x64 REG_25 — Register 25
  [33:30] FIELD_16, [33:29] FIELD_14, [31:28] FIELD_10, [28:26] FIELD_15, [25] FIELD_8, [26:25] FIELD_9, [26:24] FIELD_3, [26:22] FIELD_2, [21:19] FIELD_11, [17:16] FIELD_6, [17:14] FIELD_5, [13] FIELD_4, [12:9] FIELD_12, [7:6] FIELD_1, [4:2] FIELD_7, [5:2] FIELD_13
0x68 REG_26 — Register 26
  [31] FIELD_6, [26] FIELD_10, [29:26] FIELD_23, [25] FIELD_19, [25:22] FIELD_8, [24:22] FIELD_31, [25:21] FIELD_3, [23:21] FIELD_11, [20] FIELD_1, [23:20] FIELD_4, [20:19] FIELD_9, [20:19] FIELD_24, [21:19] FIELD_25, [20:18] FIELD_20, [20:16] FIELD_12, [16] FIELD_30, [14] FIELD_5, [17:13] FIELD_15, [17:13] FIELD_16, [15:13] FIELD_26, [16:12] FIELD_18, [15:12] FIELD_22, [11:10] FIELD_14, [12:9] FIELD_2, [10:9] FIELD_13, [8:7] FIELD_17, [8:7] FIELD_21, [7:4] FIELD_7, [5:4] FIELD_28, [6:3] FIELD_27, [4:1] FIELD_29
0x6C REG_27 — Register 27
  [31] FIELD_12, [33:29] FIELD_1, [27:26] FIELD_4, [26:25] FIELD_8, [26:24] FIELD_6, [27:24] FIELD_10, [24:22] FIELD_13, [23:21] FIELD_5, [16:15] FIELD_11, [16:12] FIELD_7, [8:4] FIELD_2, [7:4] FIELD_3, [2:0] FIELD_9
