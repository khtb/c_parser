# LargeDummyDevice register map
File version: 1.0
Registers are 32-bit, read-write, no defined reset value unless marked. A register's access mark holds for its fields unless they carry their own. Offsets are from the block's base; [hi:lo] are bit positions.

## PERIPHERAL_47
Base 0x4002E000
0x04 REG_1 — Register 1
  [31:28] FIELD_3, [26:25] FIELD_13, [25:24] FIELD_11, [26:22] FIELD_2, [23:20] FIELD_1, [19] FIELD_7, [22:18] FIELD_9, [15:14] FIELD_4, [12] FIELD_8, [10:9] FIELD_5, [6] FIELD_6, [6:2] FIELD_10, [3:2] FIELD_12
0x08 REG_2 — Register 2
  [32:30] FIELD_22, [30] FIELD_25, [28] FIELD_11, [28] FIELD_13, [28] FIELD_24, [28:26] FIELD_26, [27:24] FIELD_23, [26:22] FIELD_3, [23:20] FIELD_6, [20] FIELD_10, [18:17] FIELD_9, [16:15] FIELD_19, [14:13] FIELD_16, [12] FIELD_4, [15:12] FIELD_15, [14:11] FIELD_2, [13:9] FIELD_21, [12:9] FIELD_27, [10:8] FIELD_8, [9:7] FIELD_18, [7] FIELD_28, [9:6] FIELD_1, [8:6] FIELD_7, [6:5] FIELD_20, [8:4] FIELD_12, [5:2] FIELD_5, [3:2] FIELD_14, [3:2] FIELD_17
0x0C REG_3 — Register 3
  [32:31] FIELD_9, [35:31] FIELD_20, [29:28] FIELD_18, [27] FIELD_3, [25] FIELD_14, [27:25] FIELD_15, [23:19] FIELD_2, [22:19] FIELD_5, [18] FIELD_13, [20:17] FIELD_7, [18:14] FIELD_17, [17:13] FIELD_6, [16:13] FIELD_8, [13:12] FIELD_19, [14:11] FIELD_12, [11:10] FIELD_16, [6] FIELD_10, [9:5] FIELD_1, [6:5] FIELD_4, [6:5] FIELD_11
0x10 REG_4 — Register 4
  [27] FIELD_5, [26:24] FIELD_2, [28:24] FIELD_9, [22:21] FIELD_11, [19:17] FIELD_3, [18:14] FIELD_7, [16:14] FIELD_13, [10:9] FIELD_4, [13:9] FIELD_8, [7:6] FIELD_1, [5:4] FIELD_10, [5:4] FIELD_14, [4:0] FIELD_6, [3:0] FIELD_12
0x14 REG_5 — Register 5
  [32:30] FIELD_1, [31:28] FIELD_11, [27:25] FIELD_5, [25] FIELD_8, [28:24] FIELD_12, [20:17] FIELD_10, [20:16] FIELD_7, [14:12] FIELD_6, [7] FIELD_4, [7:5] FIELD_9, [3] FIELD_2, [4:2] FIELD_13, [3:0] FIELD_3
0x18 REG_6 — Register 6
  [34:31] FIELD_11, [35:31] FIELD_14, [34:30] FIELD_13, [30:27] FIELD_7, [27] FIELD_18, [27:26] FIELD_16, [25] FIELD_2, [24] FIELD_8, [25:24] FIELD_21, [27:24] FIELD_22, [22:19] FIELD_20, [19:18] FIELD_4, [17:16] FIELD_19, [18:14] FIELD_5, [16:12] FIELD_23, [16:12] FIELD_25, [12:11] FIELD_12, [13:10] FIELD_6, [10:7] FIELD_1, [7:6] FIELD_10, [4] FIELD_17, [3:2] FIELD_3, [1] FIELD_9, [5:1] FIELD_15, [2:0] FIELD_24
0x1C REG_7 — Register 7
  [26:25] FIELD_4, [22:19] FIELD_2, [20:16] FIELD_3, [17:14] FIELD_6, [8:5] FIELD_5, [3:0] FIELD_1
0x20 REG_8 — Register 8
  [34:31] FIELD_4, [35:31] FIELD_7, [35:31] FIELD_10, [34:31] FIELD_13, [35:31] FIELD_25, [28] FIELD_22, [30:26] FIELD_5, [26] FIELD_9, [29:26] FIELD_24, [23] FIELD_6, [25:22] FIELD_11, [24:22] FIELD_17, [23:22] FIELD_20, [22:20] FIELD_2, [24:20] FIELD_21, [14:13] FIELD_19, [16:13] FIELD_30, [15:12] FIELD_29, [12:11] FIELD_26, [12:9] FIELD_1, [9:6] FIELD_14, [6] FIELD_16, [9:5] FIELD_8, [5] FIELD_15, [6:5] FIELD_23, [6:3] FIELD_3, [5:2] FIELD_27, [3:2] FIELD_28, [1] FIELD_12, [2:1] FIELD_18
0x24 REG_9 — Register 9
  [33:30] FIELD_12, [31:27] FIELD_4, [25] FIELD_6, [25:24] FIELD_9, [21:19] FIELD_2, [21:19] FIELD_8, [19:17] FIELD_13, [18:16] FIELD_10, [18:16] FIELD_11, [15:13] FIELD_7, [13:12] FIELD_5, [5:4] FIELD_1, [5:4] FIELD_3
0x28 REG_10 — Register 10
  [28:24] FIELD_5, [22:21] FIELD_3, [22:20] FIELD_9, [18:15] FIELD_1, [13:12] FIELD_6, [11:10] FIELD_7, [12:9] FIELD_2, [6:3] FIELD_8, [4:0] FIELD_4
0x2C REG_11 — Register 11
  [32:30] FIELD_1, [32:29] FIELD_2, [17:14] FIELD_3, [10:8] FIELD_5, [8:6] FIELD_4
0x30 REG_12 — Register 12
  [31] FIELD_10, [31:29] FIELD_9, [30:28] FIELD_26, [28:25] FIELD_7, [23] FIELD_13, [25:23] FIELD_22, [23:20] FIELD_23, [23:20] FIELD_24, [22:19] FIELD_6, [19:18] FIELD_14, [18:17] FIELD_21, [17:15] FIELD_3, [17:14] FIELD_27, [13] FIELD_4, [16:13] FIELD_16, [13:12] FIELD_11, [11] FIELD_17, [11:10] FIELD_2, [14:10] FIELD_20, [12:9] FIELD_8, [10:8] FIELD_5, [8] FIELD_18, [6] FIELD_28, [8:4] FIELD_25, [6:2] FIELD_1, [3:2] FIELD_12, [4:1] FIELD_15, [5:1] FIELD_19
0x34 REG_13 — Register 13
  [21:18] FIELD_3, [17:14] FIELD_2, [11:9] FIELD_1, [7:6] FIELD_7, [9:5] FIELD_6, [6:3] FIELD_4, [6:3] FIELD_8, [1] FIELD_5
