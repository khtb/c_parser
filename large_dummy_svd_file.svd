# LargeDummyDevice register map
File version: 1.0
Registers are 32-bit, read-write, no defined reset value unless marked. A register's access mark holds for its fields unless they carry their own. Offsets are from the block's base; [hi:lo] are bit positions.

## PERIPHERAL_69
Base 0x40044000
0x04 REG_1 — Register 1
  [29:28] FIELD_14, [27] FIELD_6, [30:27] FIELD_12, [30:26] FIELD_4, [26] FIELD_5, [28:26] FIELD_13, [26:25] FIELD_10, [25] FIELD_17, [27:24] FIELD_16, [24:23] FIELD_7, [22] FIELD_15, [19:16] FIELD_8, [18:15] FIELD_1, [15] FIELD_3, [17:14] FIELD_2, [13:9] FIELD_11, [2] FIELD_9
0x08 REG_2 — Register 2
  [33:31] FIELD_20, [33:30] FIELD_30, [28:27] FIELD_13, [29:25] FIELD_2, [25:24] FIELD_24, [25:22] FIELD_6, [22] FIELD_21, [23:21] FIELD_4, [24:20] FIELD_17, [21:20] FIELD_18, [24:20] FIELD_25, [19] FIELD_15, [22:19] FIELD_16, [20:18] FIELD_12, [21:17] FIELD_9, [21:17] FIELD_11, [17] FIELD_14, [20:16] FIELD_1, [15] FIELD_22, [16:15] FIELD_27, [15:13] FIELD_19, [14:12] FIELD_10, [12:9] FIELD_3, [12:9] FIELD_5, [13:9] FIELD_26, [8] FIELD_23, [7:6] FIELD_7, [9:6] FIELD_8, [8:6] FIELD_28, [9:6] FIELD_29, [0] FIELD_31
0x0C REG_3 — Register 3
  [20] FIELD_1
0x10 REG_4 — Register 4
  [30] FIELD_18, [32:28] FIELD_14, [29:27] FIELD_13, [24] FIELD_20, [21] FIELD_17, [21:20] FIELD_8, [21:18] FIELD_19, [17] FIELD_12, [17:16] FIELD_5, [17:13] FIELD_2, [14:13] FIELD_9, [16:12] FIELD_6, [15:11] FIELD_7, [14:10] FIELD_11, [10:9] FIELD_4, [11:8] FIELD_10, [9:8] FIELD_16, [7:3] FIELD_1, [4:3] FIELD_3, [1] FIELD_15
0x14 REG_5 — Register 5
  [32:31] FIELD_12, [32:28] FIELD_6, [29:28] FIELD_24, [28:24] FIELD_1, [23] FIELD_2, [24:23] FIELD_22, [22:20] FIELD_18, [19:18] FIELD_7, [17] FIELD_13, [18:16] FIELD_8, [20:16] FIELD_10, [19:15] FIELD_4, [16:12] FIELD_11, [12:11] FIELD_15, [13:11] FIELD_25, [10] FIELD_5, [10] FIELD_14, [11:9] FIELD_19, [9:7] FIELD_17, [10:6] FIELD_9, [7:6] FIELD_20, [6:4] FIELD_16, [2] FIELD_21, [6:2] FIELD_23, [3:0] FIELD_3
0x18 REG_6 — Register 6
  [30] FIELD_3, [33:29] FIELD_5, [31:27] FIELD_2, [28:26] FIELD_8, [27:24] FIELD_1, [24:22] FIELD_9, [26:22] FIELD_10, [22:21] FIELD_12, [15] FIELD_11, [3] FIELD_6, [4:2] FIELD_4, [4:1] FIELD_7
0x1C REG_7 — Register 7
  [33:31] FIELD_1, [34:31] FIELD_9, [33:30] FIELD_12, [31:28] FIELD_8, [30:26] FIELD_3, [25:24] FIELD_2, [24:23] FIELD_5, [23:19] FIELD_4, [23:19] FIELD_18, [17:14] FIELD_7, [14:13] FIELD_16, [14:10] FIELD_10, [13:10] FIELD_14, [12:9] FIELD_17, [10:6] FIELD_13, [6:5] FIELD_15, [6:4] FIELD_6, [3] FIELD_11
0x20 REG_8 — Register 8
  [34:31] FIELD_1, [32:30] FIELD_4, [29] FIELD_7, [29:28] FIELD_5, [28:25] FIELD_13, [22:21] FIELD_8, [20:19] FIELD_9, [20:16] FIELD_10, [15:12] FIELD_3, [15:11] FIELD_6, [6] FIELD_11, [6:2] FIELD_2, [3:2] FIELD_12
0x24 REG_9 — Register 9
  [34:31] FIELD_12, [35:31] FIELD_24, [31:29] FIELD_13, [30:28] FIELD_20, [30:28] FIELD_25, [31:27] FIELD_4, [30:27] FIELD_5, [31:27] FIELD_6, [30:27] FIELD_11, [27:24] FIELD_10, [23:21] FIELD_23, [21:18] FIELD_17, [17] FIELD_2, [18:16] FIELD_15, [18:16] FIELD_19, [18:15] FIELD_8, [18:15] FIELD_9, [15:14] FIELD_22, [15:12] FIELD_26, [12:10] FIELD_1, [13:10] FIELD_7, [11:9] FIELD_16, [8] FIELD_14, [3] FIELD_21, [5:1] FIELD_18, [4:0] FIELD_3
0x28 REG_10 — Register 10
  [4] FIELD_1
0x2C REG_11 — Register 11
  [24:20] FIELD_2, [21:17] FIELD_3, [7:5] FIELD_1
0x30 REG_12 — Register 12
  [34:31] FIELD_3, [27:23] FIELD_4, [26:22] FIELD_5, [24:21] FIELD_1, [16:12] FIELD_6, [5:2] FIELD_2
0x34 REG_13 — Register 13
  [32:30] FIELD_9, [30] FIELD_20, [34:30] FIELD_22, [32:29] FIELD_14, [31:29] FIELD_21, [29:28] FIELD_2, [29:26] FIELD_12, [21] FIELD_3, [22:19] FIELD_18, [18:17] FIELD_5, [19:17] FIELD_7, [19:17] FIELD_16, [15] FIELD_11, [16:12] FIELD_10, [13:12] FIELD_15, [15:12] FIELD_19, [10:8] FIELD_4, [10:6] FIELD_6, [10:6] FIELD_17, [7:5] FIELD_1, [5] FIELD_8, [8:5] FIELD_23, [7:4] FIELD_13
0x38 REG_14 — Register 14
  [33:30] FIELD_4, [30:28] FIELD_14, [31:27] FIELD_1, [27:24] FIELD_10, [27:23] FIELD_8, [23:21] FIELD_9, [23:20] FIELD_5, [17] FIELD_11, [13:12] FIELD_13, [15:12] FIELD_17, [10:9] FIELD_16, [8:6] FIELD_12, [2] FIELD_6, [4:2] FIELD_15, [4:1] FIELD_3, [1] FIELD_7, [2:0] FIELD_2
0x3C REG_15 — Register 15
  [31:27] FIELD_2, [30:27] FIELD_7, [29:27] FIELD_19, [23:22] FIELD_23, [21] FIELD_22, [24:20] FIELD_9, [21:19] FIELD_3, [20:18] FIELD_6, [19:15] FIELD_4, [17:15] FIELD_8, [17:14] FIELD_18, [16:12] FIELD_10, [14:10] FIELD_14, [12:10] FIELD_17, [10:9] FIELD_1, [13:9] FIELD_11, [12:9] FIELD_20, [12:9] FIELD_21, [8] FIELD_12, [9:7] FIELD_13, [8:5] FIELD_5, [5:3] FIELD_15, [6:2] FIELD_16
0x40 REG_16 — Register 16
  [34:31] FIELD_5, [27:26] FIELD_20, [29:25] FIELD_9, [27:23] FIELD_6, [24:23] FIELD_10, [27:23] FIELD_11, [25:23] FIELD_18, [20:19] FIELD_14, [21:17] FIELD_2, [17] FIELD_7, [21:17] FIELD_21, [15:14] FIELD_8, [10:9] FIELD_4, [8] FIELD_3, [10:6] FIELD_13, [10:6] FIELD_17, [10:6] FIELD_19, [8:5] FIELD_1, [8:4] FIELD_15, [4] FIELD_16, [5:1] FIELD_12
0x44 REG_17 — Register 17
  [34:31] FIELD_15, [31:30] FIELD_1, [31:30] FIELD_10, [30] FIELD_18, [31:28] FIELD_24, [27:26] FIELD_2, [29:25] FIELD_7, [25] FIELD_8, [25:23] FIELD_16, [22:21] FIELD_19, [21:20] FIELD_9, [22:19] FIELD_25, [18] FIELD_26, [14:12] FIELD_5, [15:11] FIELD_13, [10] FIELD_11, [12:9] FIELD_22, [8:7] FIELD_4, [8:5] FIELD_12, [5:4] FIELD_3, [3] FIELD_17, [4:2] FIELD_14, [4:2] FIELD_20, [5:1] FIELD_6, [2:0] FIELD_21, [4:0] FIELD_23
0x48 REG_18 — Register 18
  [32:31] FIELD_10, [31:28] FIELD_13, [26:25] FIELD_18, [25:22] FIELD_2, [22:21] FIELD_1, [21] FIELD_3, [20:19] FIELD_4, [19:18] FIELD_15, [18:17] FIELD_5, [18:17] FIELD_12, [19:16] FIELD_8, [18:15] FIELD_19, [14:13] FIELD_20, [12:11] FIELD_7, [12:11] FIELD_14, [11:8] FIELD_6, [4:3] FIELD_9, [3:1] FIELD_16, [4:1] FIELD_17, [0] FIELD_11
0x4C REG_19 — Register 19
  [32:29] FIELD_2, [31:28] FIELD_11, [28:27] FIELD_4, [29:27] FIELD_6, [25] FIELD_13, [23:21] FIELD_7, [16:15] FIELD_8, [13:10] FIELD_12, [8] FIELD_10, [11:7] FIELD_9, [5:4] FIELD_5, [6:4] FIELD_14, [5:3] FIELD_1, [5:3] FIELD_3
0x50 REG_20 — Register 20
  [28:25] FIELD_2, [29:25] FIELD_13, [22] FIELD_1, [22] FIELD_10, [23:19] FIELD_3, [16] FIELD_14, [16:15] FIELD_6, [16:14] FIELD_16, [16:13] FIELD_8, [12] FIELD_17, [11] FIELD_9, [6] FIELD_5, [7:6] FIELD_11, [6:5] FIELD_7, [4] FIELD_15, [4] FIELD_19, [5:3] FIELD_12, [2:1] FIELD_4, [4:1] FIELD_18
0x54 REG_21 — Register 21
  [33:29] FIELD_6, [30:27] FIELD_4, [25:24] FIELD_2, [21:19] FIELD_14, [12:10] FIELD_12, [9:8] FIELD_9, [8:7] FIELD_11, [10:7] FIELD_13, [11:7] FIELD_16, [5] FIELD_15, [6:4] FIELD_5, [6:3] FIELD_10, [5:2] FIELD_8, [3:1] FIELD_3, [0] FIELD_1, [3:0] FIELD_7
0x58 REG_22 — Register 22
  [32:30] FIELD_11, [29:27] FIELD_21, [30:26] FIELD_22, [27:25] FIELD_10, [25:24] FIELD_4, [24] FIELD_19, [27:23] FIELD_14, [21] FIELD_6, [22:21] FIELD_15, [22:18] FIELD_9, [22:18] FIELD_17, [19:16] FIELD_20, [15] FIELD_3, [19:15] FIELD_5, [11:10] FIELD_18, [12:8] FIELD_2, [11:8] FIELD_7, [10:8] FIELD_23, [8:7] FIELD_8, [9:5] FIELD_25, [5:3] FIELD_1, [4:3] FIELD_12, [3:2] FIELD_13, [3:1] FIELD_16, [3:1] FIELD_24
0x5C REG_23 — Register 23
  [24:22] FIELD_5, [22:20] FIELD_6, [21:19] FIELD_7, [19:18] FIELD_2, [15:13] FIELD_1, [9] FIELD_3, [10:9] FIELD_4
0x60 REG_24 — Register 24
  [31] FIELD_22, [32:30] FIELD_14, [30] FIELD_23, [33:29] FIELD_4, [31:29] FIELD_26, [32:28] FIELD_6, [31:28] FIELD_27, [29:25] FIELD_15, [25:22] FIELD_10, [23:20] FIELD_24, [23:19] FIELD_7, [21:17] FIELD_18, [16:15] FIELD_13, [19:15] FIELD_17, [14] FIELD_16, [18:14] FIELD_25, [14:10] FIELD_12, [14:10] FIELD_21, [9:8] FIELD_8, [8] FIELD_9, [7] FIELD_1, [7] FIELD_19, [9:6] FIELD_3, [7:6] FIELD_11, [9:5] FIELD_5, [9:5] FIELD_28, [6:3] FIELD_20, [2:0] FIELD_2
0x64 REG_25 — Register 25
  [35:31] FIELD_11, [34:30] FIELD_1, [30:28] FIELD_7, [29:27] FIELD_2, [29:27] FIELD_19, [29:26] FIELD_9, [26:25] FIELD_22, [28:25] FIELD_26, [24:22] FIELD_21, [25:21] FIELD_24, [16] FIELD_15, [15:13] FIELD_10, [14:13] FIELD_17, [12] FIELD_5, [12] FIELD_23, [13:11] FIELD_13, [13:10] FIELD_12, [12:9] FIELD_3, [11:7] FIELD_20, [5] FIELD_8, [7:4] FIELD_4, [6:4] FIELD_6, [8:4] FIELD_14, [6:4] FIELD_18, [3] FIELD_16, [3] FIELD_25
0x68 REG_26 — Register 26
  [31] FIELD_25, [33:30] FIELD_10, [30:29] FIELD_19, [30:28] FIELD_22, [31:28] FIELD_24, [30:27] FIELD_11, [27:26] FIELD_28, [20] FIELD_12, [22:18] FIELD_18, [22:18] FIELD_23, [19:15] FIELD_13, [14] FIELD_1, [13:11] FIELD_3, [10] FIELD_6, [11:10] FIELD_27, [13:9] FIELD_14, [11:9] FIELD_20, [11:8] FIELD_2, [9:8] FIELD_4, [9:6] FIELD_17, [4] FIELD_9, [7:4] FIELD_21, [5:3] FIELD_15, [5:3] FIELD_29, [3] FIELD_30, [5:2] FIELD_5, [2] FIELD_8, [4:2] FIELD_16, [2:1] FIELD_26, [3:0] FIELD_7
0x6C REG_27 — Register 27
  [32:30] FIELD_17, [33:29] FIELD_24, [28:27] FIELD_19, [26] FIELD_23, [27:24] FIELD_10, [28:24] FIELD_14, [25:22] FIELD_18, [24:21] FIELD_8, [20:19] FIELD_13, [21:19] FIELD_20, [22:18] FIELD_4, [15] FIELD_7, [14] FIELD_1, [15:14] FIELD_5, [18:14] FIELD_15, [15:12] FIELD_2, [10:9] FIELD_12, [10:7] FIELD_3, [10:6] FIELD_16, [7:4] FIELD_21, [3] FIELD_6, [4:3] FIELD_11, [5:3] FIELD_22, [4:2] FIELD_9
0x70 REG_28 — Register 28
  [33:29] FIELD_17, [30:27] FIELD_2, [30:27] FIELD_27, [26] FIELD_19, [30:26] FIELD_22, [27:26] FIELD_23, [26:25] FIELD_9, [25:22] FIELD_10, [25:22] FIELD_26, [24:21] FIELD_5, [23:20] FIELD_8, [24:20] FIELD_20, [18:16] FIELD_16, [18:14] FIELD_25, [16:13] FIELD_14, [11] FIELD_15, [13:11] FIELD_21, [11:10] FIELD_6, [10:6] FIELD_7, [7:6] FIELD_13, [6:5] FIELD_11, [5] FIELD_18, [3] FIELD_4, [4:3] FIELD_12, [5:2] FIELD_28, [2:1] FIELD_1, [5:1] FIELD_3, [4:0] FIELD_24
0x74 REG_29 — Register 29
  [34:31] FIELD_1, [33:30] FIELD_4, [32:30] FIELD_5, [18:14] FIELD_3, [3:0] FIELD_2
0x78 REG_30 — Register 30
  [34:30] FIELD_15, [29] FIELD_6, [29:26] FIELD_18, [26:25] FIELD_19, [26:24] FIELD_4, [22:20] FIELD_9, [21:18] FIELD_11, [17:16] FIELD_17, [19:15] FIELD_5, [18:15] FIELD_7, [15:12] FIELD_1, [14:12] FIELD_12, [16:12] FIELD_16, [12:11] FIELD_3, [12:10] FIELD_10, [12:10] FIELD_13, [10:8] FIELD_8, [7] FIELD_2, [4:2] FIELD_14
0x7C REG_31 — Register 31
  [30] FIELD_9, [32:30] FIELD_15, [33:29] FIELD_8, [28] FIELD_7, [29:26] FIELD_11, [28:24] FIELD_14, [24:23] FIELD_6, [25:22] FIELD_5, [20:17] FIELD_3, [18:16] FIELD_12, [19:15] FIELD_4, [17:15] FIELD_16, [15:14] FIELD_10, [13:12] FIELD_2, [12:9] FIELD_13, [9:8] FIELD_1
0x80 REG_32 — Register 32
  [32:30] FIELD_1, [30] FIELD_2, [27] FIELD_5, [28:27] FIELD_7, [26:25] FIELD_17, [24:22] FIELD_18, [25:22] FIELD_20, [21] FIELD_6, [22:21] FIELD_16, [22:19] FIELD_8, [20:18] FIELD_14, [19:17] FIELD_4, [19:16] FIELD_12, [16:15] FIELD_19, [18:14] FIELD_9, [12] FIELD_11, [7] FIELD_3, [5:2] FIELD_13, [1] FIELD_10, [4:1] FIELD_15
0x84 REG_33 — Register 33
  [34:30] FIELD_4, [30] FIELD_18, [28:27] FIELD_7, [30:27] FIELD_11, [29:27] FIELD_17, [26] FIELD_9, [28:26] FIELD_10, [27:24] FIELD_6, [24:23] FIELD_2, [19] FIELD_14, [23:19] FIELD_15, [16:13] FIELD_1, [14:13] FIELD_3, [15:13] FIELD_12, [17:13] FIELD_16, [13:12] FIELD_5, [11] FIELD_13, [10:8] FIELD_8
0x88 REG_34 — Register 34
  [34:31] FIELD_7, [27:26] FIELD_2, [26] FIELD_6, [30:26] FIELD_21, [21:20] FIELD_3, [22:20] FIELD_9, [23:20] FIELD_10, [23:20] FIELD_16, [19] FIELD_5, [19:18] FIELD_4, [19:18] FIELD_18, [21:18] FIELD_19, [19:15] FIELD_8, [19:15] FIELD_14, [14] FIELD_1, [14:11] FIELD_17, [11:9] FIELD_20, [10:7] FIELD_13, [7:5] FIELD_15, [2:1] FIELD_12, [0] FIELD_11
0x8C REG_35 — Register 35
  [25:22] FIELD_10, [24:21] FIELD_8, [24:21] FIELD_12, [22:18] FIELD_11, [21:18] FIELD_14, [21:17] FIELD_5, [19:15] FIELD_7, [16:12] FIELD_9, [10:8] FIELD_4, [12:8] FIELD_13, [7:6] FIELD_2, [7:5] FIELD_3, [5:4] FIELD_6, [3:2] FIELD_1
0x90 REG_36 — Register 36
  [32:30] FIELD_20, [30:27] FIELD_2, [28:27] FIELD_11, [27] FIELD_19, [28:24] FIELD_7, [22:21] FIELD_18, [18] FIELD_21, [19:16] FIELD_8, [18:15] FIELD_23, [18:14] FIELD_5, [13] FIELD_16, [14:12] FIELD_3, [13:11] FIELD_14, [12:10] FIELD_6, [14:10] FIELD_13, [11:10] FIELD_22, [11:9] FIELD_9, [13:9] FIELD_15, [10:8] FIELD_12, [9:7] FIELD_10, [8:5] FIELD_17, [4:3] FIELD_1, [5:2] FIELD_4
0x94 REG_37 — Register 37
  [33:30] FIELD_29, [29:27] FIELD_14, [29:26] FIELD_21, [27:25] FIELD_18, [24] FIELD_15, [24] FIELD_20, [27:24] FIELD_26, [26:23] FIELD_7, [26:23] FIELD_23, [23:22] FIELD_8, [25:21] FIELD_5, [23:21] FIELD_6, [21:18] FIELD_12, [19:17] FIELD_4, [19:17] FIELD_13, [14] FIELD_19, [16:13] FIELD_9, [13:12] FIELD_1, [14:11] FIELD_3, [15:11] FIELD_25, [13:10] FIELD_16, [9:8] FIELD_27, [8:7] FIELD_10, [8:7] FIELD_11, [5] FIELD_17, [4] FIELD_22, [4] FIELD_24, [6:4] FIELD_28, [2:1] FIELD_2
