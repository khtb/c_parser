# LargeDummyDevice register map
File version: 1.0
Registers are 32-bit, read-write, no defined reset value unless marked. A register's access mark holds for its fields unless they carry their own. Offsets are from the block's base; [hi:lo] are bit positions.

## PERIPHERAL_19
Base 0x40012000
0x04 REG_1 — Register 1
  [25:21] FIELD_10, [21:20] FIELD_6, [21:18] FIELD_7, [16] FIELD_2, [15:11] FIELD_1, [6:5] FIELD_8, [7:4] FIELD_9, [4:3] FIELD_5, [3:2] FIELD_3, [4:2] FIELD_4
0x08 REG_2 — Register 2
  [32:29] FIELD_3, [26:23] FIELD_7, [24:21] FIELD_10, [19] FIELD_5, [19:18] FIELD_11, [11:9] FIELD_13, [8:6] FIELD_8, [9:5] FIELD_1, [7:5] FIELD_2, [6:5] FIELD_4, [8:5] FIELD_6, [5:2] FIELD_14, [4:0] FIELD_9, [2:0] FIELD_12
0x0C REG_3 — Register 3
  [29] FIELD_5, [31:28] FIELD_4, [30:28] FIELD_9, [24] FIELD_7, [22] FIELD_3, [21] FIELD_10, [11] FIELD_11, [10:8] FIELD_8, [9:7] FIELD_1, [2] FIELD_6, [2:0] FIELD_2
0x10 REG_4 — Register 4
  [35:31] FIELD_3, [30] FIELD_7, [31:30] FIELD_18, [33:30] FIELD_21, [28:27] FIELD_12, [23] FIELD_24, [25:22] FIELD_4, [22:21] FIELD_2, [21:18] FIELD_8, [21:17] FIELD_10, [20:17] FIELD_14, [17:16] FIELD_9, [19:16] FIELD_25, [16:15] FIELD_22, [15:13] FIELD_1, [15:13] FIELD_5, [15:12] FIELD_15, [11:8] FIELD_11, [8:7] FIELD_6, [9:7] FIELD_13, [9:5] FIELD_16, [8:4] FIELD_17, [4:2] FIELD_20, [2:0] FIELD_19, [3:0] FIELD_23
0x14 REG_5 — Register 5
  [33:31] FIELD_8, [30] FIELD_2, [30] FIELD_22, [30:29] FIELD_11, [28:26] FIELD_5, [24] FIELD_10, [28:24] FIELD_12, [27:24] FIELD_18, [28:24] FIELD_20, [27:23] FIELD_14, [20:19] FIELD_6, [21:18] FIELD_16, [19:17] FIELD_15, [20:17] FIELD_24, [18:16] FIELD_1, [17:13] FIELD_23, [12] FIELD_9, [15:11] FIELD_7, [12:11] FIELD_17, [14:10] FIELD_13, [12:9] FIELD_3, [10:8] FIELD_4, [9:6] FIELD_25, [4:2] FIELD_21, [2:1] FIELD_19
0x18 REG_6 — Register 6
  [30:29] FIELD_4, [28] FIELD_11, [25] FIELD_1, [25:24] FIELD_9, [26:23] FIELD_10, [23:22] FIELD_7, [12:8] FIELD_8, [12:8] FIELD_12, [10:7] FIELD_6, [6:5] FIELD_2, [7:4] FIELD_3, [5:2] FIELD_5
0x1C REG_7 — Register 7
  [33:31] FIELD_27, [34:31] FIELD_28, [31:30] FIELD_2, [34:30] FIELD_13, [28] FIELD_23, [27:25] FIELD_7, [25] FIELD_17, [26:25] FIELD_25, [25:24] FIELD_14, [26:22] FIELD_20, [25:21] FIELD_4, [21] FIELD_15, [21:20] FIELD_11, [23:19] FIELD_21, [20:17] FIELD_3, [20:17] FIELD_29, [19:16] FIELD_1, [17:16] FIELD_5, [16] FIELD_22, [19:15] FIELD_6, [16:15] FIELD_9, [16:15] FIELD_12, [18:14] FIELD_10, [11:10] FIELD_16, [11:9] FIELD_8, [8] FIELD_19, [6:5] FIELD_26, [2] FIELD_24, [5:1] FIELD_18
0x20 REG_8 — Register 8
  [32:31] FIELD_5, [35:31] FIELD_13, [30:29] FIELD_17, [27:24] FIELD_9, [25:24] FIELD_15, [23] FIELD_10, [24:21] FIELD_4, [20:19] FIELD_18, [22:18] FIELD_6, [14] FIELD_8, [12] FIELD_1, [14:12] FIELD_7, [9] FIELD_16, [9:8] FIELD_14, [10:7] FIELD_2, [5:1] FIELD_3, [1] FIELD_11, [2:1] FIELD_12
0x24 REG_9 — Register 9
  [31:30] FIELD_18, [30:28] FIELD_10, [29:28] FIELD_27, [29:27] FIELD_7, [30:27] FIELD_15, [26] FIELD_19, [28:25] FIELD_16, [26:22] FIELD_5, [23:22] FIELD_29, [23:22] FIELD_30, [21] FIELD_8, [23:21] FIELD_12, [22:20] FIELD_25, [22:19] FIELD_21, [19:18] FIELD_23, [20:17] FIELD_6, [19:17] FIELD_22, [17:14] FIELD_4, [14:12] FIELD_13, [16:12] FIELD_17, [11:9] FIELD_3, [10:9] FIELD_28, [7:6] FIELD_2, [7:6] FIELD_9, [9:5] FIELD_14, [3] FIELD_20, [4:1] FIELD_26, [2:0] FIELD_1, [1:0] FIELD_11, [2:0] FIELD_24
0x28 REG_10 — Register 10
  [32:30] FIELD_6, [32:30] FIELD_9, [30:28] FIELD_2, [28] FIELD_3, [31:28] FIELD_10, [29:27] FIELD_23, [24] FIELD_17, [25:23] FIELD_1, [23:22] FIELD_14, [23:22] FIELD_19, [17] FIELD_4, [20:16] FIELD_5, [13] FIELD_13, [12:11] FIELD_8, [14:11] FIELD_11, [11] FIELD_15, [11:8] FIELD_18, [10:7] FIELD_21, [9:6] FIELD_12, [9:5] FIELD_7, [8:5] FIELD_16, [5] FIELD_20, [6:3] FIELD_22
0x2C REG_11 — Register 11
  [31:29] FIELD_2, [28] FIELD_4, [28] FIELD_7, [15] FIELD_9, [14:10] FIELD_1, [10:9] FIELD_3, [11:9] FIELD_5, [6:3] FIELD_8, [4:1] FIELD_6
0x30 REG_12 — Register 12
  [34:30] FIELD_13, [29] FIELD_4, [31:28] FIELD_8, [25:24] FIELD_16, [22:20] FIELD_15, [22:19] FIELD_9, [16:13] FIELD_1, [13:11] FIELD_2, [11] FIELD_6, [14:11] FIELD_12, [9] FIELD_11, [9:8] FIELD_5, [8:7] FIELD_10, [6] FIELD_14, [6:4] FIELD_7, [1:0] FIELD_3
0x34 REG_13 — Register 13
  [33:30] FIELD_11, [31:28] FIELD_12, [28:26] FIELD_15, [25:23] FIELD_19, [26:22] FIELD_13, [22:21] FIELD_2, [21] FIELD_17, [22:20] FIELD_4, [24:20] FIELD_5, [19:17] FIELD_3, [18:17] FIELD_9, [16] FIELD_16, [13] FIELD_10, [12] FIELD_7, [11] FIELD_6, [13:9] FIELD_1, [11:7] FIELD_14, [7:4] FIELD_18, [5:1] FIELD_8
0x38 REG_14 — Register 14
  [1] FIELD_1
0x3C REG_15 — Register 15
  [31:28] FIELD_10, [31:27] FIELD_11, [22] FIELD_4, [24:22] FIELD_7, [21] FIELD_8, [20] FIELD_1, [20:18] FIELD_5, [17] FIELD_6, [16:14] FIELD_3, [12:8] FIELD_12, [9:5] FIELD_2, [6:5] FIELD_9
0x40 REG_16 — Register 16
  [29] FIELD_9, [32:29] FIELD_20, [28] FIELD_11, [28] FIELD_18, [31:27] FIELD_8, [31:27] FIELD_21, [27:23] FIELD_16, [25:23] FIELD_22, [20:19] FIELD_23, [20:18] FIELD_12, [19:17] FIELD_2, [19:17] FIELD_24, [15] FIELD_17, [16:14] FIELD_5, [13] FIELD_6, [13:12] FIELD_15, [12:10] FIELD_4, [13:9] FIELD_19, [10:8] FIELD_7, [10:7] FIELD_10, [8:5] FIELD_14, [5:3] FIELD_1, [4:3] FIELD_3, [4:1] FIELD_13
0x44 REG_17 — Register 17
  [33:30] FIELD_2, [34:30] FIELD_6, [27:26] FIELD_1, [16] FIELD_5, [17:16] FIELD_7, [10:6] FIELD_4, [8:4] FIELD_3
0x48 REG_18 — Register 18
  [32:28] FIELD_10, [31:27] FIELD_26, [27:26] FIELD_5, [26] FIELD_9, [27:25] FIELD_8, [28:24] FIELD_4, [27:24] FIELD_7, [27:24] FIELD_15, [28:24] FIELD_18, [24:23] FIELD_2, [25:23] FIELD_16, [23] FIELD_25, [18:16] FIELD_12, [15] FIELD_13, [19:15] FIELD_19, [17:14] FIELD_24, [13:12] FIELD_22, [13:10] FIELD_14, [12:10] FIELD_23, [11:9] FIELD_21, [10:7] FIELD_3, [8:6] FIELD_6, [6] FIELD_11, [9:5] FIELD_17, [5:4] FIELD_20, [6:2] FIELD_1
0x4C REG_19 — Register 19
  [30:28] FIELD_16, [30:27] FIELD_5, [27] FIELD_10, [26] FIELD_18, [26:24] FIELD_23, [22:21] FIELD_2, [25:21] FIELD_13, [22:19] FIELD_20, [21:18] FIELD_17, [14:13] FIELD_21, [13:11] FIELD_6, [15:11] FIELD_9, [9] FIELD_12, [10:6] FIELD_22, [7:5] FIELD_11, [8:5] FIELD_15, [6:4] FIELD_14, [7:3] FIELD_3, [5:2] FIELD_4, [3:1] FIELD_8, [2:0] FIELD_1, [3:0] FIELD_7, [0] FIELD_19
0x50 REG_20 — Register 20
  [26] FIELD_11, [29:25] FIELD_8, [23] FIELD_9, [23] FIELD_10, [23:21] FIELD_2, [15:13] FIELD_4, [13] FIELD_6, [15:13] FIELD_7, [16:12] FIELD_3, [9] FIELD_5, [5] FIELD_1
0x54 REG_21 — Register 21
  [31] FIELD_32, [34:30] FIELD_25, [31:29] FIELD_1, [32:29] FIELD_16, [30:26] FIELD_28, [29:26] FIELD_31, [23] FIELD_10, [25:22] FIELD_18, [22:21] FIELD_13, [22:19] FIELD_17, [22:18] FIELD_7, [18] FIELD_12, [21:17] FIELD_6, [20:17] FIELD_22, [19:16] FIELD_15, [16:15] FIELD_29, [15:14] FIELD_9, [17:13] FIELD_4, [16:13] FIELD_19, [17:13] FIELD_21, [17:13] FIELD_30, [13:12] FIELD_23, [15:11] FIELD_27, [10] FIELD_11, [10:9] FIELD_5, [11:7] FIELD_3, [8:6] FIELD_8, [8:4] FIELD_26, [5:3] FIELD_24, [4:2] FIELD_2, [2] FIELD_14, [2] FIELD_20
0x58 REG_22 — Register 22
  [34:31] FIELD_10, [26:25] FIELD_6, [28:24] FIELD_13, [21:19] FIELD_2, [20:19] FIELD_9, [19:15] FIELD_3, [11:10] FIELD_8, [14:10] FIELD_14, [12:9] FIELD_7, [11:9] FIELD_11, [6] FIELD_4, [6] FIELD_15, [5:3] FIELD_5, [5:2] FIELD_1, [2:0] FIELD_12
0x5C REG_23 — Register 23
  [33:31] FIELD_5, [34:30] FIELD_13, [32:30] FIELD_16, [32:29] FIELD_4, [29] FIELD_14, [30:27] FIELD_9, [29:26] FIELD_18, [27:25] FIELD_7, [24:22] FIELD_12, [25:22] FIELD_17, [21:19] FIELD_10, [23:19] FIELD_15, [18] FIELD_6, [19:15] FIELD_3, [11] FIELD_2, [7:6] FIELD_8, [5:3] FIELD_1, [0] FIELD_11
0x60 REG_24 — Register 24
  [35:31] FIELD_6, [32:31] FIELD_18, [33:30] FIELD_16, [28] FIELD_22, [29:26] FIELD_5, [28:26] FIELD_11, [27:26] FIELD_20, [26] FIELD_21, [24:23] FIELD_12, [27:23] FIELD_17, [23:20] FIELD_2, [24:20] FIELD_23, [22:19] FIELD_10, [21:17] FIELD_4, [18:16] FIELD_14, [18:15] FIELD_24, [13:11] FIELD_9, [10] FIELD_3, [9] FIELD_1, [10:7] FIELD_7, [11:7] FIELD_19, [6] FIELD_8, [10:6] FIELD_15, [6:3] FIELD_13
0x64 REG_25 — Register 25
  [25:23] FIELD_2, [20] FIELD_4, [14] FIELD_6, [12:8] FIELD_7, [9:6] FIELD_1, [4:3] FIELD_3, [6:2] FIELD_5
0x68 REG_26 — Register 26
  [33:31] FIELD_7, [31] FIELD_9, [33:31] FIELD_11, [18:17] FIELD_6, [16] FIELD_2, [18:14] FIELD_5, [12] FIELD_4, [12] FIELD_8, [7] FIELD_12, [6] FIELD_3, [4:2] FIELD_1, [1] FIELD_10
0x6C REG_27 — Register 27
  [31:30] FIELD_20, [31:29] FIELD_9, [31:28] FIELD_23, [26] FIELD_21, [29:25] FIELD_7, [27:25] FIELD_11, [25:24] FIELD_15, [26:22] FIELD_6, [23:21] FIELD_1, [21] FIELD_10, [23:20] FIELD_3, [20:19] FIELD_18, [21:18] FIELD_16, [20:18] FIELD_24, [18:14] FIELD_8, [16:12] FIELD_4, [11:10] FIELD_2, [7:6] FIELD_14, [5:4] FIELD_5, [5:4] FIELD_25, [4:2] FIELD_12, [5:2] FIELD_13, [4:0] FIELD_17, [3:0] FIELD_19, [3:0] FIELD_22
0x70 REG_28 — Register 28
  [33:31] FIELD_3, [30:28] FIELD_10, [26:22] FIELD_6, [22:20] FIELD_9, [23:19] FIELD_4, [19:17] FIELD_7, [15] FIELD_1, [17:15] FIELD_8, [10:6] FIELD_5, [8:5] FIELD_2
0x74 REG_29 — Register 29
  [34:30] FIELD_14, [29] FIELD_19, [30:28] FIELD_5, [31:28] FIELD_7, [27] FIELD_21, [26:22] FIELD_2, [23:22] FIELD_3, [22:21] FIELD_22, [23:19] FIELD_8, [23:19] FIELD_17, [18] FIELD_1, [19:17] FIELD_18, [17:16] FIELD_11, [16:13] FIELD_10, [14:10] FIELD_6, [10] FIELD_9, [11:10] FIELD_23, [9:8] FIELD_4, [12:8] FIELD_12, [8:7] FIELD_13, [6:4] FIELD_15, [6:4] FIELD_20, [7:3] FIELD_16
0x78 REG_30 — Register 30
  [29] FIELD_1, [29:27] FIELD_3, [12:11] FIELD_4, [6] FIELD_2
