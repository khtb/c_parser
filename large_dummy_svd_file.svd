# LargeDummyDevice register map
File version: 1.0
Registers are 32-bit, read-write, no defined reset value unless marked. A register's access mark holds for its fields unless they carry their own. Offsets are from the block's base; [hi:lo] are bit positions.

## PERIPHERAL_74
Base 0x40049000
0x04 REG_1 — Register 1
  [34:31] FIELD_18, [30:27] FIELD_17, [30:26] FIELD_6, [28:26] FIELD_13, [26] FIELD_22, [28:26] FIELD_24, [29:25] FIELD_7, [28:25] FIELD_14, [26:25] FIELD_21, [26:23] FIELD_20, [25:23] FIELD_23, [25:22] FIELD_8, [26:22] FIELD_16, [25:21] FIELD_9, [22:21] FIELD_26, [22:19] FIELD_3, [16] FIELD_19, [20:16] FIELD_31, [16:14] FIELD_12, [12:11] FIELD_28, [13:10] FIELD_15, [10:9] FIELD_10, [9] FIELD_11, [13:9] FIELD_27, [10:9] FIELD_30, [7] FIELD_1, [5] FIELD_25, [2] FIELD_5, [5:1] FIELD_4, [0] FIELD_2, [4:0] FIELD_29
0x08 REG_2 — Register 2
  [32:30] FIELD_2, [30:29] FIELD_9, [20:17] FIELD_7, [15] FIELD_4, [17:15] FIELD_5, [14:12] FIELD_6, [5:3] FIELD_8, [2:1] FIELD_1, [3:1] FIELD_3
0x0C REG_3 — Register 3
  [31] FIELD_3, [31:29] FIELD_2, [30:26] FIELD_1, [14:13] FIELD_4
0x10 REG_4 — Register 4
  [30:29] FIELD_1, [29:28] FIELD_7, [25:23] FIELD_8, [19] FIELD_9, [20:18] FIELD_10, [18:16] FIELD_2, [16] FIELD_14, [18:14] FIELD_5, [16:14] FIELD_12, [16:12] FIELD_4, [9] FIELD_11, [7:3] FIELD_3, [5:1] FIELD_6, [1:0] FIELD_13
0x14 REG_5 — Register 5
  [30:28] FIELD_15, [29:26] FIELD_16, [23:19] FIELD_3, [16] FIELD_6, [20:16] FIELD_12, [18:15] FIELD_4, [15:14] FIELD_5, [17:14] FIELD_7, [15:11] FIELD_2, [14:11] FIELD_11, [11:7] FIELD_8, [9:7] FIELD_10, [7:5] FIELD_9, [4:3] FIELD_1, [6:2] FIELD_14, [1:0] FIELD_13
0x18 REG_6 — Register 6
  [32:30] FIELD_3, [33:30] FIELD_4, [30:29] FIELD_20, [32:28] FIELD_18, [22] FIELD_17, [22:19] FIELD_5, [19] FIELD_16, [19:17] FIELD_9, [18:15] FIELD_13, [17:14] FIELD_19, [11:10] FIELD_2, [13:10] FIELD_14, [12:10] FIELD_21, [8] FIELD_1, [9:8] FIELD_11, [6] FIELD_12, [6] FIELD_15, [5:4] FIELD_7, [4:2] FIELD_10, [1] FIELD_6, [1] FIELD_8
0x1C REG_7 — Register 7
  [31] FIELD_6, [32:31] FIELD_7, [23:21] FIELD_4, [24:21] FIELD_5, [22:18] FIELD_2, [21:18] FIELD_3, [15:14] FIELD_1, [6:3] FIELD_8
0x20 REG_8 — Register 8
  [25:24] FIELD_1, [24:23] FIELD_2
0x24 REG_9 — Register 9
  [30:27] FIELD_23, [30:27] FIELD_25, [27:26] FIELD_15, [28:25] FIELD_22, [28:24] FIELD_21, [27:24] FIELD_26, [27:23] FIELD_2, [23] FIELD_17, [23:22] FIELD_10, [22:19] FIELD_16, [23:19] FIELD_20, [21:18] FIELD_4, [20:16] FIELD_5, [16] FIELD_8, [18:15] FIELD_28, [16:15] FIELD_30, [14] FIELD_11, [15:14] FIELD_27, [17:13] FIELD_14, [15:11] FIELD_24, [13:11] FIELD_29, [11:10] FIELD_6, [14:10] FIELD_19, [9:8] FIELD_1, [8] FIELD_18, [10:7] FIELD_13, [6:3] FIELD_7, [3:2] FIELD_3, [4:0] FIELD_9, [3:0] FIELD_12
0x28 REG_10 — Register 10
  [32:30] FIELD_5, [31:29] FIELD_2, [29:28] FIELD_13, [32:28] FIELD_20, [28:27] FIELD_7, [29:25] FIELD_14, [20] FIELD_3, [19] FIELD_9, [21:19] FIELD_18, [19:16] FIELD_11, [18:15] FIELD_1, [17:13] FIELD_12, [12] FIELD_17, [10:9] FIELD_6, [10:8] FIELD_16, [8:5] FIELD_19, [8:4] FIELD_4, [5:4] FIELD_10, [4] FIELD_15, [3:1] FIELD_8
0x2C REG_11 — Register 11
  [30:29] FIELD_9, [27:25] FIELD_10, [24:20] FIELD_5, [19:17] FIELD_11, [15] FIELD_7, [17:13] FIELD_3, [11] FIELD_2, [7:6] FIELD_6, [4:3] FIELD_1, [5:1] FIELD_4, [3:1] FIELD_8
0x30 REG_12 — Register 12
  [30] FIELD_7, [32:29] FIELD_9, [11:7] FIELD_2, [9:7] FIELD_8, [8:6] FIELD_1, [5:3] FIELD_4, [7:3] FIELD_5, [6:3] FIELD_6, [2:0] FIELD_3
0x34 REG_13 — Register 13
  [26] FIELD_1
0x38 REG_14 — Register 14
  [33:31] FIELD_5, [35:31] FIELD_17, [32:30] FIELD_3, [33:30] FIELD_12, [32:29] FIELD_29, [30:27] FIELD_23, [26:25] FIELD_24, [26:24] FIELD_7, [23] FIELD_2, [22:21] FIELD_15, [24:21] FIELD_22, [22:20] FIELD_20, [21:20] FIELD_21, [21:19] FIELD_14, [21:18] FIELD_8, [19:17] FIELD_25, [15] FIELD_6, [18:14] FIELD_4, [18:14] FIELD_9, [14:11] FIELD_27, [12:8] FIELD_13, [7] FIELD_16, [10:6] FIELD_19, [7:5] FIELD_10, [6:4] FIELD_1, [6:4] FIELD_11, [4] FIELD_18, [3:2] FIELD_26, [2] FIELD_28
0x3C REG_15 — Register 15
  [29] FIELD_1, [28:27] FIELD_7, [22] FIELD_8, [22:21] FIELD_4, [15] FIELD_2, [7] FIELD_5, [10:6] FIELD_3, [2] FIELD_6
0x40 REG_16 — Register 16
  [32:31] FIELD_4, [30:26] FIELD_10, [26] FIELD_17, [23:22] FIELD_1, [25:22] FIELD_2, [24:22] FIELD_9, [25:21] FIELD_5, [23:20] FIELD_13, [20] FIELD_15, [13] FIELD_7, [13:12] FIELD_3, [13:11] FIELD_6, [10:9] FIELD_8, [7:4] FIELD_14, [6:3] FIELD_11, [2:1] FIELD_16, [4:0] FIELD_12
0x44 REG_17 — Register 17
  [33:31] FIELD_2, [30:26] FIELD_3, [20:19] FIELD_1, [18:16] FIELD_4
0x48 REG_18 — Register 18
  [29] FIELD_6, [30:27] FIELD_10, [28:27] FIELD_26, [26] FIELD_19, [29:25] FIELD_5, [24] FIELD_12, [27:24] FIELD_21, [22:20] FIELD_14, [19] FIELD_16, [18] FIELD_1, [22:18] FIELD_22, [20:17] FIELD_2, [17:16] FIELD_11, [17:13] FIELD_15, [15:12] FIELD_4, [8:7] FIELD_17, [9:7] FIELD_23, [8:6] FIELD_18, [6:5] FIELD_3, [7:5] FIELD_20, [4] FIELD_24, [5:2] FIELD_8, [6:2] FIELD_9, [3:2] FIELD_13, [3:2] FIELD_25, [4:0] FIELD_7
0x4C REG_19 — Register 19
  [31] FIELD_5, [35:31] FIELD_6, [33:29] FIELD_10, [27:26] FIELD_7, [27:24] FIELD_9, [24:21] FIELD_8, [17:16] FIELD_4, [16:12] FIELD_2, [3] FIELD_1, [2:0] FIELD_3
0x50 REG_20 — Register 20
  [27:26] FIELD_5, [29:25] FIELD_8, [26:25] FIELD_15, [27:24] FIELD_3, [26:22] FIELD_13, [23:19] FIELD_10, [22:18] FIELD_1, [19:17] FIELD_2, [13] FIELD_4, [14:13] FIELD_7, [13:9] FIELD_9, [11:9] FIELD_11, [5:3] FIELD_6, [4:2] FIELD_16, [3:1] FIELD_14, [1:0] FIELD_12
0x54 REG_21 — Register 21
  [35:31] FIELD_5, [33:31] FIELD_19, [28] FIELD_9, [31:28] FIELD_13, [29:25] FIELD_1, [26:25] FIELD_6, [28:24] FIELD_4, [24:23] FIELD_17, [21] FIELD_15, [22:21] FIELD_20, [20:19] FIELD_8, [22:19] FIELD_16, [21:18] FIELD_3, [14:12] FIELD_11, [8] FIELD_10, [9:7] FIELD_7, [8:7] FIELD_12, [9:5] FIELD_14, [6:4] FIELD_18, [3] FIELD_2
0x58 REG_22 — Register 22
  [31] FIELD_6, [32:31] FIELD_7, [33:31] FIELD_8, [25:21] FIELD_2, [22:21] FIELD_12, [18:17] FIELD_1, [19:16] FIELD_10, [17:14] FIELD_3, [15:14] FIELD_5, [9:7] FIELD_11, [7:4] FIELD_9, [6:2] FIELD_4
0x5C REG_23 — Register 23
  [30:29] FIELD_8, [33:29] FIELD_10, [29:28] FIELD_2, [27] FIELD_1, [26] FIELD_6, [26:22] FIELD_11, [18] FIELD_4, [19:16] FIELD_3, [19:16] FIELD_7, [12] FIELD_9, [7:5] FIELD_5
0x60 REG_24 — Register 24
  [34:30] FIELD_10, [32:29] FIELD_6, [28:27] FIELD_26, [26] FIELD_4, [28:25] FIELD_19, [27:23] FIELD_3, [25:23] FIELD_7, [24:23] FIELD_23, [26:22] FIELD_12, [25:21] FIELD_27, [23:20] FIELD_2, [21:19] FIELD_30, [19:18] FIELD_5, [20:18] FIELD_15, [20:17] FIELD_20, [21:17] FIELD_29, [14] FIELD_8, [17:14] FIELD_11, [12] FIELD_31, [10:9] FIELD_17, [10:9] FIELD_28, [9:8] FIELD_1, [8] FIELD_25, [7] FIELD_14, [6:5] FIELD_18, [9:5] FIELD_22, [5:4] FIELD_21, [5:3] FIELD_13, [6:3] FIELD_24, [2] FIELD_9, [4:0] FIELD_16
0x64 REG_25 — Register 25
  [32:29] FIELD_2, [26] FIELD_11, [25] FIELD_12, [28:25] FIELD_14, [29:25] FIELD_17, [27:24] FIELD_15, [23] FIELD_19, [25:21] FIELD_7, [22:20] FIELD_4, [20] FIELD_13, [20] FIELD_18, [23:20] FIELD_25, [20:18] FIELD_9, [20:18] FIELD_23, [17:13] FIELD_6, [17:13] FIELD_10, [13:11] FIELD_1, [12:10] FIELD_26, [10:9] FIELD_5, [11:7] FIELD_3, [7] FIELD_27, [9:6] FIELD_24, [7:4] FIELD_20, [7:3] FIELD_21, [2] FIELD_16, [1] FIELD_8, [3:1] FIELD_22
0x68 REG_26 — Register 26
  [31] FIELD_7, [32:30] FIELD_2, [32:30] FIELD_8, [24] FIELD_6, [24:22] FIELD_3, [21] FIELD_5, [16:13] FIELD_4, [5] FIELD_1
0x6C REG_27 — Register 27
  [30] FIELD_4, [29] FIELD_3, [29:26] FIELD_10, [25] FIELD_9, [26:22] FIELD_8, [24:20] FIELD_16, [20:19] FIELD_2, [19] FIELD_18, [21:18] FIELD_6, [14:11] FIELD_11, [12:10] FIELD_7, [12:9] FIELD_14, [8:7] FIELD_13, [11:7] FIELD_15, [6] FIELD_1, [4] FIELD_17, [3:2] FIELD_12, [4:1] FIELD_5, [1:0] FIELD_19
0x70 REG_28 — Register 28
  [31] FIELD_8, [28:27] FIELD_6, [30:27] FIELD_11, [29:26] FIELD_14, [29:25] FIELD_5, [27:25] FIELD_20, [25:22] FIELD_9, [23:19] FIELD_1, [21:19] FIELD_22, [15] FIELD_4, [18:14] FIELD_12, [17:14] FIELD_17, [16:13] FIELD_13, [15:13] FIELD_16, [15:12] FIELD_10, [12] FIELD_19, [13:11] FIELD_3, [12:11] FIELD_7, [14:10] FIELD_23, [13:9] FIELD_15, [11:8] FIELD_18, [7:6] FIELD_21, [7:3] FIELD_2
0x74 REG_29 — Register 29
  [31] FIELD_7, [34:30] FIELD_10, [34:30] FIELD_21, [29] FIELD_27, [27] FIELD_15, [31:27] FIELD_20, [29:27] FIELD_26, [26:25] FIELD_3, [24:22] FIELD_4, [21:20] FIELD_9, [23:20] FIELD_16, [17] FIELD_11, [20:16] FIELD_2, [19:16] FIELD_5, [18:15] FIELD_14, [18:15] FIELD_19, [16:14] FIELD_24, [18:14] FIELD_25, [9] FIELD_8, [6:5] FIELD_12, [5] FIELD_23, [6:4] FIELD_22, [4:3] FIELD_17, [4:3] FIELD_18, [3:1] FIELD_1, [4:1] FIELD_6, [5:1] FIELD_13
0x78 REG_30 — Register 30
  [29] FIELD_18, [32:29] FIELD_21, [27:25] FIELD_22, [25:24] FIELD_9, [24:22] FIELD_4, [23:22] FIELD_6, [21] FIELD_14, [22:21] FIELD_15, [23:19] FIELD_1, [20:19] FIELD_17, [19:17] FIELD_2, [16:12] FIELD_16, [10:9] FIELD_11, [11:8] FIELD_12, [7] FIELD_13, [6:4] FIELD_5, [6:4] FIELD_20, [4] FIELD_23, [2] FIELD_19, [3:1] FIELD_3, [1] FIELD_7, [5:1] FIELD_8, [5:1] FIELD_10
0x7C REG_31 — Register 31
  [32:30] FIELD_14, [27:26] FIELD_26, [28:24] FIELD_8, [23:22] FIELD_19, [20] FIELD_21, [22:19] FIELD_11, [20:19] FIELD_25, [20:18] FIELD_4, [22:18] FIELD_10, [16] FIELD_9, [20:16] FIELD_13, [16:15] FIELD_6, [14] FIELD_16, [16:14] FIELD_20, [16:14] FIELD_27, [15:11] FIELD_5, [11] FIELD_7, [10] FIELD_1, [14:10] FIELD_24, [9:6] FIELD_18, [6:5] FIELD_15, [8:4] FIELD_3, [7:4] FIELD_28, [6:4] FIELD_29, [7:3] FIELD_23, [2] FIELD_2, [3:2] FIELD_12, [5:2] FIELD_17, [1] FIELD_22
0x80 REG_32 — Register 32
  [15:12] FIELD_1
0x84 REG_33 — Register 33
  [34:31] FIELD_14, [30] FIELD_9, [28:27] FIELD_7, [25:24] FIELD_5, [20] FIELD_4, [23:20] FIELD_8, [21:17] FIELD_15, [15] FIELD_2, [16:15] FIELD_6, [12] FIELD_10, [11:10] FIELD_11, [11:10] FIELD_13, [9:6] FIELD_3, [9:5] FIELD_12, [4] FIELD_1
0x88 REG_34 — Register 34
  [30] FIELD_11, [32:30] FIELD_14, [30:29] FIELD_6, [29:28] FIELD_2, [29:27] FIELD_8, [29:25] FIELD_9, [26:25] FIELD_17, [26:22] FIELD_19, [21] FIELD_18, [16:15] FIELD_7, [14] FIELD_15, [15:12] FIELD_5, [15:12] FIELD_16, [9] FIELD_10, [8:7] FIELD_4, [9:5] FIELD_3, [5:4] FIELD_1, [5:2] FIELD_13, [4:0] FIELD_12
0x8C REG_35 — Register 35
  [28] FIELD_6, [26:25] FIELD_1, [22:21] FIELD_4, [14:11] FIELD_2, [11:9] FIELD_3, [7:6] FIELD_5
0x90 REG_36 — Register 36
  [35:31] FIELD_9, [28:24] FIELD_1, [24] FIELD_8, [24:22] FIELD_4, [25:22] FIELD_5, [16] FIELD_3, [18:16] FIELD_10, [17:14] FIELD_2, [4:2] FIELD_7, [0] FIELD_6
0x94 REG_37 — Register 37
  [31] FIELD_8, [31] FIELD_13, [34:31] FIELD_23, [32:30] FIELD_2, [30] FIELD_6, [29:28] FIELD_27, [29:25] FIELD_3, [28:24] FIELD_9, [25:24] FIELD_16, [26:24] FIELD_17, [19:18] FIELD_20, [19:17] FIELD_15, [17:14] FIELD_11, [18:14] FIELD_30, [15:12] FIELD_1, [10] FIELD_14, [13:10] FIELD_31, [11:9] FIELD_21, [9:8] FIELD_5, [8] FIELD_12, [11:7] FIELD_4, [10:7] FIELD_7, [6] FIELD_25, [5] FIELD_18, [8:5] FIELD_26, [8:4] FIELD_10, [3] FIELD_22, [3] FIELD_24, [6:3] FIELD_28, [7:3] FIELD_29, [2:1] FIELD_19
0x98 REG_38 — Register 38
  [29:27] FIELD_2, [28:26] FIELD_5, [26] FIELD_8, [25] FIELD_16, [26:23] FIELD_3, [24:22] FIELD_14, [21:20] FIELD_11, [20:19] FIELD_6, [19] FIELD_15, [19:17] FIELD_4, [17] FIELD_18, [13:12] FIELD_1, [12:10] FIELD_7, [10] FIELD_13, [8] FIELD_12, [10:6] FIELD_17, [4:2] FIELD_10, [4:1] FIELD_9
0x9C REG_39 — Register 39
  [33:30] FIELD_4, [29] FIELD_14, [28:27] FIELD_6, [31:27] FIELD_11, [26] FIELD_3, [27:26] FIELD_12, [24] FIELD_13, [24:23] FIELD_16, [23:22] FIELD_8, [19] FIELD_15, [17] FIELD_10, [16:14] FIELD_7, [14:11] FIELD_1, [11:9] FIELD_5, [8:6] FIELD_9, [7:5] FIELD_2
0xA0 REG_40 — Register 40
  [34:31] FIELD_4, [33:31] FIELD_20, [32:29] FIELD_16, [32:29] FIELD_21, [28:27] FIELD_3, [26:24] FIELD_11, [26:23] FIELD_7, [22] FIELD_17, [25:22] FIELD_22, [23:21] FIELD_8, [25:21] FIELD_9, [25:21] FIELD_12, [20:19] FIELD_14, [18:17] FIELD_10, [20:17] FIELD_19, [15] FIELD_6, [14:12] FIELD_2, [13:11] FIELD_1, [9:8] FIELD_13, [8] FIELD_15, [10:7] FIELD_5, [9:5] FIELD_18
0xA4 REG_41 — Register 41
  [31] FIELD_2, [30:27] FIELD_4, [27] FIELD_9, [28:25] FIELD_10, [25] FIELD_16, [25:22] FIELD_13, [24:20] FIELD_1, [21:20] FIELD_8, [17:15] FIELD_14, [16:14] FIELD_3, [16:14] FIELD_12, [14:10] FIELD_17, [9] FIELD_11, [8:7] FIELD_15, [8:6] FIELD_5, [5] FIELD_7, [5:4] FIELD_6
0xA8 REG_42 — Register 42
  [33:31] FIELD_22, [27] FIELD_26, [29:26] FIELD_21, [26] FIELD_23, [25] FIELD_1, [26:25] FIELD_11, [28:25] FIELD_15, [28:24] FIELD_16, [25:24] FIELD_17, [26:23] FIELD_9, [24:23] FIELD_29, [25:22] FIELD_3, [24:22] FIELD_19, [20] FIELD_24, [20:19] FIELD_31, [17:14] FIELD_13, [16:14] FIELD_25, [17:13] FIELD_30, [12] FIELD_4, [16:12] FIELD_5, [14:12] FIELD_7, [14:12] FIELD_28, [12:11] FIELD_18, [12:8] FIELD_8, [6] FIELD_2, [8:6] FIELD_12, [8:6] FIELD_20, [6:5] FIELD_27, [5:2] FIELD_10, [3:1] FIELD_6, [0] FIELD_14
