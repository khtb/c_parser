# LargeDummyDevice register map
File version: 1.0
Registers are 32-bit, read-write, no defined reset value unless marked. A register's access mark holds for its fields unless they carry their own. Offsets are from the block's base; [hi:lo] are bit positions.

## PERIPHERAL_27
Base 0x4001A000
0x04 REG_1 — Register 1
  [34:31] FIELD_11, [33:30] FIELD_3, [30] FIELD_10, [28:27] FIELD_14, [26:25] FIELD_7, [25] FIELD_22, [24] FIELD_16, [28:24] FIELD_26, [25:22] FIELD_5, [24:22] FIELD_23, [24:21] FIELD_24, [20] FIELD_4, [19:17] FIELD_17, [15:14] FIELD_9, [17:13] FIELD_1, [15:13] FIELD_6, [14:13] FIELD_21, [13] FIELD_29, [14:10] FIELD_25, [9:7] FIELD_12, [7] FIELD_18, [8:7] FIELD_27, [9:7] FIELD_28, [7] FIELD_31, [6] FIELD_8, [7:6] FIELD_19, [4] FIELD_2, [5:4] FIELD_20, [5:2] FIELD_13, [4:1] FIELD_15, [4:1] FIELD_30
0x08 REG_2 — Register 2
  [32:31] FIELD_13, [33:30] FIELD_27, [29] FIELD_6, [30:29] FIELD_20, [31:28] FIELD_1, [29:28] FIELD_18, [28] FIELD_21, [32:28] FIELD_28, [30:26] FIELD_4, [27:25] FIELD_19, [28:24] FIELD_10, [27:24] FIELD_22, [25:24] FIELD_23, [23:22] FIELD_11, [21:18] FIELD_2, [21:18] FIELD_12, [18] FIELD_17, [21:18] FIELD_26, [20:17] FIELD_5, [18:17] FIELD_24, [17] FIELD_25, [19:15] FIELD_8, [18:15] FIELD_14, [15:12] FIELD_16, [15:12] FIELD_29, [13:9] FIELD_15, [6:4] FIELD_3, [4] FIELD_9, [2:0] FIELD_7
0x0C REG_3 — Register 3
  [26] FIELD_1
0x10 REG_4 — Register 4
  [30:29] FIELD_2, [30:28] FIELD_22, [30:27] FIELD_7, [30:27] FIELD_15, [29:25] FIELD_25, [25:24] FIELD_18, [24] FIELD_20, [23] FIELD_11, [25:23] FIELD_27, [24:21] FIELD_13, [21:20] FIELD_14, [21:20] FIELD_24, [23:19] FIELD_3, [21:19] FIELD_6, [21:17] FIELD_23, [20:16] FIELD_4, [15:14] FIELD_8, [18:14] FIELD_16, [17:14] FIELD_26, [13:12] FIELD_19, [11] FIELD_30, [10] FIELD_10, [11:10] FIELD_21, [10:9] FIELD_1, [12:9] FIELD_12, [11:8] FIELD_17, [9:8] FIELD_28, [7:4] FIELD_9, [7:3] FIELD_5, [3:2] FIELD_29
0x14 REG_5 — Register 5
  [32:29] FIELD_5, [27] FIELD_10, [27:26] FIELD_6, [26:25] FIELD_4, [23:20] FIELD_1, [20:19] FIELD_2, [21:19] FIELD_7, [19:17] FIELD_3, [18:15] FIELD_8, [13:11] FIELD_9, [7:5] FIELD_11
0x18 REG_6 — Register 6
  [33:31] FIELD_17, [32:31] FIELD_18, [33:30] FIELD_4, [29] FIELD_22, [29:28] FIELD_23, [27:25] FIELD_14, [28:25] FIELD_24, [24:20] FIELD_13, [22:19] FIELD_10, [19] FIELD_20, [20:16] FIELD_15, [17:16] FIELD_16, [14] FIELD_5, [14:13] FIELD_3, [16:13] FIELD_21, [10] FIELD_6, [13:10] FIELD_8, [12:10] FIELD_11, [11:9] FIELD_7, [11:7] FIELD_25, [8:5] FIELD_2, [8:5] FIELD_19, [5:4] FIELD_12, [7:3] FIELD_9, [2:1] FIELD_1
0x1C REG_7 — Register 7
  [35:31] FIELD_1, [32:30] FIELD_17, [32:29] FIELD_6, [33:29] FIELD_14, [31:29] FIELD_19, [33:29] FIELD_28, [33:29] FIELD_30, [30:28] FIELD_16, [28:26] FIELD_26, [24] FIELD_29, [25:23] FIELD_11, [24:23] FIELD_20, [21] FIELD_8, [24:21] FIELD_23, [20] FIELD_3, [19:17] FIELD_2, [18:16] FIELD_10, [17:15] FIELD_4, [18:15] FIELD_9, [18:15] FIELD_21, [15:14] FIELD_7, [18:14] FIELD_27, [15:13] FIELD_12, [16:12] FIELD_25, [10:9] FIELD_5, [11:9] FIELD_18, [8:4] FIELD_15, [5:2] FIELD_13, [3:1] FIELD_31, [4:0] FIELD_22, [2:0] FIELD_24
0x20 REG_8 — Register 8
  [34:31] FIELD_15, [31] FIELD_24, [32:30] FIELD_14, [29] FIELD_10, [27] FIELD_6, [29:27] FIELD_21, [28:25] FIELD_23, [27:23] FIELD_9, [21] FIELD_11, [24:20] FIELD_7, [20:18] FIELD_2, [19:18] FIELD_13, [16] FIELD_1, [19:15] FIELD_12, [17:13] FIELD_18, [16:13] FIELD_22, [16:12] FIELD_19, [13:11] FIELD_5, [13:11] FIELD_20, [11:10] FIELD_8, [11:10] FIELD_25, [11:9] FIELD_17, [6] FIELD_4, [7:6] FIELD_26, [4] FIELD_16, [3] FIELD_3
0x24 REG_9 — Register 9
  [33:30] FIELD_19, [28] FIELD_21, [29:27] FIELD_7, [31:27] FIELD_22, [24] FIELD_8, [26:22] FIELD_4, [26:22] FIELD_5, [26:22] FIELD_20, [21:20] FIELD_14, [21:18] FIELD_2, [22:18] FIELD_17, [20:17] FIELD_15, [18:16] FIELD_13, [18:16] FIELD_18, [14:13] FIELD_23, [15:12] FIELD_1, [16:12] FIELD_9, [16:12] FIELD_11, [13:10] FIELD_6, [10:6] FIELD_3, [7:6] FIELD_10, [2:1] FIELD_12, [5:1] FIELD_16
0x28 REG_10 — Register 10
  [32:29] FIELD_3, [30:28] FIELD_6, [28] FIELD_22, [31:27] FIELD_8, [27] FIELD_17, [29:27] FIELD_19, [24:22] FIELD_23, [25:21] FIELD_4, [25:21] FIELD_20, [18:17] FIELD_13, [16:15] FIELD_2, [15] FIELD_9, [15] FIELD_11, [17:15] FIELD_15, [15] FIELD_21, [14] FIELD_14, [17:14] FIELD_16, [15:11] FIELD_1, [11] FIELD_12, [13:10] FIELD_18, [9:7] FIELD_7, [7:3] FIELD_10, [5:1] FIELD_5
