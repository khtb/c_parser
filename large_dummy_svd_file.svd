# LargeDummyDevice register map
File version: 1.0
Registers are 32-bit, read-write, no defined reset value unless marked. A register's access mark holds for its fields unless they carry their own. Offsets are from the block's base; [hi:lo] are bit positions.

## PERIPHERAL_67
Base 0x40042000
0x04 REG_1 — Register 1
  [5:2] FIELD_1
0x08 REG_2 — Register 2
  [32:29] FIELD_2, [28:27] FIELD_1, [29:25] FIELD_22, [28:25] FIELD_31, [23] FIELD_7, [26:23] FIELD_11, [23] FIELD_12, [26:23] FIELD_24, [24:22] FIELD_16, [22:21] FIELD_10, [23:20] FIELD_3, [23:20] FIELD_25, [20:19] FIELD_23, [20:17] FIELD_27, [16] FIELD_6, [20:16] FIELD_13, [17:16] FIELD_19, [15] FIELD_32, [15:14] FIELD_4, [18:14] FIELD_5, [14] FIELD_17, [14:11] FIELD_20, [10] FIELD_29, [13:9] FIELD_28, [8] FIELD_14, [10:6] FIELD_21, [8:6] FIELD_26, [8:5] FIELD_8, [6:5] FIELD_9, [5:3] FIELD_18, [2:1] FIELD_30, [1:0] FIELD_15
0x0C REG_3 — Register 3
  [34:31] FIELD_8, [31] FIELD_9, [32:31] FIELD_13, [31:29] FIELD_1, [24:23] FIELD_14, [20] FIELD_3, [19:18] FIELD_10, [21:18] FIELD_12, [14] FIELD_2, [11:9] FIELD_5, [8] FIELD_7, [6:4] FIELD_4, [3] FIELD_6, [2:1] FIELD_11
0x10 REG_4 — Register 4
  [29] FIELD_11, [30:27] FIELD_5, [29:27] FIELD_14, [25] FIELD_6, [25:23] FIELD_8, [25:22] FIELD_2, [24:22] FIELD_12, [22] FIELD_13, [18:16] FIELD_1, [14:11] FIELD_9, [10] FIELD_4, [9] FIELD_3, [7:4] FIELD_7, [2:0] FIELD_10
0x14 REG_5 — Register 5
  [29] FIELD_21, [28] FIELD_1, [30:26] FIELD_9, [29:25] FIELD_2, [24:23] FIELD_8, [21:20] FIELD_22, [20:19] FIELD_3, [20:19] FIELD_23, [19] FIELD_24, [20:16] FIELD_15, [16:13] FIELD_7, [17:13] FIELD_18, [11] FIELD_5, [13:11] FIELD_17, [10:9] FIELD_6, [7] FIELD_16, [6:4] FIELD_10, [5:4] FIELD_12, [5:3] FIELD_19, [6:2] FIELD_4, [3:2] FIELD_20, [4:1] FIELD_11, [5:1] FIELD_13, [2:0] FIELD_14
0x18 REG_6 — Register 6
  [34:31] FIELD_5, [30:27] FIELD_3, [25:24] FIELD_1, [25:21] FIELD_4, [21:17] FIELD_8, [10] FIELD_6, [7:3] FIELD_7, [0] FIELD_2
0x1C REG_7 — Register 7
  [34:31] FIELD_4, [30:28] FIELD_9, [27:24] FIELD_15, [25:22] FIELD_10, [22:21] FIELD_12, [22:20] FIELD_19, [21:18] FIELD_6, [20:16] FIELD_17, [16:14] FIELD_7, [16:12] FIELD_3, [11:9] FIELD_5, [12:9] FIELD_11, [8] FIELD_13, [10:7] FIELD_20, [10:6] FIELD_18, [4] FIELD_21, [5:3] FIELD_1, [1] FIELD_14, [1:0] FIELD_2, [2:0] FIELD_8, [2:0] FIELD_16
0x20 REG_8 — Register 8
  [31:30] FIELD_8, [19] FIELD_5, [21:17] FIELD_1, [17] FIELD_7, [19:15] FIELD_4, [18:14] FIELD_9, [10:6] FIELD_2, [4:3] FIELD_3, [5:2] FIELD_6
0x24 REG_9 — Register 9
  [32:31] FIELD_1, [33:29] FIELD_14, [29:28] FIELD_3, [29:25] FIELD_10, [25:22] FIELD_6, [21:20] FIELD_9, [19] FIELD_2, [19:17] FIELD_15, [18:15] FIELD_7, [15] FIELD_8, [19:15] FIELD_16, [8] FIELD_12, [8] FIELD_17, [5] FIELD_5, [3] FIELD_4, [4:2] FIELD_13, [3:2] FIELD_18, [2:1] FIELD_11
0x28 REG_10 — Register 10
  [34:30] FIELD_2, [33:29] FIELD_4, [29:26] FIELD_6, [21:19] FIELD_7, [21:17] FIELD_10, [18:15] FIELD_3, [17:15] FIELD_8, [15:14] FIELD_1, [14:11] FIELD_9, [8:4] FIELD_5
0x2C REG_11 — Register 11
  [25:24] FIELD_8, [21:18] FIELD_9, [13:9] FIELD_5, [7] FIELD_1, [8:7] FIELD_7, [9:6] FIELD_4, [6:5] FIELD_6, [3] FIELD_2, [3:1] FIELD_3
0x30 REG_12 — Register 12
  [31:28] FIELD_1, [30:27] FIELD_6, [28:27] FIELD_7, [26:25] FIELD_4, [28:25] FIELD_8, [19:16] FIELD_10, [14:12] FIELD_5, [12] FIELD_12, [15:11] FIELD_3, [11:7] FIELD_2, [6:2] FIELD_9, [1:0] FIELD_11
0x34 REG_13 — Register 13
  [31:28] FIELD_4, [31:27] FIELD_5, [25:21] FIELD_1, [20:19] FIELD_8, [16:13] FIELD_7, [10] FIELD_2, [6:2] FIELD_3, [1] FIELD_6

## PERIPHERAL_71
Base 0x40046000
0x04 REG_1 — Register 1
  [31:29] FIELD_1, [30:26] FIELD_6, [20:18] FIELD_4, [10:8] FIELD_3, [8:4] FIELD_2, [3] FIELD_5

## PERIPHERAL_87
Base 0x40056000
0x04 REG_1 — Register 1
  [32:30] FIELD_1, [30:26] FIELD_4, [25] FIELD_8, [25:21] FIELD_2, [23:21] FIELD_5, [15:14] FIELD_6, [11:7] FIELD_7, [4:3] FIELD_3
0x08 REG_2 — Register 2
  [31] FIELD_18, [29] FIELD_4, [30:27] FIELD_11, [25] FIELD_7, [25:23] FIELD_5, [27:23] FIELD_22, [25:22] FIELD_10, [23:22] FIELD_16, [22:20] FIELD_8, [22:20] FIELD_12, [20:19] FIELD_21, [20:18] FIELD_13, [19:18] FIELD_14, [19:16] FIELD_15, [13] FIELD_19, [12:9] FIELD_17, [7] FIELD_3, [7:6] FIELD_1, [8:5] FIELD_2, [8:5] FIELD_20, [8:4] FIELD_9, [5:1] FIELD_6
0x0C REG_3 — Register 3
  [30:28] FIELD_6, [28:27] FIELD_3, [26] FIELD_8, [27:23] FIELD_18, [26:22] FIELD_20, [24:21] FIELD_9, [24:21] FIELD_21, [19] FIELD_14, [20:17] FIELD_11, [15:14] FIELD_13, [16:13] FIELD_5, [15:13] FIELD_19, [15:11] FIELD_10, [11] FIELD_16, [9:6] FIELD_1, [7:6] FIELD_15, [8:5] FIELD_4, [5:3] FIELD_7, [2:1] FIELD_12, [4:0] FIELD_2, [4:0] FIELD_17
0x10 REG_4 — Register 4
  [33:31] FIELD_8, [31:30] FIELD_11, [33:29] FIELD_2, [26] FIELD_6, [29:25] FIELD_4, [25:21] FIELD_10, [23:20] FIELD_12, [17:14] FIELD_3, [14:13] FIELD_1, [14:12] FIELD_9, [6:3] FIELD_5, [4:1] FIELD_7
