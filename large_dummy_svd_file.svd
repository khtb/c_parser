# LargeDummyDevice register map
File version: 1.0
Registers are 32-bit, read-write, no defined reset value unless marked. A register's access mark holds for its fields unless they carry their own. Offsets are from the block's base; [hi:lo] are bit positions.

## PERIPHERAL_73
Base 0x40048000
0x04 REG_1 — Register 1
  [34:30] FIELD_2, [30:28] FIELD_3, [30:26] FIELD_1, [17] FIELD_4
0x08 REG_2 — Register 2
  [32:31] FIELD_20, [31:30] FIELD_11, [30:27] FIELD_1, [27] FIELD_12, [30:27] FIELD_25, [25] FIELD_13, [25:22] FIELD_7, [24:21] FIELD_10, [23:21] FIELD_23, [21:20] FIELD_22, [23:19] FIELD_3, [23:19] FIELD_6, [21:19] FIELD_14, [19:18] FIELD_26, [19:16] FIELD_16, [17:14] FIELD_24, [16:13] FIELD_27, [15:12] FIELD_2, [12] FIELD_9, [15:12] FIELD_19, [15:11] FIELD_4, [11:8] FIELD_21, [6] FIELD_18, [9:6] FIELD_29, [5:3] FIELD_28, [5:2] FIELD_15, [6:2] FIELD_17, [2:1] FIELD_5, [5:1] FIELD_8
0x0C REG_3 — Register 3
  [33:30] FIELD_9, [27:25] FIELD_4, [26:25] FIELD_7, [18] FIELD_8, [19:16] FIELD_3, [14:12] FIELD_1, [13:9] FIELD_5, [10:6] FIELD_2, [1:0] FIELD_6
0x10 REG_4 — Register 4
  [30] FIELD_13, [31:28] FIELD_4, [29:27] FIELD_12, [26] FIELD_17, [30:26] FIELD_20, [25:23] FIELD_19, [23:19] FIELD_8, [17:15] FIELD_11, [17:14] FIELD_3, [13] FIELD_2, [13:12] FIELD_18, [12:11] FIELD_5, [15:11] FIELD_16, [10] FIELD_6, [12:10] FIELD_15, [11:9] FIELD_1, [7] FIELD_10, [7:4] FIELD_14, [6:2] FIELD_7, [3:1] FIELD_9
0x14 REG_5 — Register 5
  [33:30] FIELD_7, [32:29] FIELD_3, [28] FIELD_8, [24] FIELD_2, [22:19] FIELD_5, [10] FIELD_1, [13:9] FIELD_6, [5:4] FIELD_4, [6:2] FIELD_9
0x18 REG_6 — Register 6
  [33:29] FIELD_8, [20] FIELD_9, [18:17] FIELD_4, [18:15] FIELD_10, [16:14] FIELD_3, [18:14] FIELD_6, [16:13] FIELD_7, [6] FIELD_1, [5:1] FIELD_2, [1] FIELD_5
0x1C REG_7 — Register 7
  [33:30] FIELD_19, [29:28] FIELD_18, [29:27] FIELD_3, [26] FIELD_22, [28:24] FIELD_10, [26:24] FIELD_24, [27:24] FIELD_25, [26:22] FIELD_20, [23:22] FIELD_23, [25:21] FIELD_4, [25:21] FIELD_13, [23:19] FIELD_16, [22:18] FIELD_14, [16] FIELD_1, [16] FIELD_12, [16:13] FIELD_7, [17:13] FIELD_11, [13] FIELD_26, [14:11] FIELD_6, [14:11] FIELD_21, [10] FIELD_8, [11:7] FIELD_2, [11:7] FIELD_9, [9:6] FIELD_5, [6] FIELD_17, [7:4] FIELD_15
0x20 REG_8 — Register 8
  [31:30] FIELD_2, [33:30] FIELD_13, [29:28] FIELD_4, [29:28] FIELD_10, [28:26] FIELD_3, [26:22] FIELD_5, [18:15] FIELD_7, [12:10] FIELD_9, [8:6] FIELD_11, [8:5] FIELD_6, [6:3] FIELD_1, [7:3] FIELD_8, [3] FIELD_12, [5:3] FIELD_14, [5:2] FIELD_15
0x24 REG_9 — Register 9
  [30] FIELD_15, [31:27] FIELD_1, [31:27] FIELD_9, [29:25] FIELD_14, [24:23] FIELD_7, [21:19] FIELD_2, [21:18] FIELD_4, [21:17] FIELD_11, [14] FIELD_5, [14:11] FIELD_8, [10:8] FIELD_17, [8:7] FIELD_12, [9:5] FIELD_10, [3] FIELD_13, [2] FIELD_3, [6:2] FIELD_6, [1:0] FIELD_16
0x28 REG_10 — Register 10
  [32:31] FIELD_25, [30] FIELD_21, [33:29] FIELD_9, [30:29] FIELD_16, [30:29] FIELD_29, [31:28] FIELD_3, [27] FIELD_4, [27] FIELD_10, [26] FIELD_8, [29:26] FIELD_15, [29:26] FIELD_27, [25] FIELD_23, [26:24] FIELD_1, [25:23] FIELD_17, [25:23] FIELD_24, [25:22] FIELD_6, [26:22] FIELD_12, [24:22] FIELD_14, [20:19] FIELD_2, [21:19] FIELD_28, [16] FIELD_20, [18:16] FIELD_31, [13] FIELD_5, [15:11] FIELD_26, [10] FIELD_19, [10:9] FIELD_18, [9] FIELD_22, [9:7] FIELD_7, [10:7] FIELD_13, [6:5] FIELD_11, [8:5] FIELD_30
0x2C REG_11 — Register 11
  [29] FIELD_2, [16] FIELD_4, [20:16] FIELD_7, [18:14] FIELD_1, [17:14] FIELD_9, [16:12] FIELD_10, [10] FIELD_5, [11:7] FIELD_8, [6:3] FIELD_3, [3] FIELD_6
0x30 REG_12 — Register 12
  [30] FIELD_16, [29:28] FIELD_8, [29:28] FIELD_12, [30:27] FIELD_25, [24:23] FIELD_6, [26:23] FIELD_24, [25:22] FIELD_10, [22:21] FIELD_18, [19:18] FIELD_7, [19:18] FIELD_14, [19:17] FIELD_9, [20:16] FIELD_20, [16:15] FIELD_23, [18:14] FIELD_2, [16:14] FIELD_19, [17:14] FIELD_21, [15:13] FIELD_1, [13] FIELD_3, [15:13] FIELD_11, [14:10] FIELD_15, [10:6] FIELD_13, [3] FIELD_17, [2] FIELD_4, [5:1] FIELD_5, [1] FIELD_22, [4:1] FIELD_26, [3:1] FIELD_27
0x34 REG_13 — Register 13
  [30] FIELD_7, [28:27] FIELD_3, [16] FIELD_1, [14] FIELD_6, [16:12] FIELD_2, [10] FIELD_8, [11:9] FIELD_10, [9:8] FIELD_5, [5] FIELD_4, [1] FIELD_9
0x38 REG_14 — Register 14
  [30] FIELD_14, [34:30] FIELD_19, [25] FIELD_13, [25:23] FIELD_9, [24:22] FIELD_3, [24:21] FIELD_18, [22:18] FIELD_12, [16:15] FIELD_16, [18:14] FIELD_6, [13:12] FIELD_7, [12:11] FIELD_5, [12:11] FIELD_17, [10:8] FIELD_1, [9:8] FIELD_10, [10:7] FIELD_4, [9:6] FIELD_2, [5:4] FIELD_8, [0] FIELD_11, [0] FIELD_15
0x3C REG_15 — Register 15
  [30] FIELD_16, [34:30] FIELD_27, [33:29] FIELD_9, [30:29] FIELD_20, [31:29] FIELD_21, [30:28] FIELD_8, [30:28] FIELD_19, [28:25] FIELD_25, [28:24] FIELD_18, [20] FIELD_26, [14] FIELD_2, [17:14] FIELD_13, [17:13] FIELD_11, [12] FIELD_6, [13:11] FIELD_17, [10] FIELD_28, [12:10] FIELD_29, [10:7] FIELD_3, [10:7] FIELD_22, [5:4] FIELD_7, [8:4] FIELD_10, [7:4] FIELD_12, [4] FIELD_14, [4:3] FIELD_5, [4:3] FIELD_24, [3:2] FIELD_15, [2:1] FIELD_1, [2:1] FIELD_23, [1:0] FIELD_4
0x40 REG_16 — Register 16
  [32:29] FIELD_3, [33:29] FIELD_8, [30:27] FIELD_18, [26:22] FIELD_12, [25:21] FIELD_11, [23:20] FIELD_15, [22:19] FIELD_9, [21:18] FIELD_17, [18:15] FIELD_7, [17:14] FIELD_1, [16:14] FIELD_5, [14] FIELD_16, [9:6] FIELD_2, [6:5] FIELD_4, [6:3] FIELD_14, [3:2] FIELD_6, [6:2] FIELD_13, [1] FIELD_10
0x44 REG_17 — Register 17
  [33:30] FIELD_12, [31:30] FIELD_21, [31:30] FIELD_23, [33:29] FIELD_6, [28] FIELD_11, [31:27] FIELD_15, [29:25] FIELD_18, [25:24] FIELD_3, [25:23] FIELD_17, [22:20] FIELD_16, [20] FIELD_26, [18] FIELD_8, [21:18] FIELD_13, [14:13] FIELD_10, [11] FIELD_19, [13:11] FIELD_27, [10] FIELD_20, [7] FIELD_1, [6] FIELD_9, [7:4] FIELD_4, [5:3] FIELD_25, [4:2] FIELD_5, [2:1] FIELD_2, [1] FIELD_14, [1] FIELD_22, [1:0] FIELD_7, [0] FIELD_24, [4:0] FIELD_28
0x48 REG_18 — Register 18
  [31:29] FIELD_3, [23:21] FIELD_11, [20:16] FIELD_5, [15:12] FIELD_7, [15:11] FIELD_10, [11:10] FIELD_2, [9] FIELD_6, [12:8] FIELD_9, [6:3] FIELD_1, [7:3] FIELD_8, [3:2] FIELD_4
0x4C REG_19 — Register 19
  [5:2] FIELD_1
0x50 REG_20 — Register 20
  [28] FIELD_11, [28:25] FIELD_10, [25:22] FIELD_3, [24:22] FIELD_9, [21:20] FIELD_6, [21:18] FIELD_5, [16] FIELD_12, [13:12] FIELD_1, [7:6] FIELD_2, [7:6] FIELD_7, [4:1] FIELD_4, [3:1] FIELD_8
0x54 REG_21 — Register 21
  [30] FIELD_6, [30] FIELD_10, [33:29] FIELD_12, [32:29] FIELD_21, [30:28] FIELD_19, [27:23] FIELD_16, [25:23] FIELD_17, [26:22] FIELD_32, [20] FIELD_7, [24:20] FIELD_11, [23:19] FIELD_31, [18:17] FIELD_29, [14] FIELD_4, [16:14] FIELD_23, [13] FIELD_3, [14:13] FIELD_8, [16:13] FIELD_14, [14:13] FIELD_28, [13] FIELD_30, [11:10] FIELD_13, [12:10] FIELD_25, [9] FIELD_9, [10:9] FIELD_26, [10:9] FIELD_27, [12:8] FIELD_1, [12:8] FIELD_20, [7] FIELD_15, [9:7] FIELD_24, [4] FIELD_22, [6:2] FIELD_18, [2:1] FIELD_5, [1:0] FIELD_2
0x58 REG_22 — Register 22
  [33:30] FIELD_20, [33:29] FIELD_5, [30:28] FIELD_12, [31:27] FIELD_8, [28:26] FIELD_2, [29:25] FIELD_3, [25:24] FIELD_4, [22] FIELD_1, [22] FIELD_11, [25:22] FIELD_21, [23:21] FIELD_9, [23:19] FIELD_24, [23:19] FIELD_25, [18:16] FIELD_7, [19:16] FIELD_13, [17:14] FIELD_17, [15:11] FIELD_15, [11:10] FIELD_27, [11:8] FIELD_23, [12:8] FIELD_26, [7:6] FIELD_14, [9:6] FIELD_16, [9:5] FIELD_10, [5:3] FIELD_18, [5:2] FIELD_6, [2:0] FIELD_19, [0] FIELD_22
0x5C REG_23 — Register 23
  [34:31] FIELD_12, [27] FIELD_7, [27:26] FIELD_14, [26:24] FIELD_2, [27:24] FIELD_15, [21:19] FIELD_5, [18] FIELD_6, [22:18] FIELD_10, [17:16] FIELD_9, [18:15] FIELD_3, [15:13] FIELD_11, [16:12] FIELD_4, [14:11] FIELD_18, [10:8] FIELD_1, [4:3] FIELD_16, [6:3] FIELD_19, [4:2] FIELD_17, [1] FIELD_13, [1:0] FIELD_8
