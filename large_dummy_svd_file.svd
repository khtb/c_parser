# LargeDummyDevice register map
File version: 1.0
Registers are 32-bit, read-write, no defined reset value unless marked. A register's access mark holds for its fields unless they carry their own. Offsets are from the block's base; [hi:lo] are bit positions.

## PERIPHERAL_68
Base 0x40043000
0x04 REG_1 — Register 1
  [26] FIELD_3, [25] FIELD_4, [24] FIELD_5, [24:23] FIELD_6, [19:18] FIELD_1, [19:16] FIELD_10, [16:14] FIELD_7, [14:13] FIELD_12, [15:11] FIELD_2, [12:11] FIELD_11, [9:5] FIELD_9, [5:3] FIELD_8
0x08 REG_2 — Register 2
  [31:28] FIELD_1, [27] FIELD_4, [25:24] FIELD_11, [26:23] FIELD_9, [27:23] FIELD_13, [17:15] FIELD_15, [14:12] FIELD_8, [13:9] FIELD_2, [8] FIELD_5, [9:8] FIELD_6, [8] FIELD_14, [9:8] FIELD_16, [7:3] FIELD_3, [4:3] FIELD_7, [6:2] FIELD_10, [3:0] FIELD_12
0x0C REG_3 — Register 3
  [29] FIELD_5, [31:28] FIELD_22, [28:27] FIELD_3, [26:24] FIELD_8, [24] FIELD_11, [23:22] FIELD_2, [22] FIELD_16, [23:22] FIELD_19, [22:21] FIELD_24, [22:20] FIELD_18, [22:18] FIELD_4, [18] FIELD_12, [21:18] FIELD_17, [20:18] FIELD_21, [21:17] FIELD_23, [18:16] FIELD_1, [18:16] FIELD_20, [12:11] FIELD_10, [12:11] FIELD_14, [10] FIELD_9, [11:8] FIELD_13, [7] FIELD_15, [7:4] FIELD_6, [2:0] FIELD_7
0x10 REG_4 — Register 4
  [33:30] FIELD_7, [25:24] FIELD_2, [14:11] FIELD_6, [13:10] FIELD_5, [12:8] FIELD_4, [9:5] FIELD_3, [6:5] FIELD_8, [2:0] FIELD_1
0x14 REG_5 — Register 5
  [5:2] FIELD_1, [3:0] FIELD_2
0x18 REG_6 — Register 6
  [31:27] FIELD_4, [27:24] FIELD_9, [22:20] FIELD_12, [20:18] FIELD_10, [19:15] FIELD_3, [17:15] FIELD_13, [17:14] FIELD_2, [17:14] FIELD_11, [12] FIELD_5, [14:11] FIELD_6, [10] FIELD_8, [8] FIELD_1, [9:5] FIELD_7
0x1C REG_7 — Register 7
  [31:29] FIELD_20, [29:27] FIELD_3, [25:23] FIELD_18, [23:21] FIELD_10, [25:21] FIELD_12, [21:20] FIELD_19, [23:19] FIELD_15, [19:18] FIELD_1, [21:18] FIELD_11, [17] FIELD_21, [18:16] FIELD_6, [19:15] FIELD_4, [16:13] FIELD_5, [15:13] FIELD_9, [14:12] FIELD_16, [10:9] FIELD_7, [13:9] FIELD_17, [5] FIELD_8, [7:4] FIELD_14, [7:4] FIELD_22, [6:3] FIELD_13, [3:1] FIELD_2
0x20 REG_8 — Register 8
  [33:31] FIELD_11, [30] FIELD_14, [30] FIELD_15, [33:29] FIELD_10, [28:27] FIELD_21, [25:21] FIELD_13, [24:21] FIELD_16, [21:20] FIELD_18, [22:19] FIELD_22, [19:16] FIELD_2, [17:16] FIELD_4, [18:14] FIELD_5, [10] FIELD_6, [11:10] FIELD_20, [13:10] FIELD_23, [9] FIELD_8, [9:7] FIELD_12, [8:7] FIELD_19, [5] FIELD_7, [8:4] FIELD_9, [5:3] FIELD_3, [5:1] FIELD_1, [5:1] FIELD_17
0x24 REG_9 — Register 9
  [32:28] FIELD_1, [28] FIELD_9, [30:27] FIELD_4, [27:26] FIELD_3, [24:23] FIELD_6, [22] FIELD_11, [24:22] FIELD_12, [12] FIELD_8, [14:10] FIELD_10, [9] FIELD_15, [8:7] FIELD_5, [11:7] FIELD_7, [7:6] FIELD_13, [9:6] FIELD_14, [9:5] FIELD_2
0x28 REG_10 — Register 10
  [12] FIELD_4, [12:10] FIELD_3, [10:7] FIELD_2, [9:5] FIELD_1
0x2C REG_11 — Register 11
  [33:31] FIELD_1, [29] FIELD_18, [28:27] FIELD_10, [29:26] FIELD_9, [30:26] FIELD_19, [26:25] FIELD_2, [26:24] FIELD_17, [23:22] FIELD_3, [22:21] FIELD_8, [23:20] FIELD_7, [22:19] FIELD_12, [15:14] FIELD_13, [13:12] FIELD_6, [10:8] FIELD_16, [9:6] FIELD_5, [9:6] FIELD_14, [7:4] FIELD_20, [5:2] FIELD_4, [4:0] FIELD_11, [3:0] FIELD_15
0x30 REG_12 — Register 12
  [31] FIELD_1, [31:27] FIELD_2, [24] FIELD_9, [23] FIELD_4, [23] FIELD_5, [23] FIELD_8, [6] FIELD_6, [5] FIELD_7, [3:0] FIELD_3
0x34 REG_13 — Register 13
  [32:30] FIELD_12, [30:26] FIELD_2, [27:25] FIELD_7, [23:19] FIELD_6, [18] FIELD_10, [18] FIELD_13, [21:18] FIELD_18, [17] FIELD_1, [17] FIELD_3, [18:14] FIELD_4, [17:14] FIELD_17, [13] FIELD_19, [13] FIELD_21, [8:7] FIELD_20, [8:6] FIELD_11, [9:5] FIELD_16, [2:1] FIELD_8, [2:1] FIELD_9, [2:1] FIELD_15, [0] FIELD_5, [3:0] FIELD_14
0x38 REG_14 — Register 14
  [35:31] FIELD_3, [34:30] FIELD_1, [28:26] FIELD_4, [30:26] FIELD_9, [28:25] FIELD_2, [25] FIELD_11, [27:23] FIELD_6, [18:15] FIELD_5, [18:14] FIELD_8, [13:12] FIELD_10, [8:7] FIELD_7
0x3C REG_15 — Register 15
  [32:28] FIELD_5, [29:27] FIELD_13, [27:25] FIELD_10, [24] FIELD_1, [28:24] FIELD_7, [24:23] FIELD_9, [15:13] FIELD_3, [11:7] FIELD_2, [10:7] FIELD_6, [7:4] FIELD_12, [3] FIELD_4, [6:3] FIELD_8, [4:2] FIELD_11
0x40 REG_16 — Register 16
  [32:31] FIELD_4, [32:30] FIELD_15, [31:30] FIELD_22, [32:29] FIELD_27, [31:28] FIELD_18, [29:26] FIELD_6, [27:26] FIELD_8, [28:25] FIELD_28, [27:24] FIELD_12, [23] FIELD_29, [24:21] FIELD_2, [23:21] FIELD_5, [19] FIELD_3, [16:15] FIELD_9, [15] FIELD_21, [17:13] FIELD_10, [17:13] FIELD_19, [15:12] FIELD_11, [13:12] FIELD_13, [13:12] FIELD_30, [13:11] FIELD_1, [13:11] FIELD_7, [11] FIELD_20, [11] FIELD_23, [12:9] FIELD_26, [9:7] FIELD_16, [5] FIELD_24, [5:4] FIELD_14, [4] FIELD_17, [2:1] FIELD_25
0x44 REG_17 — Register 17
  [31:28] FIELD_15, [29:25] FIELD_7, [25:24] FIELD_17, [26:24] FIELD_23, [27:23] FIELD_6, [22:21] FIELD_8, [21:19] FIELD_1, [19] FIELD_9, [21:18] FIELD_20, [17] FIELD_16, [18:15] FIELD_3, [14] FIELD_12, [15:13] FIELD_22, [15:11] FIELD_21, [14:10] FIELD_2, [14:10] FIELD_13, [13:9] FIELD_10, [11:9] FIELD_19, [9:8] FIELD_14, [8:6] FIELD_4, [9:6] FIELD_24, [7:5] FIELD_5, [7:5] FIELD_18, [4:2] FIELD_11
0x48 REG_18 — Register 18
  [29:27] FIELD_12, [30:26] FIELD_11, [28:26] FIELD_13, [26:25] FIELD_2, [26:23] FIELD_15, [25:22] FIELD_4, [26:22] FIELD_20, [22:20] FIELD_8, [20] FIELD_10, [21:20] FIELD_16, [18] FIELD_3, [16] FIELD_7, [16:13] FIELD_19, [13:12] FIELD_9, [14:12] FIELD_17, [8] FIELD_1, [11:8] FIELD_5, [9:8] FIELD_21, [10:6] FIELD_6, [5:4] FIELD_18, [2:0] FIELD_14
0x4C REG_19 — Register 19
  [33:31] FIELD_2, [35:31] FIELD_7, [30:29] FIELD_8, [29] FIELD_24, [30:28] FIELD_18, [30:27] FIELD_1, [28:27] FIELD_4, [26] FIELD_5, [24] FIELD_9, [28:24] FIELD_21, [23:20] FIELD_23, [19:18] FIELD_17, [19:18] FIELD_19, [19:17] FIELD_10, [19:17] FIELD_12, [19:17] FIELD_15, [19:15] FIELD_11, [15:13] FIELD_20, [17:13] FIELD_22, [14:10] FIELD_3, [8:7] FIELD_14, [4:3] FIELD_13, [3] FIELD_16, [2:1] FIELD_6
0x50 REG_20 — Register 20
  [34:31] FIELD_18, [31:30] FIELD_3, [31:30] FIELD_21, [30] FIELD_26, [28:26] FIELD_7, [28:25] FIELD_8, [29:25] FIELD_12, [28:24] FIELD_28, [22] FIELD_5, [22] FIELD_6, [23:19] FIELD_10, [16:15] FIELD_4, [19:15] FIELD_20, [13] FIELD_24, [16:12] FIELD_14, [13:10] FIELD_19, [10:9] FIELD_2, [12:9] FIELD_13, [8] FIELD_11, [8:6] FIELD_1, [7:5] FIELD_27, [8:4] FIELD_25, [5:3] FIELD_22, [6:2] FIELD_15, [6:2] FIELD_16, [2:1] FIELD_9, [0] FIELD_17, [1:0] FIELD_23
0x54 REG_21 — Register 21
  [34:30] FIELD_9, [32:29] FIELD_7, [32:28] FIELD_14, [31:28] FIELD_23, [28:27] FIELD_8, [27:25] FIELD_20, [22:21] FIELD_12, [25:21] FIELD_18, [19] FIELD_17, [19:15] FIELD_13, [16:15] FIELD_21, [18:14] FIELD_15, [15:13] FIELD_2, [17:13] FIELD_4, [14:12] FIELD_19, [12:11] FIELD_6, [11:10] FIELD_16, [9:8] FIELD_1, [12:8] FIELD_24, [8:6] FIELD_3, [5:1] FIELD_5, [3:1] FIELD_11, [3:1] FIELD_22, [4:0] FIELD_10
0x58 REG_22 — Register 22
  [32:31] FIELD_5, [32:30] FIELD_6, [33:29] FIELD_19, [30:27] FIELD_3, [26:25] FIELD_12, [23] FIELD_9, [27:23] FIELD_13, [21] FIELD_18, [22:18] FIELD_4, [21:18] FIELD_16, [19:17] FIELD_14, [16:13] FIELD_15, [11] FIELD_8, [10:7] FIELD_7, [5] FIELD_11, [4] FIELD_2, [4:0] FIELD_1, [1:0] FIELD_10, [2:0] FIELD_17
0x5C REG_23 — Register 23
  [32:31] FIELD_2, [32:30] FIELD_1, [34:30] FIELD_13, [28:24] FIELD_24, [22] FIELD_6, [26:22] FIELD_7, [26:22] FIELD_20, [21] FIELD_21, [22:18] FIELD_5, [21:18] FIELD_16, [19:17] FIELD_18, [18:16] FIELD_22, [18:16] FIELD_26, [19:15] FIELD_8, [19:15] FIELD_15, [18:14] FIELD_4, [14:12] FIELD_12, [15:12] FIELD_25, [11] FIELD_11, [10] FIELD_19, [11:9] FIELD_9, [8] FIELD_3, [8:6] FIELD_17, [6:5] FIELD_27, [6:4] FIELD_10, [6:2] FIELD_14, [1:0] FIELD_23
0x60 REG_24 — Register 24
  [31] FIELD_3, [32:31] FIELD_12, [34:30] FIELD_18, [29:27] FIELD_8, [28:27] FIELD_9, [30:26] FIELD_16, [28:25] FIELD_11, [23] FIELD_15, [18:15] FIELD_6, [11] FIELD_14, [13:9] FIELD_1, [7:6] FIELD_2, [9:6] FIELD_4, [7:6] FIELD_10, [7:4] FIELD_7, [4:1] FIELD_17, [3:0] FIELD_5, [1:0] FIELD_13
0x64 REG_25 — Register 25
  [28:26] FIELD_2, [17:15] FIELD_6, [16:14] FIELD_5, [9:8] FIELD_1, [2] FIELD_3, [4:1] FIELD_4
0x68 REG_26 — Register 26
  [32:28] FIELD_1, [31:27] FIELD_4, [28:24] FIELD_7, [18:16] FIELD_3, [12:11] FIELD_6, [4:2] FIELD_2, [0] FIELD_5
0x6C REG_27 — Register 27
  [29:28] FIELD_3, [24] FIELD_6, [14] FIELD_5, [13:9] FIELD_1, [9:8] FIELD_7, [7:4] FIELD_4, [4:0] FIELD_2
0x70 REG_28 — Register 28
  [34:30] FIELD_6, [30] FIELD_24, [30:29] FIELD_20, [29:28] FIELD_2, [30:28] FIELD_8, [31:28] FIELD_28, [29:26] FIELD_1, [29:26] FIELD_16, [28:25] FIELD_17, [24:23] FIELD_23, [24:22] FIELD_18, [24:21] FIELD_27, [22:20] FIELD_7, [23:19] FIELD_19, [18] FIELD_4, [21:18] FIELD_13, [16] FIELD_9, [17:16] FIELD_14, [18:16] FIELD_22, [16:15] FIELD_5, [17:14] FIELD_15, [8] FIELD_26, [7] FIELD_11, [3] FIELD_3, [4:3] FIELD_10, [4:3] FIELD_21, [6:3] FIELD_25, [3:0] FIELD_12
0x74 REG_29 — Register 29
  [29:28] FIELD_4, [26:25] FIELD_2, [22:21] FIELD_5, [21:18] FIELD_1, [12:10] FIELD_3
0x78 REG_30 — Register 30
  [31:29] FIELD_7, [32:29] FIELD_9, [29:27] FIELD_16, [25:22] FIELD_1, [25:21] FIELD_15, [20] FIELD_5, [18:15] FIELD_18, [16:14] FIELD_13, [17:13] FIELD_8, [16:13] FIELD_20, [14:11] FIELD_4, [12:8] FIELD_3, [11:8] FIELD_12, [11:7] FIELD_11, [9:6] FIELD_19, [6:4] FIELD_2, [5:3] FIELD_14, [3:2] FIELD_6, [6:2] FIELD_10, [3:2] FIELD_17, [5:2] FIELD_21
0x7C REG_31 — Register 31
  [29:25] FIELD_7, [21] FIELD_9, [15] FIELD_8, [13:12] FIELD_3, [12] FIELD_10, [13:10] FIELD_1, [6:4] FIELD_6, [4:3] FIELD_4, [3] FIELD_5, [2:0] FIELD_2
0x80 REG_32 — Register 32
  [31] FIELD_8, [33:30] FIELD_1, [28] FIELD_11, [27:25] FIELD_14, [26:24] FIELD_13, [21:18] FIELD_7, [19:18] FIELD_12, [20:16] FIELD_4, [16:15] FIELD_3, [15:14] FIELD_2, [14:12] FIELD_10, [8:6] FIELD_6, [5:3] FIELD_5, [5:2] FIELD_9
0x84 REG_33 — Register 33
  [34:31] FIELD_15, [33:30] FIELD_20, [31:27] FIELD_6, [28:24] FIELD_7, [22] FIELD_1, [23:20] FIELD_2, [19:18] FIELD_8, [16:15] FIELD_18, [13:11] FIELD_10, [10] FIELD_9, [10] FIELD_11, [13:10] FIELD_17, [13:9] FIELD_13, [8:7] FIELD_16, [10:6] FIELD_19, [6:5] FIELD_5, [5:2] FIELD_14, [2:0] FIELD_3, [1:0] FIELD_4, [4:0] FIELD_12
0x88 REG_34 — Register 34
  [30] FIELD_20, [32:29] FIELD_11, [28:27] FIELD_1, [31:27] FIELD_6, [30:27] FIELD_18, [26:25] FIELD_2, [25] FIELD_8, [24:22] FIELD_13, [22:20] FIELD_7, [17:16] FIELD_5, [18:15] FIELD_17, [17:14] FIELD_12, [13:10] FIELD_14, [10:7] FIELD_3, [7:5] FIELD_21, [8:5] FIELD_23, [7:4] FIELD_9, [6:4] FIELD_10, [5:4] FIELD_19, [3] FIELD_15, [2] FIELD_16, [3:1] FIELD_4, [2:0] FIELD_22
0x8C REG_35 — Register 35
  [34:30] FIELD_4, [28] FIELD_7, [29:28] FIELD_13, [28:27] FIELD_9, [26] FIELD_3, [29:26] FIELD_5, [24] FIELD_12, [20:18] FIELD_11, [16:15] FIELD_1, [16:13] FIELD_15, [15:11] FIELD_2, [15:11] FIELD_10, [14:11] FIELD_14, [7:4] FIELD_8, [3:2] FIELD_6
0x90 REG_36 — Register 36
  [35:31] FIELD_27, [30:29] FIELD_2, [32:28] FIELD_8, [32:28] FIELD_13, [31:28] FIELD_25, [29:27] FIELD_3, [23] FIELD_19, [24:22] FIELD_31, [18] FIELD_28, [19:17] FIELD_18, [19:15] FIELD_1, [17:14] FIELD_16, [17:14] FIELD_17, [16:14] FIELD_26, [10] FIELD_9, [13:10] FIELD_24, [13:9] FIELD_6, [9:8] FIELD_11, [10:7] FIELD_5, [7:5] FIELD_29, [4] FIELD_20, [6:3] FIELD_15, [6:3] FIELD_22, [7:3] FIELD_30, [6:2] FIELD_7, [6:2] FIELD_10, [4:1] FIELD_12, [3:1] FIELD_21, [2:1] FIELD_23, [4:0] FIELD_4, [3:0] FIELD_14
0x94 REG_37 — Register 37
  [35:31] FIELD_7, [34:30] FIELD_3, [31:30] FIELD_12, [30:29] FIELD_2, [33:29] FIELD_6, [30:28] FIELD_15, [25:24] FIELD_13, [10] FIELD_8, [13:10] FIELD_10, [7] FIELD_4, [3] FIELD_1, [5:3] FIELD_5, [1] FIELD_11, [0] FIELD_9, [3:0] FIELD_14
0x98 REG_38 — Register 38
  [31] FIELD_22, [33:30] FIELD_5, [31:30] FIELD_24, [29] FIELD_17, [30:29] FIELD_25, [30:28] FIELD_6, [23] FIELD_18, [24:22] FIELD_1, [25:22] FIELD_9, [26:22] FIELD_15, [24:20] FIELD_23, [22:20] FIELD_26, [18:17] FIELD_13, [20:17] FIELD_21, [19:15] FIELD_4, [16:15] FIELD_7, [15:14] FIELD_12, [16:13] FIELD_27, [15:12] FIELD_3, [10] FIELD_16, [7:6] FIELD_10, [9:6] FIELD_11, [9:5] FIELD_8, [7:3] FIELD_19, [7:3] FIELD_20, [2:1] FIELD_2, [2:0] FIELD_14
0x9C REG_39 — Register 39
  [35:31] FIELD_7, [32:31] FIELD_11, [34:31] FIELD_15, [32:30] FIELD_1, [29:28] FIELD_5, [29:28] FIELD_17, [29:26] FIELD_12, [27:26] FIELD_20, [27:25] FIELD_8, [23:20] FIELD_3, [17:15] FIELD_14, [17:14] FIELD_4, [15:14] FIELD_16, [13:12] FIELD_9, [12] FIELD_13, [15:11] FIELD_18, [7] FIELD_19, [9:5] FIELD_2, [4:3] FIELD_21, [0] FIELD_6, [4:0] FIELD_10
0xA0 REG_40 — Register 40
  [32:30] FIELD_18, [34:30] FIELD_20, [28] FIELD_9, [31:28] FIELD_22, [27:26] FIELD_25, [29:25] FIELD_3, [24] FIELD_15, [22] FIELD_7, [24:22] FIELD_19, [24:21] FIELD_1, [23:21] FIELD_5, [23:21] FIELD_23, [23:20] FIELD_14, [21:20] FIELD_27, [22:19] FIELD_17, [15:14] FIELD_6, [14] FIELD_8, [18:14] FIELD_12, [18:14] FIELD_26, [17:13] FIELD_2, [15:13] FIELD_16, [14:11] FIELD_10, [11:10] FIELD_11, [9:8] FIELD_13, [8:6] FIELD_4, [3:2] FIELD_21, [2:0] FIELD_24
0xA4 REG_41 — Register 41
  [31] FIELD_21, [28:27] FIELD_5, [28:27] FIELD_11, [29:27] FIELD_16, [30:26] FIELD_9, [26:25] FIELD_17, [26:22] FIELD_7, [21:17] FIELD_1, [20:16] FIELD_4, [17:15] FIELD_2, [17:14] FIELD_10, [11:10] FIELD_12, [13:10] FIELD_18, [10:9] FIELD_19, [13:9] FIELD_20, [10:7] FIELD_8, [9:7] FIELD_14, [8:6] FIELD_13, [5] FIELD_6, [8:4] FIELD_3, [6:2] FIELD_15
0xA8 REG_42 — Register 42
  [33:31] FIELD_2, [32:29] FIELD_1, [11:7] FIELD_3
0xAC REG_43 — Register 43
  [28] FIELD_9, [26:24] FIELD_3, [24:23] FIELD_5, [22:18] FIELD_4, [18:14] FIELD_6, [10:7] FIELD_2, [7:5] FIELD_7, [5:4] FIELD_8, [3:1] FIELD_1
0xB0 REG_44 — Register 44
  [33:31] FIELD_4, [34:30] FIELD_3, [33:29] FIELD_12, [32:28] FIELD_5, [31:27] FIELD_11, [26] FIELD_7, [25] FIELD_6, [26:23] FIELD_2, [23:21] FIELD_17, [23:20] FIELD_20, [21:20] FIELD_22, [20:18] FIELD_21, [16] FIELD_1, [17:15] FIELD_8, [16:14] FIELD_16, [13:12] FIELD_15, [13:11] FIELD_10, [11:10] FIELD_14, [10:6] FIELD_18, [6:5] FIELD_13, [6:4] FIELD_9, [4:2] FIELD_19
0xB4 REG_45 — Register 45
  [31] FIELD_3, [31:28] FIELD_7, [26:23] FIELD_2, [22:20] FIELD_5, [20:19] FIELD_1, [19:15] FIELD_8, [7:6] FIELD_6, [7:3] FIELD_4
0xB8 REG_46 — Register 46
  [32:31] FIELD_11, [33:31] FIELD_17, [32:29] FIELD_1, [29] FIELD_18, [29:26] FIELD_9, [28:26] FIELD_16, [28:25] FIELD_3, [24] FIELD_8, [24:23] FIELD_14, [22:21] FIELD_6, [24:21] FIELD_24, [20:16] FIELD_7, [15] FIELD_15, [16:14] FIELD_2, [15:11] FIELD_13, [14:11] FIELD_23, [13:10] FIELD_19, [11:9] FIELD_5, [11:7] FIELD_4, [10:6] FIELD_20, [4] FIELD_10, [3:2] FIELD_22, [3:1] FIELD_12, [2:0] FIELD_21
0xBC REG_47 — Register 47
  [31] FIELD_13, [31:30] FIELD_5, [34:30] FIELD_12, [29:27] FIELD_4, [26:22] FIELD_7, [25:22] FIELD_18, [19:18] FIELD_10, [19:17] FIELD_9, [19:16] FIELD_1, [16] FIELD_2, [19:16] FIELD_3, [15] FIELD_14, [16:14] FIELD_8, [17:14] FIELD_17, [7] FIELD_6, [8:7] FIELD_11, [5:1] FIELD_16, [3:0] FIELD_15
0xC0 REG_48 — Register 48
  [30:29] FIELD_6, [31:27] FIELD_5, [24:23] FIELD_1, [22] FIELD_2, [19:18] FIELD_3, [13] FIELD_4, [13:11] FIELD_7
0xC4 REG_49 — Register 49
  [30] FIELD_11, [33:29] FIELD_4, [29] FIELD_12, [26] FIELD_2, [29:26] FIELD_3, [16:14] FIELD_5, [16:13] FIELD_9, [14:12] FIELD_10, [13:10] FIELD_1, [8:5] FIELD_7, [6:3] FIELD_8, [6:2] FIELD_13, [5:2] FIELD_14, [1:0] FIELD_6
