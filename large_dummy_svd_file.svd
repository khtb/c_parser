# LargeDummyDevice register map
File version: 1.0
Registers are 32-bit, read-write, no defined reset value unless marked. A register's access mark holds for its fields unless they carry their own. Offsets are from the block's base; [hi:lo] are bit positions.

## PERIPHERAL_65
Base 0x40040000
0x04 REG_1 — Register 1
  [31:30] FIELD_1, [31:30] FIELD_4, [31:30] FIELD_7, [25] FIELD_11, [20] FIELD_15, [20] FIELD_17, [21:19] FIELD_16, [18:17] FIELD_8, [21:17] FIELD_10, [18:17] FIELD_12, [15] FIELD_5, [19:15] FIELD_14, [13:12] FIELD_18, [13:10] FIELD_9, [12:8] FIELD_3, [7] FIELD_2, [3:2] FIELD_6, [6:2] FIELD_13
0x08 REG_2 — Register 2
  [30] FIELD_2, [34:30] FIELD_18, [30] FIELD_23, [31:28] FIELD_24, [31:28] FIELD_29, [29:26] FIELD_1, [27:23] FIELD_25, [25:22] FIELD_6, [23:22] FIELD_10, [24:22] FIELD_32, [20] FIELD_9, [22:19] FIELD_8, [19] FIELD_12, [21:17] FIELD_11, [20:16] FIELD_4, [15:13] FIELD_16, [13] FIELD_27, [15:13] FIELD_30, [14:12] FIELD_15, [10] FIELD_14, [11:9] FIELD_31, [9:8] FIELD_5, [9:8] FIELD_26, [10:7] FIELD_7, [11:7] FIELD_13, [10:7] FIELD_22, [10:6] FIELD_3, [9:6] FIELD_17, [8:5] FIELD_20, [6:4] FIELD_28, [0] FIELD_19, [4:0] FIELD_21
0x0C REG_3 — Register 3
  [34:30] FIELD_7, [27] FIELD_3, [29:27] FIELD_8, [30:26] FIELD_4, [29:25] FIELD_1, [27:23] FIELD_2, [23:20] FIELD_5, [16:14] FIELD_9, [14:11] FIELD_6
0x10 REG_4 — Register 4
  [33:30] FIELD_18, [30:27] FIELD_6, [30:27] FIELD_19, [25] FIELD_12, [26:24] FIELD_8, [24] FIELD_10, [24:23] FIELD_5, [24:23] FIELD_21, [19] FIELD_4, [22:19] FIELD_22, [17] FIELD_7, [17] FIELD_9, [14:13] FIELD_17, [15:12] FIELD_1, [7] FIELD_3, [6] FIELD_14, [9:6] FIELD_16, [6:4] FIELD_15, [6:2] FIELD_13, [1] FIELD_2, [3:1] FIELD_11, [4:0] FIELD_20
0x14 REG_5 — Register 5
  [35:31] FIELD_6, [32:30] FIELD_8, [32:29] FIELD_11, [30:29] FIELD_15, [32:28] FIELD_21, [29:27] FIELD_2, [30:27] FIELD_24, [25:23] FIELD_10, [20:19] FIELD_17, [19:18] FIELD_18, [18:17] FIELD_22, [16:15] FIELD_5, [15] FIELD_16, [16:13] FIELD_20, [11] FIELD_13, [9] FIELD_23, [7:6] FIELD_4, [9:5] FIELD_3, [5] FIELD_7, [7:5] FIELD_9, [7:3] FIELD_14, [6:2] FIELD_12, [4:2] FIELD_19, [1:0] FIELD_1
0x18 REG_6 — Register 6
  [32:30] FIELD_13, [31:29] FIELD_25, [28:27] FIELD_9, [28:27] FIELD_24, [27:26] FIELD_11, [27:25] FIELD_14, [24:21] FIELD_20, [23:20] FIELD_6, [24:20] FIELD_7, [21:18] FIELD_16, [19:17] FIELD_17, [19:16] FIELD_4, [20:16] FIELD_23, [18:15] FIELD_1, [16:15] FIELD_22, [18:14] FIELD_2, [14] FIELD_8, [13] FIELD_10, [16:13] FIELD_12, [15:12] FIELD_15, [12:9] FIELD_5, [9] FIELD_18, [11:7] FIELD_21, [5] FIELD_3, [6:3] FIELD_19
0x1C REG_7 — Register 7
  [33:31] FIELD_5, [34:30] FIELD_17, [29] FIELD_2, [31:28] FIELD_13, [28:27] FIELD_18, [27] FIELD_19, [24:21] FIELD_6, [21:20] FIELD_9, [21:20] FIELD_10, [22:19] FIELD_15, [17] FIELD_21, [17:16] FIELD_12, [15:12] FIELD_11, [13:12] FIELD_16, [11] FIELD_3, [10:9] FIELD_1, [7:5] FIELD_20, [8:4] FIELD_8, [4:3] FIELD_4, [4:1] FIELD_14, [1:0] FIELD_7
0x20 REG_8 — Register 8
  [31] FIELD_12, [29] FIELD_22, [31:29] FIELD_23, [28:26] FIELD_18, [26:25] FIELD_20, [23] FIELD_5, [24:23] FIELD_24, [25:22] FIELD_1, [25:22] FIELD_6, [21:20] FIELD_4, [19] FIELD_16, [21:18] FIELD_21, [17] FIELD_17, [14:13] FIELD_8, [13:12] FIELD_15, [13:12] FIELD_26, [11] FIELD_11, [10:9] FIELD_27, [9:8] FIELD_2, [12:8] FIELD_9, [9:8] FIELD_10, [8] FIELD_25, [11:7] FIELD_3, [10:7] FIELD_13, [6:4] FIELD_7, [8:4] FIELD_14, [4:2] FIELD_19
0x24 REG_9 — Register 9
  [29:28] FIELD_4, [26:24] FIELD_6, [23] FIELD_1, [21:19] FIELD_5, [20:19] FIELD_10, [16:13] FIELD_7, [11] FIELD_2, [9:8] FIELD_3, [8] FIELD_11, [11:7] FIELD_8, [8:5] FIELD_9
0x28 REG_10 — Register 10
  [31:30] FIELD_1, [32:30] FIELD_15, [30:26] FIELD_11, [26:25] FIELD_2, [28:25] FIELD_12, [27:23] FIELD_9, [24:22] FIELD_3, [16] FIELD_7, [17:14] FIELD_4, [18:14] FIELD_6, [8:4] FIELD_10, [2] FIELD_13, [4:2] FIELD_14, [1] FIELD_5, [0] FIELD_8
0x2C REG_11 — Register 11
  [31] FIELD_6, [34:31] FIELD_30, [34:30] FIELD_14, [30:29] FIELD_5, [30:29] FIELD_8, [31:28] FIELD_16, [32:28] FIELD_20, [30:26] FIELD_29, [28:25] FIELD_22, [25:23] FIELD_11, [23:22] FIELD_13, [25:21] FIELD_15, [20:19] FIELD_19, [22:18] FIELD_18, [19:18] FIELD_25, [18:15] FIELD_12, [17:15] FIELD_21, [15:11] FIELD_3, [13:11] FIELD_17, [13:11] FIELD_26, [10] FIELD_23, [10:7] FIELD_27, [7] FIELD_28, [8:6] FIELD_24, [5:4] FIELD_10, [3] FIELD_4, [4:0] FIELD_1, [0] FIELD_2, [0] FIELD_7, [2:0] FIELD_9
0x30 REG_12 — Register 12
  [31] FIELD_2, [35:31] FIELD_9, [32:31] FIELD_12, [31:30] FIELD_1, [30:27] FIELD_10, [24] FIELD_8, [24:21] FIELD_6, [19:18] FIELD_4, [14:11] FIELD_7, [11:9] FIELD_3, [6:3] FIELD_11, [2:1] FIELD_5
