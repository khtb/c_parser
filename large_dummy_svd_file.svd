# LargeDummyDevice register map
File version: 1.0
Registers are 32-bit, read-write, no defined reset value unless marked. A register's access mark holds for its fields unless they carry their own. Offsets are from the block's base; [hi:lo] are bit positions.

## PERIPHERAL_86
Base 0x40055000
0x04 REG_1 — Register 1
  [31] FIELD_21, [26] FIELD_28, [26:22] FIELD_19, [23:21] FIELD_5, [20] FIELD_32, [20:19] FIELD_8, [15] FIELD_11, [18:14] FIELD_20, [14:12] FIELD_13, [13:11] FIELD_17, [12:11] FIELD_18, [11:10] FIELD_10, [10] FIELD_26, [10] FIELD_27, [10] FIELD_29, [10:8] FIELD_2, [8] FIELD_4, [9:8] FIELD_30, [9:7] FIELD_12, [6] FIELD_1, [9:6] FIELD_23, [10:6] FIELD_25, [6:5] FIELD_3, [5:4] FIELD_9, [7:4] FIELD_22, [3] FIELD_15, [4:3] FIELD_31, [6:2] FIELD_6, [6:2] FIELD_14, [5:1] FIELD_7, [3:1] FIELD_24, [1:0] FIELD_16
0x08 REG_2 — Register 2
  [32:30] FIELD_9, [33:29] FIELD_1, [28:27] FIELD_6, [28:25] FIELD_2, [23:20] FIELD_7, [22:19] FIELD_14, [18] FIELD_5, [21:17] FIELD_13, [20:16] FIELD_4, [19:16] FIELD_16, [19:15] FIELD_18, [14:11] FIELD_17, [10] FIELD_8, [9] FIELD_15, [6:4] FIELD_11, [7:3] FIELD_10, [3:1] FIELD_3, [4:1] FIELD_12
0x0C REG_3 — Register 3
  [29:28] FIELD_5, [28] FIELD_13, [32:28] FIELD_14, [32:28] FIELD_18, [28] FIELD_25, [26:24] FIELD_9, [25:24] FIELD_11, [21] FIELD_23, [20:19] FIELD_7, [20:19] FIELD_21, [19:18] FIELD_15, [19:18] FIELD_19, [18] FIELD_22, [19:18] FIELD_24, [19:17] FIELD_6, [17:16] FIELD_16, [18:14] FIELD_28, [17:13] FIELD_12, [11] FIELD_29, [13:10] FIELD_4, [14:10] FIELD_20, [12:9] FIELD_8, [6:4] FIELD_10, [6:3] FIELD_3, [6:2] FIELD_26, [4:1] FIELD_2, [2:1] FIELD_17, [1:0] FIELD_1, [4:0] FIELD_27
0x10 REG_4 — Register 4
  [24:20] FIELD_2, [17:15] FIELD_4, [7:3] FIELD_1, [3] FIELD_5, [4:2] FIELD_3
0x14 REG_5 — Register 5
  [34:31] FIELD_3, [35:31] FIELD_4, [30:29] FIELD_15, [27:25] FIELD_1, [28:25] FIELD_8, [26:23] FIELD_5, [24:22] FIELD_2, [22:20] FIELD_16, [20:19] FIELD_11, [20:18] FIELD_12, [20:17] FIELD_13, [10:9] FIELD_9, [11:8] FIELD_7, [10:7] FIELD_14, [6] FIELD_6, [6:3] FIELD_10
0x18 REG_6 — Register 6
  [32:31] FIELD_13, [32:31] FIELD_21, [29] FIELD_15, [31:29] FIELD_25, [29:27] FIELD_3, [30:27] FIELD_10, [31:27] FIELD_14, [29:26] FIELD_7, [29:26] FIELD_9, [30:26] FIELD_11, [30:26] FIELD_12, [27:26] FIELD_16, [29:25] FIELD_6, [28:24] FIELD_17, [23] FIELD_4, [26:22] FIELD_26, [24:22] FIELD_27, [25:21] FIELD_20, [21] FIELD_23, [21:17] FIELD_24, [18:16] FIELD_1, [18:16] FIELD_5, [16:15] FIELD_18, [14] FIELD_22, [10:8] FIELD_8, [6] FIELD_19, [4:2] FIELD_2, [5:2] FIELD_28
0x1C REG_7 — Register 7
  [30:29] FIELD_5, [27] FIELD_3, [27:23] FIELD_2, [18:15] FIELD_4, [12:11] FIELD_1
0x20 REG_8 — Register 8
  [27] FIELD_10, [25:24] FIELD_7, [17] FIELD_4, [16:12] FIELD_8, [12:10] FIELD_2, [9:7] FIELD_9, [10:6] FIELD_5, [9:5] FIELD_11, [5:4] FIELD_3, [8:4] FIELD_6, [2] FIELD_1, [4:0] FIELD_12
0x24 REG_9 — Register 9
  [34:31] FIELD_8, [33:31] FIELD_10, [33:30] FIELD_15, [29] FIELD_13, [33:29] FIELD_28, [28] FIELD_12, [28:27] FIELD_1, [27] FIELD_21, [30:27] FIELD_25, [27:26] FIELD_3, [30:26] FIELD_14, [25] FIELD_2, [23] FIELD_9, [27:23] FIELD_27, [25:22] FIELD_7, [24:22] FIELD_23, [23:21] FIELD_4, [22:20] FIELD_24, [20:19] FIELD_6, [17] FIELD_11, [19:16] FIELD_16, [16] FIELD_22, [16:14] FIELD_19, [13] FIELD_17, [9:8] FIELD_5, [10:8] FIELD_20, [7:6] FIELD_18, [5:3] FIELD_26
0x28 REG_10 — Register 10
  [35:31] FIELD_8, [35:31] FIELD_14, [32:30] FIELD_13, [29:27] FIELD_4, [26] FIELD_7, [28:25] FIELD_9, [24:22] FIELD_2, [23:22] FIELD_15, [20:19] FIELD_1, [21:18] FIELD_12, [15] FIELD_10, [12] FIELD_6, [12:11] FIELD_5, [13:9] FIELD_11, [9:7] FIELD_3
0x2C REG_11 — Register 11
  [31:29] FIELD_1, [29:28] FIELD_17, [30:27] FIELD_10, [31:27] FIELD_14, [24] FIELD_11, [25:21] FIELD_19, [23:21] FIELD_20, [20:19] FIELD_26, [20:19] FIELD_27, [19:18] FIELD_3, [18] FIELD_6, [17:16] FIELD_15, [17:15] FIELD_24, [12] FIELD_12, [14:12] FIELD_13, [16:12] FIELD_28, [14:11] FIELD_22, [11:10] FIELD_9, [11:9] FIELD_5, [10:9] FIELD_16, [12:9] FIELD_25, [9] FIELD_29, [9:8] FIELD_31, [10:7] FIELD_30, [10:6] FIELD_7, [6:4] FIELD_18, [7:3] FIELD_21, [5:2] FIELD_4, [4:2] FIELD_8, [4:1] FIELD_2, [4:0] FIELD_23
0x30 REG_12 — Register 12
  [31] FIELD_6, [35:31] FIELD_30, [32:30] FIELD_4, [33:30] FIELD_24, [29:27] FIELD_18, [31:27] FIELD_19, [28:27] FIELD_26, [31:27] FIELD_27, [24:23] FIELD_10, [22] FIELD_5, [22] FIELD_8, [25:22] FIELD_29, [22:20] FIELD_12, [23:19] FIELD_22, [18] FIELD_2, [22:18] FIELD_15, [22:18] FIELD_31, [21:17] FIELD_32, [19:16] FIELD_28, [19:15] FIELD_1, [18:15] FIELD_9, [15:14] FIELD_11, [14:12] FIELD_16, [12] FIELD_23, [10] FIELD_3, [9] FIELD_20, [8:7] FIELD_13, [4:3] FIELD_14, [5:3] FIELD_25, [4:2] FIELD_7, [5:2] FIELD_21, [4:0] FIELD_17
0x34 REG_13 — Register 13
  [32:28] FIELD_4, [24:23] FIELD_1, [20:19] FIELD_5, [21:18] FIELD_2, [16:15] FIELD_3, [16:12] FIELD_7, [13:11] FIELD_6
0x38 REG_14 — Register 14
  [32:28] FIELD_1, [29:28] FIELD_3, [26:24] FIELD_4, [25:23] FIELD_5, [24:21] FIELD_9, [20:18] FIELD_2, [21:18] FIELD_10, [6] FIELD_7, [6:4] FIELD_8, [1] FIELD_11, [3:0] FIELD_6
0x3C REG_15 — Register 15
  [31] FIELD_1
0x40 REG_16 — Register 16
  [30:28] FIELD_6, [30:28] FIELD_11, [26] FIELD_7, [23:20] FIELD_3, [23:20] FIELD_12, [21:18] FIELD_5, [17:16] FIELD_2, [11] FIELD_10, [8] FIELD_9, [9:5] FIELD_8, [4:1] FIELD_1, [5:1] FIELD_4
0x44 REG_17 — Register 17
  [31:27] FIELD_3, [22:18] FIELD_4, [18:15] FIELD_1, [14:12] FIELD_2
0x48 REG_18 — Register 18
  [35:31] FIELD_3, [35:31] FIELD_14, [29] FIELD_9, [32:29] FIELD_12, [30:28] FIELD_5, [25:23] FIELD_2, [23:22] FIELD_6, [21:20] FIELD_15, [19] FIELD_13, [18] FIELD_8, [19:18] FIELD_10, [16:13] FIELD_7, [10:7] FIELD_11, [8:5] FIELD_4, [4:3] FIELD_1
0x4C REG_19 — Register 19
  [35:31] FIELD_17, [32:29] FIELD_1, [32:28] FIELD_8, [30:28] FIELD_10, [31:27] FIELD_6, [26] FIELD_11, [26:24] FIELD_2, [26:24] FIELD_19, [21:20] FIELD_7, [23:19] FIELD_16, [20:18] FIELD_3, [19:15] FIELD_9, [16:14] FIELD_5, [16:14] FIELD_14, [16:13] FIELD_4, [11:10] FIELD_13, [11:7] FIELD_12, [4] FIELD_18, [3:0] FIELD_15
0x50 REG_20 — Register 20
  [34:31] FIELD_14, [31:30] FIELD_10, [28] FIELD_6, [30:27] FIELD_5, [27:26] FIELD_3, [28:26] FIELD_16, [29:25] FIELD_1, [26:25] FIELD_18, [22:21] FIELD_15, [22:18] FIELD_7, [20:17] FIELD_2, [19:16] FIELD_4, [16:15] FIELD_9, [17:15] FIELD_12, [15] FIELD_13, [15:14] FIELD_8, [14:12] FIELD_11, [7:5] FIELD_17
0x54 REG_21 — Register 21
  [31] FIELD_9, [34:31] FIELD_25, [30] FIELD_23, [33:30] FIELD_26, [31:28] FIELD_5, [30:28] FIELD_28, [29:27] FIELD_4, [27] FIELD_16, [26] FIELD_7, [26] FIELD_14, [27:26] FIELD_22, [27:26] FIELD_30, [26:25] FIELD_12, [28:25] FIELD_24, [24] FIELD_20, [26:23] FIELD_10, [24:20] FIELD_27, [19:18] FIELD_15, [16] FIELD_11, [19:16] FIELD_29, [16:13] FIELD_1, [13:10] FIELD_3, [12:9] FIELD_19, [12:8] FIELD_21, [8:7] FIELD_17, [4:3] FIELD_8, [5:2] FIELD_6, [1] FIELD_2, [3:1] FIELD_18, [0] FIELD_13
0x58 REG_22 — Register 22
  [26:22] FIELD_1, [21:20] FIELD_5, [18:17] FIELD_6, [16:12] FIELD_7, [15:12] FIELD_8, [8] FIELD_9, [10:6] FIELD_4, [5:2] FIELD_2, [4:1] FIELD_3
0x5C REG_23 — Register 23
  [28:25] FIELD_3, [25:24] FIELD_4, [22:21] FIELD_5, [13:12] FIELD_2, [14:11] FIELD_7, [13:10] FIELD_6, [5] FIELD_8, [4:1] FIELD_1
0x60 REG_24 — Register 24
  [30:29] FIELD_10, [30:28] FIELD_2, [25:21] FIELD_11, [24:20] FIELD_4, [20] FIELD_8, [20:19] FIELD_13, [20:19] FIELD_16, [18:16] FIELD_17, [18:15] FIELD_9, [12] FIELD_1, [16:12] FIELD_14, [10] FIELD_6, [10:9] FIELD_5, [8] FIELD_18, [7] FIELD_20, [5:4] FIELD_12, [8:4] FIELD_19, [7:4] FIELD_22, [4:2] FIELD_3, [5:2] FIELD_15, [2:1] FIELD_7, [1:0] FIELD_21
0x64 REG_25 — Register 25
  [32:31] FIELD_15, [33:30] FIELD_10, [29] FIELD_4, [32:29] FIELD_7, [30:26] FIELD_5, [25:24] FIELD_3, [27:23] FIELD_13, [24:22] FIELD_26, [24:20] FIELD_17, [20:19] FIELD_1, [19:18] FIELD_9, [18:17] FIELD_24, [19:16] FIELD_27, [15] FIELD_11, [14] FIELD_22, [13] FIELD_8, [11] FIELD_12, [11] FIELD_19, [13:10] FIELD_6, [11:10] FIELD_14, [11:9] FIELD_23, [13:9] FIELD_25, [12:8] FIELD_21, [9:7] FIELD_18, [11:7] FIELD_20, [8:6] FIELD_2, [4:2] FIELD_16
