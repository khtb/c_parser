# LargeDummyDevice register map
File version: 1.0
Registers are 32-bit, read-write, no defined reset value unless marked. A register's access mark holds for its fields unless they carry their own. Offsets are from the block's base; [hi:lo] are bit positions.

## PERIPHERAL_95
Base 0x4005E000
0x04 REG_1 — Register 1
  [34:30] FIELD_3, [33:30] FIELD_11, [30:28] FIELD_1, [27:26] FIELD_9, [26] FIELD_15, [27:25] FIELD_12, [24:23] FIELD_13, [27:23] FIELD_16, [23:22] FIELD_21, [25:21] FIELD_2, [22:21] FIELD_14, [22:18] FIELD_17, [19:18] FIELD_19, [19:17] FIELD_22, [16:13] FIELD_6, [16:12] FIELD_5, [15:12] FIELD_8, [12:11] FIELD_4, [12:11] FIELD_10, [12:10] FIELD_7, [11:9] FIELD_20, [6:5] FIELD_18
0x08 REG_2 — Register 2
  [30] FIELD_10, [31:28] FIELD_7, [25] FIELD_11, [22:21] FIELD_1, [19:18] FIELD_6, [20:17] FIELD_9, [16:15] FIELD_13, [14:10] FIELD_3, [5] FIELD_4, [3] FIELD_5, [3:2] FIELD_2, [3:1] FIELD_12, [2:0] FIELD_8
0x0C REG_3 — Register 3
  [30] FIELD_3, [24:23] FIELD_8, [18:17] FIELD_1, [16] FIELD_4, [16:15] FIELD_5, [17:14] FIELD_6, [15:12] FIELD_9, [10:9] FIELD_2, [8:5] FIELD_7
0x10 REG_4 — Register 4
  [35:31] FIELD_21, [31:30] FIELD_9, [34:30] FIELD_16, [31:28] FIELD_15, [26] FIELD_14, [27:24] FIELD_2, [25:23] FIELD_12, [24:23] FIELD_19, [22] FIELD_11, [22:21] FIELD_3, [19] FIELD_4, [20:18] FIELD_10, [20:17] FIELD_18, [19:15] FIELD_22, [16:14] FIELD_7, [11] FIELD_1, [8:7] FIELD_13, [11:7] FIELD_17, [6:4] FIELD_8, [5:1] FIELD_5, [5:1] FIELD_20, [3:0] FIELD_6
0x14 REG_5 — Register 5
  [31:30] FIELD_2, [30:29] FIELD_8, [17:14] FIELD_7, [12:11] FIELD_10, [9] FIELD_9, [11:7] FIELD_1, [8:7] FIELD_4, [7:5] FIELD_5, [1] FIELD_3, [0] FIELD_6
0x18 REG_6 — Register 6
  [35:31] FIELD_5, [28] FIELD_3, [27:26] FIELD_12, [22] FIELD_4, [20:18] FIELD_14, [20:16] FIELD_13, [18:14] FIELD_9, [12] FIELD_11, [13:11] FIELD_10, [13:10] FIELD_6, [10:9] FIELD_1, [10:8] FIELD_15, [6:4] FIELD_2, [4:1] FIELD_17, [3:0] FIELD_7, [1:0] FIELD_8, [0] FIELD_16
0x1C REG_7 — Register 7
  [34:31] FIELD_11, [34:31] FIELD_20, [32:30] FIELD_4, [28:26] FIELD_2, [26:25] FIELD_14, [25:24] FIELD_15, [28:24] FIELD_26, [23:20] FIELD_5, [23:20] FIELD_9, [22:20] FIELD_25, [24:20] FIELD_30, [19:18] FIELD_7, [19:18] FIELD_31, [17] FIELD_17, [16:14] FIELD_21, [15:12] FIELD_1, [15:11] FIELD_16, [14:10] FIELD_23, [10:9] FIELD_12, [11:9] FIELD_22, [12:8] FIELD_29, [10:7] FIELD_8, [11:7] FIELD_10, [7] FIELD_19, [8:7] FIELD_27, [7:5] FIELD_13, [5] FIELD_28, [4:3] FIELD_6, [5:3] FIELD_24, [5:2] FIELD_32, [4:1] FIELD_3, [4:0] FIELD_18
0x20 REG_8 — Register 8
  [31:29] FIELD_7, [29:27] FIELD_2, [26:25] FIELD_9, [24:22] FIELD_5, [16:15] FIELD_1, [18:15] FIELD_3, [11:9] FIELD_4, [12:8] FIELD_6, [10:7] FIELD_8, [9:7] FIELD_10
0x24 REG_9 — Register 9
  [24:23] FIELD_3, [10:9] FIELD_1, [13:9] FIELD_2
0x28 REG_10 — Register 10
  [27:26] FIELD_5, [22] FIELD_2, [21:19] FIELD_3, [21:18] FIELD_8, [16:12] FIELD_7, [9] FIELD_4, [11:8] FIELD_6, [7:4] FIELD_1
0x2C REG_11 — Register 11
  [28] FIELD_9, [32:28] FIELD_16, [30:28] FIELD_29, [28:27] FIELD_10, [27:25] FIELD_3, [28:24] FIELD_20, [24:23] FIELD_4, [25:21] FIELD_21, [21:20] FIELD_6, [20:18] FIELD_15, [18] FIELD_26, [20:16] FIELD_22, [19:15] FIELD_24, [15:12] FIELD_17, [14:11] FIELD_5, [12:11] FIELD_11, [10:8] FIELD_12, [7] FIELD_13, [8:5] FIELD_1, [8:5] FIELD_2, [7:5] FIELD_25, [4] FIELD_8, [8:4] FIELD_27, [7:3] FIELD_18, [5:2] FIELD_7, [2:1] FIELD_19, [4:0] FIELD_14, [3:0] FIELD_23, [1:0] FIELD_28
0x30 REG_12 — Register 12
  [33:31] FIELD_7, [34:30] FIELD_13, [26] FIELD_14, [26] FIELD_18, [28:25] FIELD_9, [26:24] FIELD_8, [24:23] FIELD_4, [26:22] FIELD_10, [25:21] FIELD_5, [22:19] FIELD_6, [21:17] FIELD_11, [20:17] FIELD_12, [20:17] FIELD_17, [18:14] FIELD_16, [11:9] FIELD_2, [9:7] FIELD_15, [6] FIELD_19, [3] FIELD_1, [3] FIELD_3
0x34 REG_13 — Register 13
  [25] FIELD_1, [26:25] FIELD_2, [24:23] FIELD_3, [20:18] FIELD_6, [5:4] FIELD_5, [4:0] FIELD_4
0x38 REG_14 — Register 14
  [34:31] FIELD_11, [29:27] FIELD_2, [27:26] FIELD_4, [26:25] FIELD_16, [26:23] FIELD_5, [22:20] FIELD_9, [21:19] FIELD_8, [16:13] FIELD_13, [14:12] FIELD_17, [9:8] FIELD_12, [11:8] FIELD_15, [7] FIELD_6, [8:7] FIELD_14, [8:5] FIELD_1, [5] FIELD_10, [4] FIELD_3, [7:4] FIELD_7
0x3C REG_15 — Register 15
  [30:28] FIELD_9, [29:27] FIELD_14, [28:26] FIELD_7, [24] FIELD_2, [25:22] FIELD_1, [20:18] FIELD_10, [18] FIELD_12, [16:12] FIELD_5, [11:10] FIELD_6, [7:6] FIELD_4, [3] FIELD_3, [6:2] FIELD_13, [2:0] FIELD_8, [0] FIELD_11
0x40 REG_16 — Register 16
  [30:29] FIELD_13, [28:26] FIELD_1, [25:24] FIELD_6, [24:21] FIELD_11, [24:21] FIELD_12, [22:20] FIELD_8, [24:20] FIELD_14, [19:17] FIELD_9, [15:13] FIELD_2, [11] FIELD_4, [12:11] FIELD_5, [13:11] FIELD_15, [10:9] FIELD_10, [10:7] FIELD_3, [5:3] FIELD_16, [5:1] FIELD_7
0x44 REG_17 — Register 17
  [33:31] FIELD_2, [32:30] FIELD_7, [30:29] FIELD_9, [29:25] FIELD_17, [23] FIELD_1, [24:22] FIELD_12, [23:21] FIELD_6, [23:21] FIELD_10, [14] FIELD_13, [16:14] FIELD_16, [13] FIELD_4, [16:12] FIELD_3, [13:12] FIELD_11, [7] FIELD_19, [8:6] FIELD_5, [7:6] FIELD_15, [7:5] FIELD_8, [6:3] FIELD_14, [0] FIELD_18
0x48 REG_18 — Register 18
  [32:31] FIELD_14, [28] FIELD_2, [30:27] FIELD_17, [27:25] FIELD_20, [28:24] FIELD_21, [25:22] FIELD_4, [20] FIELD_8, [23:20] FIELD_12, [21:17] FIELD_19, [20:16] FIELD_13, [19:15] FIELD_3, [17:14] FIELD_15, [15:13] FIELD_7, [15:12] FIELD_6, [12:11] FIELD_18, [11:10] FIELD_11, [10] FIELD_22, [9:7] FIELD_10, [6:4] FIELD_1, [6:3] FIELD_5, [3:1] FIELD_9, [2:0] FIELD_16
0x4C REG_19 — Register 19
  [29:28] FIELD_13, [31:27] FIELD_5, [28:26] FIELD_12, [30:26] FIELD_21, [29:25] FIELD_30, [26:23] FIELD_19, [23:21] FIELD_7, [20] FIELD_16, [19] FIELD_22, [19] FIELD_29, [20:18] FIELD_9, [19:17] FIELD_11, [16:15] FIELD_14, [17:15] FIELD_20, [18:15] FIELD_27, [17:14] FIELD_2, [13:12] FIELD_26, [12:11] FIELD_6, [13:11] FIELD_8, [11:8] FIELD_18, [11:7] FIELD_1, [11:7] FIELD_24, [7:6] FIELD_3, [9:6] FIELD_17, [5] FIELD_23, [5:4] FIELD_28, [5:3] FIELD_15, [5:2] FIELD_4, [4:0] FIELD_10, [4:0] FIELD_25
0x50 REG_20 — Register 20
  [34:30] FIELD_1, [30] FIELD_4, [31:30] FIELD_11, [30:28] FIELD_5, [24:23] FIELD_12, [22:19] FIELD_3, [21:17] FIELD_13, [18:14] FIELD_7, [9:6] FIELD_2, [8:6] FIELD_9, [9:5] FIELD_10, [7:4] FIELD_16, [2] FIELD_15, [4:1] FIELD_8, [5:1] FIELD_14, [3:0] FIELD_6
0x54 REG_21 — Register 21
  [33:29] FIELD_13, [29:28] FIELD_8, [30:27] FIELD_10, [21] FIELD_5, [22:20] FIELD_1, [20] FIELD_6, [20:19] FIELD_14, [19:18] FIELD_7, [16] FIELD_16, [15] FIELD_12, [15:14] FIELD_2, [16:13] FIELD_15, [12:11] FIELD_9, [13:9] FIELD_17, [7:6] FIELD_11, [5:4] FIELD_4, [4:0] FIELD_3
0x58 REG_22 — Register 22
  [35:31] FIELD_4, [31:30] FIELD_2, [26:25] FIELD_3, [19:15] FIELD_1, [8:5] FIELD_5, [9:5] FIELD_6, [5] FIELD_7
