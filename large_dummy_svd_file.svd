# LargeDummyDevice register map
File version: 1.0
Registers are 32-bit, read-write, no defined reset value unless marked. A register's access mark holds for its fields unless they carry their own. Offsets are from the block's base; [hi:lo] are bit positions.

## PERIPHERAL_44
Base 0x4002B000
0x04 REG_1 — Register 1
  [34:31] FIELD_18, [34:30] FIELD_2, [34:30] FIELD_20, [34:30] FIELD_25, [31:29] FIELD_6, [33:29] FIELD_22, [32:29] FIELD_24, [27] FIELD_1, [29:27] FIELD_12, [28:27] FIELD_26, [30:26] FIELD_11, [26] FIELD_14, [24] FIELD_15, [26:23] FIELD_28, [24:22] FIELD_27, [20:18] FIELD_23, [18:17] FIELD_8, [16:15] FIELD_3, [16:12] FIELD_9, [14:11] FIELD_16, [15:11] FIELD_17, [12:8] FIELD_5, [9:8] FIELD_30, [11:7] FIELD_7, [8:7] FIELD_13, [6] FIELD_4, [8:6] FIELD_19, [4] FIELD_29, [2] FIELD_10, [1] FIELD_21
0x08 REG_2 — Register 2
  [31] FIELD_17, [29] FIELD_10, [33:29] FIELD_16, [33:29] FIELD_20, [29:28] FIELD_6, [30:28] FIELD_13, [28] FIELD_22, [28:27] FIELD_7, [29:27] FIELD_19, [27:26] FIELD_8, [25:22] FIELD_5, [23:20] FIELD_26, [23:19] FIELD_24, [15] FIELD_14, [17:14] FIELD_12, [16:13] FIELD_11, [12:9] FIELD_3, [13:9] FIELD_23, [8:6] FIELD_2, [5] FIELD_4, [5] FIELD_9, [5] FIELD_18, [3:2] FIELD_15, [2:1] FIELD_21, [1] FIELD_25, [2:0] FIELD_1
0x0C REG_3 — Register 3
  [32:28] FIELD_7, [29:25] FIELD_2, [25] FIELD_8, [28:25] FIELD_18, [26:23] FIELD_12, [20:19] FIELD_9, [20:18] FIELD_17, [17:16] FIELD_1, [17:16] FIELD_5, [19:16] FIELD_19, [14] FIELD_11, [16:13] FIELD_14, [14:13] FIELD_20, [14:10] FIELD_15, [10:9] FIELD_3, [12:9] FIELD_13, [9:8] FIELD_10, [9:7] FIELD_6, [7:4] FIELD_16, [4:3] FIELD_4
0x10 REG_4 — Register 4
  [31:30] FIELD_3, [29:28] FIELD_1, [29:25] FIELD_4, [18:15] FIELD_6, [15:14] FIELD_5, [8:6] FIELD_2, [7:3] FIELD_8, [0] FIELD_7
0x14 REG_5 — Register 5
  [32:29] FIELD_8, [33:29] FIELD_13, [28] FIELD_5, [27:25] FIELD_6, [24:23] FIELD_15, [24:21] FIELD_14, [23:20] FIELD_12, [23:19] FIELD_2, [15:14] FIELD_4, [17:14] FIELD_11, [12:11] FIELD_9, [8:7] FIELD_7, [5] FIELD_1, [4:1] FIELD_10, [2:0] FIELD_3
0x18 REG_6 — Register 6
  [32:30] FIELD_3, [28] FIELD_2, [22] FIELD_4, [21] FIELD_1, [23:21] FIELD_5
0x1C REG_7 — Register 7
  [33:30] FIELD_14, [26:24] FIELD_12, [24:22] FIELD_3, [22] FIELD_10, [21] FIELD_6, [20] FIELD_5, [23:20] FIELD_11, [19:17] FIELD_1, [17:16] FIELD_15, [17:13] FIELD_8, [13:10] FIELD_2, [11:9] FIELD_4, [5] FIELD_9, [9:5] FIELD_13, [4] FIELD_7
0x20 REG_8 — Register 8
  [32:30] FIELD_1, [32:29] FIELD_11, [30:27] FIELD_22, [29:26] FIELD_9, [30:26] FIELD_15, [30:26] FIELD_21, [27:26] FIELD_23, [26:23] FIELD_10, [26:23] FIELD_16, [19] FIELD_7, [21:19] FIELD_12, [19:18] FIELD_6, [21:18] FIELD_18, [19:18] FIELD_27, [21:17] FIELD_25, [18:16] FIELD_14, [17:15] FIELD_24, [15:12] FIELD_13, [15:12] FIELD_19, [12] FIELD_20, [11:10] FIELD_8, [13:10] FIELD_17, [14:10] FIELD_26, [9:8] FIELD_2, [8:7] FIELD_4, [8:5] FIELD_5, [5:3] FIELD_3
0x24 REG_9 — Register 9
  [32:31] FIELD_14, [32:30] FIELD_4, [32:29] FIELD_3, [29:26] FIELD_2, [26] FIELD_10, [28:26] FIELD_13, [27:25] FIELD_6, [16:14] FIELD_9, [16:12] FIELD_5, [9:7] FIELD_8, [10:6] FIELD_1, [6] FIELD_7, [5:4] FIELD_12, [1:0] FIELD_11
0x28 REG_10 — Register 10
  [33:29] FIELD_10, [31:29] FIELD_15, [31:27] FIELD_7, [27:24] FIELD_9, [27:24] FIELD_14, [26:23] FIELD_11, [26:22] FIELD_13, [24:21] FIELD_2, [20:19] FIELD_16, [20:18] FIELD_18, [18:17] FIELD_8, [15] FIELD_5, [12:10] FIELD_12, [12:9] FIELD_1, [12:9] FIELD_17, [12:8] FIELD_4, [11:7] FIELD_3, [4:2] FIELD_6
0x2C REG_11 — Register 11
  [25:24] FIELD_2, [23:20] FIELD_4, [20:19] FIELD_3, [17:15] FIELD_6, [13:12] FIELD_5, [2:0] FIELD_1
0x30 REG_12 — Register 12
  [26] FIELD_18, [28:25] FIELD_5, [24] FIELD_15, [26:24] FIELD_19, [24:23] FIELD_7, [21] FIELD_6, [22:18] FIELD_11, [19:16] FIELD_9, [20:16] FIELD_12, [18:14] FIELD_4, [16:14] FIELD_16, [12] FIELD_10, [9:6] FIELD_3, [9:6] FIELD_13, [8:6] FIELD_14, [7:6] FIELD_17, [8:5] FIELD_1, [5] FIELD_20, [8:4] FIELD_8, [2] FIELD_2
0x34 REG_13 — Register 13
  [34:31] FIELD_13, [33:31] FIELD_20, [24] FIELD_10, [20] FIELD_1, [23:20] FIELD_5, [20] FIELD_22, [20:19] FIELD_3, [19] FIELD_4, [20:19] FIELD_21, [18] FIELD_2, [19:18] FIELD_14, [20:17] FIELD_15, [16:15] FIELD_6, [14] FIELD_9, [17:13] FIELD_11, [10] FIELD_18, [12:10] FIELD_19, [9] FIELD_17, [9:7] FIELD_16, [9:5] FIELD_7, [5] FIELD_12, [4:0] FIELD_8
0x38 REG_14 — Register 14
  [31:27] FIELD_5, [24:23] FIELD_8, [23] FIELD_10, [21:20] FIELD_12, [20:19] FIELD_4, [21:19] FIELD_6, [20:16] FIELD_7, [12] FIELD_1, [16:12] FIELD_15, [14:11] FIELD_3, [14:10] FIELD_14, [10:7] FIELD_9, [6] FIELD_11, [8:6] FIELD_13, [7:5] FIELD_2
0x3C REG_15 — Register 15
  [33:31] FIELD_27, [32:30] FIELD_3, [32:29] FIELD_23, [31:28] FIELD_1, [32:28] FIELD_5, [28] FIELD_20, [31:27] FIELD_25, [25] FIELD_4, [28:25] FIELD_32, [24] FIELD_24, [26:23] FIELD_6, [24:21] FIELD_8, [23:19] FIELD_26, [22:18] FIELD_2, [18] FIELD_19, [20:17] FIELD_10, [21:17] FIELD_21, [16:15] FIELD_11, [17:15] FIELD_14, [18:15] FIELD_17, [17:13] FIELD_28, [12] FIELD_13, [12] FIELD_22, [15:12] FIELD_31, [14:11] FIELD_18, [7] FIELD_9, [9:7] FIELD_12, [8:6] FIELD_7, [8:6] FIELD_15, [8:5] FIELD_29, [7:3] FIELD_16, [2:1] FIELD_30
0x40 REG_16 — Register 16
  [33:31] FIELD_8, [32:31] FIELD_10, [31] FIELD_21, [31:27] FIELD_4, [29:27] FIELD_7, [28:27] FIELD_23, [28:26] FIELD_5, [29:26] FIELD_16, [29:25] FIELD_2, [27:23] FIELD_24, [23:22] FIELD_18, [22:21] FIELD_1, [22:20] FIELD_17, [20:19] FIELD_11, [21:18] FIELD_3, [20:18] FIELD_6, [22:18] FIELD_15, [16:15] FIELD_13, [12] FIELD_12, [14:12] FIELD_14, [6] FIELD_20, [6:4] FIELD_19, [4:3] FIELD_22, [2] FIELD_9, [4:0] FIELD_25
0x44 REG_17 — Register 17
  [29:27] FIELD_5, [29:27] FIELD_8, [27:23] FIELD_1, [22:19] FIELD_2, [19:18] FIELD_7, [15:12] FIELD_3, [12] FIELD_11, [8] FIELD_9, [9:8] FIELD_10, [8:7] FIELD_4, [4:2] FIELD_6
0x48 REG_18 — Register 18
  [30:27] FIELD_2, [21] FIELD_3, [21:20] FIELD_4, [10] FIELD_5, [13:9] FIELD_1
0x4C REG_19 — Register 19
  [35:31] FIELD_5, [32:29] FIELD_28, [31:28] FIELD_12, [30:27] FIELD_6, [30:27] FIELD_25, [28:26] FIELD_7, [28:26] FIELD_14, [26] FIELD_21, [29:25] FIELD_8, [21:20] FIELD_26, [22:18] FIELD_1, [21:17] FIELD_3, [18:17] FIELD_9, [17] FIELD_22, [17] FIELD_23, [17:16] FIELD_16, [17:13] FIELD_20, [14:12] FIELD_13, [15:12] FIELD_18, [10:9] FIELD_4, [12:8] FIELD_27, [10:6] FIELD_10, [6:3] FIELD_24, [5:2] FIELD_17, [3:1] FIELD_2, [5:1] FIELD_11, [3:0] FIELD_15, [2:0] FIELD_19
0x50 REG_20 — Register 20
  [29] FIELD_1, [32:28] FIELD_7, [27:26] FIELD_11, [23] FIELD_3, [22] FIELD_6, [22:19] FIELD_2, [21:17] FIELD_10, [10] FIELD_4, [13:9] FIELD_8, [5:4] FIELD_9, [4:2] FIELD_5
0x54 REG_21 — Register 21
  [34:31] FIELD_1, [33:30] FIELD_9, [29] FIELD_2, [29:25] FIELD_8, [24:22] FIELD_3, [19:18] FIELD_7, [7] FIELD_6, [8:4] FIELD_4, [1:0] FIELD_5
