# LargeDummyDevice register map
File version: 1.0
Registers are 32-bit, read-write, no defined reset value unless marked. A register's access mark holds for its fields unless they carry their own. Offsets are from the block's base; [hi:lo] are bit positions.

## PERIPHERAL_96
Base 0x4005F000
0x04 REG_1 — Register 1
  [32:31] FIELD_9, [34:31] FIELD_14, [32:29] FIELD_10, [27:23] FIELD_19, [25:23] FIELD_21, [25:22] FIELD_5, [23:21] FIELD_26, [20] FIELD_6, [21:19] FIELD_16, [19:18] FIELD_4, [17] FIELD_20, [17:16] FIELD_15, [15] FIELD_28, [17:13] FIELD_25, [14:11] FIELD_3, [11] FIELD_17, [12:10] FIELD_7, [13:10] FIELD_12, [13:10] FIELD_24, [9] FIELD_29, [9:8] FIELD_18, [10:8] FIELD_23, [7:5] FIELD_13, [3:1] FIELD_2, [4:1] FIELD_22, [0] FIELD_1, [1:0] FIELD_8, [0] FIELD_11, [2:0] FIELD_27
0x08 REG_2 — Register 2
  [33:31] FIELD_3, [34:31] FIELD_25, [32:28] FIELD_20, [28:27] FIELD_2, [30:27] FIELD_11, [27:26] FIELD_16, [27:25] FIELD_4, [28:25] FIELD_21, [26:22] FIELD_9, [23:22] FIELD_19, [20] FIELD_5, [20] FIELD_13, [20] FIELD_17, [21:18] FIELD_1, [20:17] FIELD_7, [17:16] FIELD_12, [16] FIELD_18, [16] FIELD_22, [18:15] FIELD_8, [13] FIELD_15, [11] FIELD_26, [12:9] FIELD_23, [8] FIELD_10, [6:4] FIELD_27, [3:1] FIELD_24, [3:0] FIELD_6, [0] FIELD_14
0x0C REG_3 — Register 3
  [28] FIELD_5, [30:27] FIELD_1, [28:27] FIELD_9, [28:25] FIELD_19, [28:24] FIELD_16, [23:22] FIELD_8, [24:21] FIELD_13, [21:20] FIELD_3, [24:20] FIELD_18, [16:15] FIELD_10, [17:15] FIELD_22, [16:12] FIELD_20, [12:11] FIELD_11, [12:9] FIELD_7, [13:9] FIELD_14, [9:8] FIELD_4, [7:4] FIELD_12, [4:2] FIELD_6, [2] FIELD_15, [1] FIELD_2, [1] FIELD_17, [4:1] FIELD_21
0x10 REG_4 — Register 4
  [32:31] FIELD_11, [28:27] FIELD_12, [25:24] FIELD_9, [25:23] FIELD_5, [23] FIELD_8, [21] FIELD_6, [24:20] FIELD_7, [19:18] FIELD_14, [12:11] FIELD_10, [11:7] FIELD_1, [6:5] FIELD_4, [5:2] FIELD_2, [5:2] FIELD_3, [5:2] FIELD_13
0x14 REG_5 — Register 5
  [32:31] FIELD_17, [32:28] FIELD_24, [31:27] FIELD_18, [30:26] FIELD_12, [29:25] FIELD_20, [29:25] FIELD_21, [23] FIELD_6, [24:22] FIELD_7, [24:22] FIELD_14, [24:21] FIELD_13, [18:17] FIELD_3, [21:17] FIELD_26, [18:15] FIELD_8, [19:15] FIELD_10, [18:15] FIELD_11, [18:14] FIELD_2, [12] FIELD_16, [12:11] FIELD_23, [10] FIELD_19, [11:9] FIELD_25, [10:7] FIELD_4, [7:6] FIELD_9, [4] FIELD_22, [6:3] FIELD_15, [4:3] FIELD_27, [4:2] FIELD_1, [3:1] FIELD_5
0x18 REG_6 — Register 6
  [30:28] FIELD_7, [23] FIELD_2, [25:23] FIELD_11, [26:22] FIELD_5, [21:20] FIELD_9, [22:19] FIELD_12, [15:13] FIELD_3, [14:12] FIELD_13, [8:7] FIELD_4, [8:5] FIELD_8, [7:3] FIELD_6, [3:1] FIELD_10, [4:0] FIELD_1
0x1C REG_7 — Register 7
  [33:31] FIELD_6, [34:30] FIELD_4, [32:28] FIELD_8, [25:22] FIELD_3, [24:21] FIELD_9, [21:20] FIELD_7, [21:19] FIELD_5, [7] FIELD_1, [4] FIELD_2
0x20 REG_8 — Register 8
  [33:30] FIELD_13, [33:30] FIELD_16, [31:29] FIELD_4, [29] FIELD_15, [30:28] FIELD_6, [27:24] FIELD_2, [24:22] FIELD_5, [21] FIELD_8, [25:21] FIELD_10, [21] FIELD_11, [18] FIELD_3, [22:18] FIELD_14, [18:16] FIELD_9, [17:13] FIELD_12, [10:9] FIELD_1, [10:6] FIELD_17, [3] FIELD_7
0x24 REG_9 — Register 9
  [35:31] FIELD_12, [34:31] FIELD_13, [29] FIELD_4, [32:28] FIELD_8, [24:23] FIELD_1, [24:22] FIELD_5, [24:22] FIELD_10, [20:18] FIELD_21, [17] FIELD_9, [19:16] FIELD_7, [18:14] FIELD_11, [16:13] FIELD_20, [13:12] FIELD_17, [12] FIELD_23, [12:10] FIELD_19, [9:7] FIELD_22, [5] FIELD_18, [6:4] FIELD_2, [5:3] FIELD_6, [7:3] FIELD_14, [5:3] FIELD_15, [2] FIELD_3, [5:1] FIELD_24, [4:0] FIELD_16
0x28 REG_10 — Register 10
  [32:31] FIELD_2, [28] FIELD_1, [24:21] FIELD_3, [15] FIELD_5, [3:2] FIELD_4
0x2C REG_11 — Register 11
  [26] FIELD_6, [26:25] FIELD_5, [26:23] FIELD_2, [25:23] FIELD_15, [25:22] FIELD_8, [21] FIELD_10, [21:20] FIELD_4, [19] FIELD_1, [19:17] FIELD_3, [18:16] FIELD_12, [18:15] FIELD_13, [14] FIELD_9, [13] FIELD_11, [14:13] FIELD_14, [0] FIELD_7
0x30 REG_12 — Register 12
  [33:30] FIELD_6, [34:30] FIELD_25, [31:29] FIELD_2, [30:29] FIELD_5, [30:29] FIELD_22, [31:27] FIELD_3, [27:23] FIELD_15, [24:22] FIELD_27, [25:21] FIELD_12, [21] FIELD_29, [21:19] FIELD_10, [20:18] FIELD_20, [21:17] FIELD_1, [15] FIELD_21, [17:14] FIELD_18, [15:13] FIELD_16, [15:11] FIELD_24, [11] FIELD_28, [14:10] FIELD_4, [14:10] FIELD_14, [12:9] FIELD_8, [13:9] FIELD_23, [10:6] FIELD_17, [9:6] FIELD_19, [6:5] FIELD_7, [5] FIELD_9, [6:3] FIELD_26, [1] FIELD_11, [2:1] FIELD_13
0x34 REG_13 — Register 13
  [34:31] FIELD_2, [29] FIELD_13, [31:28] FIELD_9, [26:24] FIELD_16, [24] FIELD_19, [27:23] FIELD_20, [26:22] FIELD_12, [26:22] FIELD_24, [21] FIELD_3, [23:21] FIELD_23, [25:21] FIELD_25, [17] FIELD_21, [19:16] FIELD_11, [18:14] FIELD_1, [11] FIELD_8, [12:11] FIELD_15, [10:7] FIELD_26, [7:6] FIELD_6, [8:4] FIELD_5, [6:4] FIELD_18, [7:4] FIELD_27, [7:3] FIELD_4, [4:3] FIELD_7, [7:3] FIELD_10, [4:2] FIELD_14, [3:2] FIELD_17, [4:1] FIELD_22
0x38 REG_14 — Register 14
  [32:30] FIELD_2, [27:25] FIELD_6, [15:11] FIELD_1, [10:9] FIELD_8, [7:6] FIELD_4, [9:6] FIELD_7, [5:1] FIELD_3, [3:0] FIELD_5
0x3C REG_15 — Register 15
  [35:31] FIELD_1, [32:29] FIELD_8, [28:27] FIELD_9, [27:25] FIELD_2, [27:24] FIELD_5, [22] FIELD_4, [21:20] FIELD_11, [21:19] FIELD_10, [15:14] FIELD_12, [15:12] FIELD_3, [12:10] FIELD_6, [10:8] FIELD_13, [3:1] FIELD_7, [4:1] FIELD_14
0x40 REG_16 — Register 16
  [33:31] FIELD_7, [34:30] FIELD_13, [30:29] FIELD_1, [28:26] FIELD_9, [29:26] FIELD_14, [26:23] FIELD_2, [27:23] FIELD_8, [22] FIELD_6, [25:21] FIELD_15, [20:19] FIELD_16, [22:18] FIELD_4, [14] FIELD_5, [14:12] FIELD_10, [12:10] FIELD_17, [10:7] FIELD_12, [6:3] FIELD_11, [2:1] FIELD_3
0x44 REG_17 — Register 17
  [33:29] FIELD_8, [30:28] FIELD_17, [30:26] FIELD_12, [25:24] FIELD_10, [26:23] FIELD_5, [24:23] FIELD_14, [25:22] FIELD_3, [25:22] FIELD_6, [25:21] FIELD_4, [21:19] FIELD_13, [16] FIELD_15, [19:15] FIELD_1, [17:15] FIELD_9, [15:14] FIELD_21, [14:12] FIELD_16, [12:10] FIELD_2, [11:9] FIELD_7, [8] FIELD_11, [10:6] FIELD_18, [8:5] FIELD_20, [0] FIELD_19
0x48 REG_18 — Register 18
  [29:25] FIELD_4, [22] FIELD_3, [17:13] FIELD_5, [11:10] FIELD_1, [12:8] FIELD_2
0x4C REG_19 — Register 19
  [31] FIELD_7, [32:31] FIELD_17, [30:28] FIELD_1, [28] FIELD_28, [29:26] FIELD_23, [26:23] FIELD_2, [26:23] FIELD_18, [22:21] FIELD_20, [20] FIELD_5, [20] FIELD_16, [21:17] FIELD_11, [19:16] FIELD_25, [17:15] FIELD_3, [13:12] FIELD_4, [12] FIELD_13, [14:11] FIELD_14, [11:10] FIELD_10, [12:10] FIELD_22, [13:9] FIELD_26, [9:6] FIELD_27, [9:5] FIELD_9, [8:5] FIELD_21, [7:5] FIELD_24, [7:4] FIELD_6, [6:3] FIELD_15, [0] FIELD_8, [0] FIELD_12, [3:0] FIELD_19, [1:0] FIELD_29
0x50 REG_20 — Register 20
  [30:27] FIELD_2, [17] FIELD_1, [19:15] FIELD_5, [4:0] FIELD_3, [1:0] FIELD_4
0x54 REG_21 — Register 21
  [31:28] FIELD_2, [17:13] FIELD_1, [7:5] FIELD_3, [6:5] FIELD_4
0x58 REG_22 — Register 22
  [33:31] FIELD_28, [33:30] FIELD_1, [32:30] FIELD_13, [30:29] FIELD_8, [32:28] FIELD_22, [30:27] FIELD_9, [29:27] FIELD_10, [27] FIELD_16, [26:25] FIELD_2, [26:25] FIELD_7, [24] FIELD_30, [23:21] FIELD_5, [21] FIELD_12, [21] FIELD_29, [17] FIELD_24, [21:17] FIELD_26, [18:15] FIELD_25, [18:14] FIELD_14, [15:13] FIELD_21, [15:12] FIELD_23, [12:11] FIELD_17, [13:10] FIELD_20, [12:9] FIELD_6, [11:8] FIELD_15, [7:5] FIELD_3, [8:5] FIELD_18, [5] FIELD_19, [4:2] FIELD_4, [4:2] FIELD_27, [3:1] FIELD_11
0x5C REG_23 — Register 23
  [35:31] FIELD_20, [32:29] FIELD_18, [32:28] FIELD_11, [28:27] FIELD_1, [28:27] FIELD_19, [27:26] FIELD_4, [28:25] FIELD_2, [25] FIELD_3, [26:25] FIELD_8, [28:25] FIELD_9, [25] FIELD_24, [27:24] FIELD_7, [26:24] FIELD_14, [24:23] FIELD_16, [24:22] FIELD_17, [17:13] FIELD_10, [9] FIELD_6, [10:9] FIELD_13, [10:9] FIELD_23, [8:7] FIELD_12, [11:7] FIELD_21, [6:4] FIELD_15, [3:0] FIELD_5, [2:0] FIELD_22
0x60 REG_24 — Register 24
  [31:28] FIELD_1, [26:25] FIELD_8, [24:23] FIELD_11, [20] FIELD_13, [21:17] FIELD_2, [20:17] FIELD_7, [16:14] FIELD_12, [14:12] FIELD_6, [14:12] FIELD_9, [15:12] FIELD_14, [11:8] FIELD_10, [9:5] FIELD_5, [6:4] FIELD_3, [2:1] FIELD_4
