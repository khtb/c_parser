# LargeDummyDevice register map
File version: 1.0
Registers are 32-bit, read-write, no defined reset value unless marked. A register's access mark holds for its fields unless they carry their own. Offsets are from the block's base; [hi:lo] are bit positions.

## PERIPHERAL_53
Base 0x40034000
0x04 REG_1 — Register 1
  [28:24] FIELD_7, [24:22] FIELD_1, [22] FIELD_3, [8] FIELD_2, [8] FIELD_6, [8:6] FIELD_4, [6:4] FIELD_5
0x08 REG_2 — Register 2
  [32:31] FIELD_19, [32:28] FIELD_1, [28] FIELD_14, [30:26] FIELD_3, [26] FIELD_13, [27:25] FIELD_10, [26:24] FIELD_16, [27:23] FIELD_24, [23:21] FIELD_21, [18] FIELD_5, [18] FIELD_11, [20:18] FIELD_15, [19:17] FIELD_4, [20:17] FIELD_26, [17:15] FIELD_22, [19:15] FIELD_25, [13] FIELD_9, [16:13] FIELD_18, [11] FIELD_7, [10] FIELD_6, [8:5] FIELD_12, [9:5] FIELD_17, [8:5] FIELD_23, [7:4] FIELD_8, [4:3] FIELD_20, [3:1] FIELD_2
0x0C REG_3 — Register 3
  [32:30] FIELD_11, [31:29] FIELD_3, [29] FIELD_6, [33:29] FIELD_10, [30:29] FIELD_16, [29] FIELD_32, [28:27] FIELD_30, [28:26] FIELD_8, [29:26] FIELD_20, [30:26] FIELD_24, [29:25] FIELD_23, [24:23] FIELD_26, [26:22] FIELD_4, [22] FIELD_7, [23:22] FIELD_31, [18] FIELD_29, [17] FIELD_18, [17:16] FIELD_12, [19:15] FIELD_14, [15:14] FIELD_15, [17:14] FIELD_17, [16:12] FIELD_21, [13:12] FIELD_27, [13:11] FIELD_19, [11] FIELD_25, [10:9] FIELD_1, [9] FIELD_5, [7:6] FIELD_2, [8:5] FIELD_28, [4] FIELD_13, [4:1] FIELD_9, [3:1] FIELD_22
0x10 REG_4 — Register 4
  [22] FIELD_2, [20:19] FIELD_1, [11:8] FIELD_3, [8:7] FIELD_6, [5] FIELD_5, [2:0] FIELD_4
0x14 REG_5 — Register 5
  [29] FIELD_6, [26:23] FIELD_14, [23:21] FIELD_13, [19:18] FIELD_15, [22:18] FIELD_17, [16:15] FIELD_2, [14] FIELD_12, [15:12] FIELD_7, [11:10] FIELD_4, [12:10] FIELD_5, [10] FIELD_11, [8] FIELD_3, [9:8] FIELD_16, [8:6] FIELD_8, [8:6] FIELD_10, [1] FIELD_1, [0] FIELD_9
0x18 REG_6 — Register 6
  [31] FIELD_15, [30:29] FIELD_4, [29] FIELD_11, [33:29] FIELD_14, [27:24] FIELD_6, [24:23] FIELD_5, [25:23] FIELD_16, [22] FIELD_13, [21] FIELD_8, [22:19] FIELD_12, [18:16] FIELD_9, [15] FIELD_3, [6:5] FIELD_2, [5:2] FIELD_7, [5:2] FIELD_10, [0] FIELD_1
0x1C REG_7 — Register 7
  [34:31] FIELD_16, [31:30] FIELD_8, [32:29] FIELD_1, [31:29] FIELD_2, [30:29] FIELD_4, [31:29] FIELD_9, [30:27] FIELD_20, [26:25] FIELD_3, [26:25] FIELD_22, [28:24] FIELD_12, [27:24] FIELD_15, [24:21] FIELD_19, [22:19] FIELD_21, [19:18] FIELD_5, [18] FIELD_7, [15] FIELD_14, [16:14] FIELD_17, [14:12] FIELD_13, [11:7] FIELD_6, [10:7] FIELD_10, [4:2] FIELD_18, [0] FIELD_11
0x20 REG_8 — Register 8
  [32:31] FIELD_4, [34:30] FIELD_1, [33:30] FIELD_5, [21:20] FIELD_2, [13:10] FIELD_3
0x24 REG_9 — Register 9
  [32:29] FIELD_27, [31:28] FIELD_2, [29:28] FIELD_22, [26] FIELD_26, [29:25] FIELD_1, [27:25] FIELD_8, [22] FIELD_19, [22] FIELD_24, [21] FIELD_9, [21] FIELD_11, [22:20] FIELD_18, [21:19] FIELD_4, [22:19] FIELD_5, [21:19] FIELD_7, [20:19] FIELD_14, [18] FIELD_29, [20:17] FIELD_23, [19:16] FIELD_3, [20:16] FIELD_17, [17:13] FIELD_15, [11:10] FIELD_6, [10:9] FIELD_12, [12:9] FIELD_20, [8] FIELD_10, [11:8] FIELD_16, [12:8] FIELD_21, [9:7] FIELD_28, [7:5] FIELD_30, [6:2] FIELD_25, [1] FIELD_13
0x28 REG_10 — Register 10
  [27] FIELD_4, [27] FIELD_5, [21:18] FIELD_2, [19:15] FIELD_1, [18:15] FIELD_8, [12:8] FIELD_6, [8:6] FIELD_7, [5] FIELD_3
0x2C REG_11 — Register 11
  [30] FIELD_2, [28:26] FIELD_6, [22] FIELD_3, [20] FIELD_1, [6:2] FIELD_5, [4:0] FIELD_4
0x30 REG_12 — Register 12
  [33:29] FIELD_11, [29] FIELD_13, [31:29] FIELD_22, [28:25] FIELD_6, [27:24] FIELD_10, [24] FIELD_19, [25:21] FIELD_12, [24:20] FIELD_15, [20:19] FIELD_16, [18:16] FIELD_2, [19:16] FIELD_5, [16] FIELD_18, [17:13] FIELD_4, [12] FIELD_1, [14:10] FIELD_7, [12:9] FIELD_9, [13:9] FIELD_21, [11:7] FIELD_23, [9:5] FIELD_3, [5] FIELD_17, [3] FIELD_14, [2] FIELD_8, [3:1] FIELD_20
0x34 REG_13 — Register 13
  [35:31] FIELD_1, [35:31] FIELD_29, [33:30] FIELD_18, [30] FIELD_23, [32:29] FIELD_14, [28:27] FIELD_25, [28:26] FIELD_3, [30:26] FIELD_4, [25] FIELD_11, [21:20] FIELD_12, [19:18] FIELD_15, [19:18] FIELD_22, [22:18] FIELD_24, [18:17] FIELD_13, [16] FIELD_5, [17:14] FIELD_10, [14] FIELD_20, [17:13] FIELD_27, [14:13] FIELD_30, [12] FIELD_6, [13:12] FIELD_16, [10:8] FIELD_17, [9:7] FIELD_2, [8:6] FIELD_8, [6] FIELD_21, [7:5] FIELD_7, [4] FIELD_19, [5:3] FIELD_26, [0] FIELD_9, [3:0] FIELD_28
0x38 REG_14 — Register 14
  [32:31] FIELD_15, [33:30] FIELD_6, [25:23] FIELD_3, [26:23] FIELD_14, [26:22] FIELD_5, [22:21] FIELD_7, [23:21] FIELD_18, [20:18] FIELD_8, [17] FIELD_4, [19:17] FIELD_10, [19:16] FIELD_16, [20:16] FIELD_19, [12:11] FIELD_1, [14:11] FIELD_9, [7] FIELD_17, [7:6] FIELD_12, [9:5] FIELD_13, [3:1] FIELD_2, [4:1] FIELD_11
0x3C REG_15 — Register 15
  [33:29] FIELD_9, [29:27] FIELD_1, [27:24] FIELD_6, [27:24] FIELD_10, [23:21] FIELD_4, [21:19] FIELD_12, [16] FIELD_8, [12] FIELD_5, [12] FIELD_7, [14:10] FIELD_11, [5:2] FIELD_3, [2:0] FIELD_2
0x40 REG_16 — Register 16
  [35:31] FIELD_24, [34:30] FIELD_20, [33:29] FIELD_18, [28] FIELD_11, [29:28] FIELD_21, [30:27] FIELD_14, [25:23] FIELD_16, [23] FIELD_22, [26:23] FIELD_27, [25:22] FIELD_6, [23:21] FIELD_10, [18] FIELD_7, [18] FIELD_23, [20:17] FIELD_28, [14:13] FIELD_19, [14:11] FIELD_26, [10] FIELD_8, [10] FIELD_13, [11:10] FIELD_15, [10] FIELD_25, [8] FIELD_9, [7] FIELD_1, [9:7] FIELD_5, [10:7] FIELD_12, [6] FIELD_30, [6:5] FIELD_4, [6:5] FIELD_29, [7:4] FIELD_3, [5:3] FIELD_2, [5:1] FIELD_17
0x44 REG_17 — Register 17
  [31] FIELD_11, [29:28] FIELD_12, [24] FIELD_14, [23] FIELD_5, [23] FIELD_16, [23:22] FIELD_3, [22:20] FIELD_7, [20:17] FIELD_6, [20:16] FIELD_13, [15:12] FIELD_10, [9] FIELD_8, [9:7] FIELD_1, [8:4] FIELD_2, [6:3] FIELD_4, [4:3] FIELD_15, [3:2] FIELD_9
0x48 REG_18 — Register 18
  [13:12] FIELD_1
0x4C REG_19 — Register 19
  [33:29] FIELD_12, [29] FIELD_13, [26:24] FIELD_8, [27:24] FIELD_18, [23:21] FIELD_1, [25:21] FIELD_21, [23:19] FIELD_14, [18:15] FIELD_6, [15:14] FIELD_2, [15:14] FIELD_4, [15:13] FIELD_7, [14:13] FIELD_25, [15:12] FIELD_9, [13:12] FIELD_11, [15:12] FIELD_23, [10] FIELD_16, [10] FIELD_19, [10] FIELD_20, [11:9] FIELD_3, [12:8] FIELD_5, [7:6] FIELD_15, [9:5] FIELD_10, [3] FIELD_22, [4:3] FIELD_24, [3:0] FIELD_17
0x50 REG_20 — Register 20
  [34:31] FIELD_13, [32:30] FIELD_12, [34:30] FIELD_21, [28] FIELD_3, [26:24] FIELD_2, [24:23] FIELD_14, [26:22] FIELD_11, [22:20] FIELD_18, [24:20] FIELD_19, [19:18] FIELD_22, [18:17] FIELD_7, [17] FIELD_16, [16:14] FIELD_4, [15:13] FIELD_5, [14:13] FIELD_15, [11] FIELD_6, [15:11] FIELD_20, [9:6] FIELD_8, [8:4] FIELD_9, [5:2] FIELD_10, [1:0] FIELD_1, [1:0] FIELD_17
0x54 REG_21 — Register 21
  [34:31] FIELD_7, [31] FIELD_9, [31:30] FIELD_8, [11] FIELD_6, [11:8] FIELD_2, [6:5] FIELD_5, [7:4] FIELD_4, [4:2] FIELD_3, [5:1] FIELD_1
