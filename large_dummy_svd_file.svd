# LargeDummyDevice register map
File version: 1.0
Registers are 32-bit, read-write, no defined reset value unless marked. A register's access mark holds for its fields unless they carry their own. Offsets are from the block's base; [hi:lo] are bit positions.

## PERIPHERAL_70
Base 0x40045000
0x04 REG_1 — Register 1
  [31:29] FIELD_14, [24:21] FIELD_4, [23:20] FIELD_2, [20:18] FIELD_13, [17:16] FIELD_6, [18:14] FIELD_8, [17:14] FIELD_11, [14:10] FIELD_3, [10] FIELD_10, [12:8] FIELD_7, [10:8] FIELD_9, [6] FIELD_5, [4] FIELD_12, [2:1] FIELD_1
0x08 REG_2 — Register 2
  [30:29] FIELD_7, [29:27] FIELD_12, [28:27] FIELD_14, [28:25] FIELD_9, [28:25] FIELD_10, [28:25] FIELD_21, [26:22] FIELD_17, [22:21] FIELD_20, [24:20] FIELD_2, [23:20] FIELD_6, [20:19] FIELD_3, [20:18] FIELD_4, [16:15] FIELD_5, [6] FIELD_8, [6] FIELD_15, [9:6] FIELD_19, [9:5] FIELD_16, [4] FIELD_11, [5:2] FIELD_1, [3:2] FIELD_13, [3:2] FIELD_18
0x0C REG_3 — Register 3
  [33:30] FIELD_2, [31:29] FIELD_3, [30:29] FIELD_13, [25:24] FIELD_11, [20:19] FIELD_4, [14:13] FIELD_12, [12] FIELD_9, [11] FIELD_10, [15:11] FIELD_14, [12:11] FIELD_17, [13:9] FIELD_15, [7:6] FIELD_16, [7:3] FIELD_1, [6:3] FIELD_8, [3:1] FIELD_5, [2:1] FIELD_6, [2:1] FIELD_7
0x10 REG_4 — Register 4
  [31] FIELD_7, [30:27] FIELD_8, [24] FIELD_12, [25:23] FIELD_3, [22] FIELD_4, [24:21] FIELD_13, [17:16] FIELD_10, [16:14] FIELD_1, [16:14] FIELD_5, [12:10] FIELD_2, [11:10] FIELD_9, [10:6] FIELD_11, [2] FIELD_6
0x14 REG_5 — Register 5
  [28] FIELD_19, [28] FIELD_24, [28:27] FIELD_14, [26] FIELD_1, [25] FIELD_7, [25:21] FIELD_22, [22:20] FIELD_20, [23:19] FIELD_23, [20:16] FIELD_10, [17:16] FIELD_16, [17:15] FIELD_2, [16:15] FIELD_9, [16:15] FIELD_17, [17:14] FIELD_18, [14] FIELD_21, [15:13] FIELD_3, [17:13] FIELD_15, [9:7] FIELD_6, [7:5] FIELD_8, [5:4] FIELD_12, [2] FIELD_4, [4:2] FIELD_5, [2:0] FIELD_11, [1:0] FIELD_13
0x18 REG_6 — Register 6
  [31] FIELD_9, [26:25] FIELD_5, [24:21] FIELD_3, [22:18] FIELD_4, [20:17] FIELD_2, [10] FIELD_8, [10:7] FIELD_7, [6:3] FIELD_1, [6:3] FIELD_6
0x1C REG_7 — Register 7
  [29] FIELD_6, [27:26] FIELD_1, [24] FIELD_2, [18:17] FIELD_4, [16] FIELD_5, [12:8] FIELD_7, [9:7] FIELD_3
0x20 REG_8 — Register 8
  [31] FIELD_1, [34:30] FIELD_3, [27] FIELD_24, [29:26] FIELD_26, [27:25] FIELD_2, [23:22] FIELD_6, [24:21] FIELD_4, [23:21] FIELD_8, [22:21] FIELD_12, [24:21] FIELD_21, [22:20] FIELD_13, [19] FIELD_10, [21:17] FIELD_14, [16:12] FIELD_16, [12:11] FIELD_18, [9] FIELD_15, [12:9] FIELD_23, [11:8] FIELD_9, [8] FIELD_20, [12:8] FIELD_22, [8:6] FIELD_11, [7:6] FIELD_19, [10:6] FIELD_25, [8:5] FIELD_17, [7:3] FIELD_5, [3:1] FIELD_7
0x24 REG_9 — Register 9
  [31] FIELD_15, [29] FIELD_1, [33:29] FIELD_4, [29] FIELD_12, [30:27] FIELD_14, [24:22] FIELD_3, [21:20] FIELD_5, [24:20] FIELD_10, [16] FIELD_9, [17:13] FIELD_8, [13:12] FIELD_7, [14:12] FIELD_13, [14:12] FIELD_16, [13:11] FIELD_11, [3:2] FIELD_2, [1:0] FIELD_6
0x28 REG_10 — Register 10
  [34:30] FIELD_7, [32:30] FIELD_18, [32:29] FIELD_25, [31:27] FIELD_10, [30:26] FIELD_1, [27:25] FIELD_22, [25:23] FIELD_4, [24:22] FIELD_26, [24:21] FIELD_16, [25:21] FIELD_21, [22:20] FIELD_8, [22:20] FIELD_9, [20:19] FIELD_20, [21:19] FIELD_29, [15] FIELD_15, [16:15] FIELD_27, [16:14] FIELD_17, [14:11] FIELD_13, [10] FIELD_12, [8:7] FIELD_6, [10:7] FIELD_11, [6] FIELD_5, [10:6] FIELD_19, [6:4] FIELD_2, [5:4] FIELD_23, [7:3] FIELD_14, [5:3] FIELD_28, [4:1] FIELD_3, [0] FIELD_24
0x2C REG_11 — Register 11
  [30:29] FIELD_21, [30:29] FIELD_23, [30:26] FIELD_12, [26:25] FIELD_8, [27:25] FIELD_11, [29:25] FIELD_16, [26:25] FIELD_27, [27:23] FIELD_10, [26:23] FIELD_28, [23:21] FIELD_1, [24:21] FIELD_7, [21:20] FIELD_18, [20] FIELD_20, [23:19] FIELD_2, [23:19] FIELD_17, [22:19] FIELD_22, [17:15] FIELD_3, [18:14] FIELD_14, [16:14] FIELD_19, [17:13] FIELD_13, [13] FIELD_30, [9] FIELD_15, [9:8] FIELD_6, [11:7] FIELD_31, [5:3] FIELD_4, [4:3] FIELD_5, [4:3] FIELD_29, [2] FIELD_9, [4:1] FIELD_25, [2:1] FIELD_26, [4:0] FIELD_24
0x30 REG_12 — Register 12
  [32:30] FIELD_5, [23:22] FIELD_4, [17:16] FIELD_3, [17:16] FIELD_10, [17:13] FIELD_7, [9] FIELD_8, [9:6] FIELD_1, [7:5] FIELD_2, [5] FIELD_6, [3:0] FIELD_9
0x34 REG_13 — Register 13
  [32:28] FIELD_6, [26] FIELD_17, [26:24] FIELD_18, [23:21] FIELD_14, [20] FIELD_4, [19] FIELD_2, [23:19] FIELD_21, [17:16] FIELD_7, [12] FIELD_19, [16:12] FIELD_20, [15:11] FIELD_15, [9] FIELD_13, [9:8] FIELD_1, [9:6] FIELD_12, [5] FIELD_11, [1] FIELD_3, [4:1] FIELD_8, [3:1] FIELD_10, [5:1] FIELD_16, [4:0] FIELD_5, [4:0] FIELD_9
0x38 REG_14 — Register 14
  [29:28] FIELD_9, [28:27] FIELD_16, [28:25] FIELD_15, [28:24] FIELD_7, [22] FIELD_2, [22] FIELD_3, [23:22] FIELD_4, [24:22] FIELD_12, [22:20] FIELD_1, [24:20] FIELD_5, [23:20] FIELD_10, [19:15] FIELD_8, [16:15] FIELD_11, [17:14] FIELD_6, [8:5] FIELD_14, [2:0] FIELD_13
0x3C REG_15 — Register 15
  [32:30] FIELD_6, [32:28] FIELD_4, [23] FIELD_3, [23:20] FIELD_5, [19:16] FIELD_1, [12:10] FIELD_7, [1] FIELD_2
0x40 REG_16 — Register 16
  [33:30] FIELD_17, [30:28] FIELD_6, [30:28] FIELD_10, [29:27] FIELD_2, [27] FIELD_11, [29:26] FIELD_16, [27:23] FIELD_12, [26:22] FIELD_9, [21:20] FIELD_4, [17:15] FIELD_21, [17:14] FIELD_1, [16:14] FIELD_7, [11] FIELD_3, [12:11] FIELD_14, [10:9] FIELD_13, [13:9] FIELD_15, [11:9] FIELD_19, [8] FIELD_5, [8] FIELD_18, [7] FIELD_22, [6:3] FIELD_20, [3:0] FIELD_8
0x44 REG_17 — Register 17
  [32:28] FIELD_5, [30:27] FIELD_7, [28:25] FIELD_17, [23:21] FIELD_12, [21:20] FIELD_8, [23:20] FIELD_10, [22:20] FIELD_16, [19] FIELD_9, [21:18] FIELD_13, [14] FIELD_15, [11:9] FIELD_1, [9:6] FIELD_11, [7:5] FIELD_14, [4:3] FIELD_3, [3:1] FIELD_2, [0] FIELD_4, [2:0] FIELD_6
0x48 REG_18 — Register 18
  [32:31] FIELD_8, [35:31] FIELD_12, [35:31] FIELD_15, [27:25] FIELD_11, [23] FIELD_3, [22] FIELD_10, [24:20] FIELD_2, [16:14] FIELD_6, [16:12] FIELD_9, [11:9] FIELD_5, [8:6] FIELD_7, [6] FIELD_13, [7:5] FIELD_4, [7:4] FIELD_14, [4:2] FIELD_1
0x4C REG_19 — Register 19
  [18] FIELD_1
0x50 REG_20 — Register 20
  [33:29] FIELD_10, [32:29] FIELD_20, [26:25] FIELD_1, [28:25] FIELD_11, [27:24] FIELD_4, [26:24] FIELD_18, [28:24] FIELD_19, [27:23] FIELD_6, [20:16] FIELD_8, [18:15] FIELD_7, [19:15] FIELD_17, [13] FIELD_16, [15:12] FIELD_15, [14:10] FIELD_12, [11:8] FIELD_14, [11:7] FIELD_5, [7:5] FIELD_3, [2] FIELD_13, [1] FIELD_9, [2:0] FIELD_2
0x54 REG_21 — Register 21
  [34:31] FIELD_3, [34:31] FIELD_8, [32:30] FIELD_6, [30:28] FIELD_11, [26] FIELD_5, [29:25] FIELD_10, [13:11] FIELD_9, [10:7] FIELD_2, [7:5] FIELD_7, [6:3] FIELD_4, [2:0] FIELD_1
0x58 REG_22 — Register 22
  [34:31] FIELD_4, [34:31] FIELD_7, [33:31] FIELD_9, [30] FIELD_13, [33:29] FIELD_2, [26] FIELD_1, [29:26] FIELD_6, [29:25] FIELD_15, [27:24] FIELD_3, [26:23] FIELD_5, [27:23] FIELD_14, [24:22] FIELD_18, [25:21] FIELD_11, [21] FIELD_16, [24:21] FIELD_21, [19:18] FIELD_25, [20:17] FIELD_12, [19:17] FIELD_17, [18:17] FIELD_19, [18:16] FIELD_22, [13] FIELD_23, [12:11] FIELD_8, [9:5] FIELD_10, [1:0] FIELD_20, [4:0] FIELD_24
0x5C REG_23 — Register 23
  [33:31] FIELD_4, [32:31] FIELD_25, [29:28] FIELD_7, [28:27] FIELD_13, [28:26] FIELD_5, [24:23] FIELD_6, [26:22] FIELD_2, [23:22] FIELD_3, [21] FIELD_9, [25:21] FIELD_23, [20:19] FIELD_20, [21:18] FIELD_15, [22:18] FIELD_19, [19:17] FIELD_8, [16] FIELD_18, [15:13] FIELD_1, [10:9] FIELD_11, [13:9] FIELD_14, [9:8] FIELD_21, [12:8] FIELD_22, [7:4] FIELD_10, [4:2] FIELD_17, [3:1] FIELD_12, [0] FIELD_16, [1:0] FIELD_24
0x60 REG_24 — Register 24
  [29:27] FIELD_4, [29:25] FIELD_3, [25:23] FIELD_1, [16:14] FIELD_2
0x64 REG_25 — Register 25
  [27:25] FIELD_1, [26:25] FIELD_4, [27:23] FIELD_3, [8:6] FIELD_2
0x68 REG_26 — Register 26
  [27] FIELD_7, [29:26] FIELD_3, [27:23] FIELD_5, [23:22] FIELD_2, [18:17] FIELD_6, [15:14] FIELD_1, [10] FIELD_4
