# LargeDummyDevice register map
File version: 1.0
Registers are 32-bit, read-write, no defined reset value unless marked. A register's access mark holds for its fields unless they carry their own. Offsets are from the block's base; [hi:lo] are bit positions.

## PERIPHERAL_88
Base 0x40057000
0x04 REG_1 — Register 1
  [32:30] FIELD_12, [31:29] FIELD_11, [32:28] FIELD_13, [29:26] FIELD_7, [20:19] FIELD_6, [19:17] FIELD_2, [18:14] FIELD_3, [13] FIELD_5, [4] FIELD_10, [5:3] FIELD_8, [2] FIELD_9, [5:1] FIELD_4, [0] FIELD_1
0x08 REG_2 — Register 2
  [33:31] FIELD_3, [30] FIELD_5, [31:29] FIELD_7, [16] FIELD_2, [19:15] FIELD_6, [3] FIELD_4, [4:0] FIELD_1
0x0C REG_3 — Register 3
  [33:31] FIELD_3, [31:30] FIELD_2, [32:28] FIELD_4, [32:28] FIELD_10, [24:22] FIELD_7, [24:20] FIELD_14, [22:18] FIELD_15, [20:17] FIELD_6, [17:16] FIELD_5, [11:8] FIELD_11, [11:7] FIELD_9, [11:7] FIELD_12, [5:4] FIELD_1, [3:1] FIELD_8, [0] FIELD_13
0x10 REG_4 — Register 4
  [31] FIELD_17, [34:30] FIELD_12, [31:29] FIELD_2, [31:29] FIELD_25, [27] FIELD_3, [27:26] FIELD_13, [28:26] FIELD_24, [25] FIELD_1, [21] FIELD_9, [16:13] FIELD_10, [13:12] FIELD_7, [14:11] FIELD_5, [14:11] FIELD_6, [13:10] FIELD_23, [9] FIELD_4, [11:9] FIELD_8, [9:8] FIELD_18, [7] FIELD_22, [7:3] FIELD_14, [5:3] FIELD_20, [4:2] FIELD_11, [5:2] FIELD_16, [4:2] FIELD_21, [1:0] FIELD_15, [3:0] FIELD_19
0x14 REG_5 — Register 5
  [31:30] FIELD_6, [32:30] FIELD_13, [29:28] FIELD_2, [31:27] FIELD_5, [26] FIELD_20, [29:26] FIELD_22, [29:26] FIELD_27, [28:24] FIELD_14, [26:23] FIELD_3, [25:21] FIELD_1, [21:19] FIELD_12, [23:19] FIELD_21, [19] FIELD_23, [22:19] FIELD_29, [19:17] FIELD_7, [18:17] FIELD_8, [19:16] FIELD_26, [14] FIELD_17, [14] FIELD_30, [16:13] FIELD_11, [10] FIELD_28, [11:8] FIELD_9, [9:8] FIELD_25, [11:7] FIELD_10, [8:7] FIELD_19, [9:5] FIELD_16, [6:5] FIELD_24, [5:2] FIELD_18, [5:1] FIELD_31, [1:0] FIELD_4, [3:0] FIELD_15
0x18 REG_6 — Register 6
  [34:30] FIELD_3, [26] FIELD_2, [18:14] FIELD_1, [17:13] FIELD_4, [12:9] FIELD_5, [10:7] FIELD_7, [4:1] FIELD_6
0x1C REG_7 — Register 7
  [30:27] FIELD_3, [29:27] FIELD_8, [30:27] FIELD_12, [28:26] FIELD_6, [27:23] FIELD_5, [22] FIELD_10, [21:17] FIELD_7, [14:12] FIELD_2, [14:12] FIELD_4, [9:5] FIELD_1, [7:4] FIELD_11, [2] FIELD_9
0x20 REG_8 — Register 8
  [29:28] FIELD_16, [28:24] FIELD_14, [23] FIELD_7, [23:20] FIELD_21, [20:19] FIELD_5, [22:19] FIELD_11, [20:18] FIELD_18, [17:16] FIELD_10, [17:16] FIELD_17, [15:14] FIELD_4, [14] FIELD_15, [16:13] FIELD_19, [14:12] FIELD_2, [15:12] FIELD_9, [11] FIELD_1, [10:9] FIELD_12, [8] FIELD_22, [7] FIELD_20, [5] FIELD_3, [6:5] FIELD_8, [3] FIELD_6, [4:0] FIELD_13
0x24 REG_9 — Register 9
  [33:31] FIELD_4, [33:31] FIELD_11, [30] FIELD_14, [29:27] FIELD_2, [28:26] FIELD_3, [27:26] FIELD_15, [29:25] FIELD_10, [26:22] FIELD_7, [26:22] FIELD_12, [20:18] FIELD_9, [20:16] FIELD_6, [18:14] FIELD_16, [13] FIELD_5, [2] FIELD_13, [5:1] FIELD_1, [4:1] FIELD_8
0x28 REG_10 — Register 10
  [32:31] FIELD_11, [30:28] FIELD_5, [31:28] FIELD_23, [30:27] FIELD_26, [29:26] FIELD_6, [26] FIELD_29, [24] FIELD_27, [22] FIELD_4, [26:22] FIELD_10, [21] FIELD_18, [22:20] FIELD_13, [20:17] FIELD_9, [20:17] FIELD_28, [17:16] FIELD_20, [16:15] FIELD_16, [15:12] FIELD_19, [12] FIELD_21, [15:12] FIELD_22, [14:10] FIELD_15, [9] FIELD_1, [13:9] FIELD_2, [11:8] FIELD_7, [9:7] FIELD_17, [9:6] FIELD_3, [6] FIELD_25, [7:6] FIELD_30, [9:5] FIELD_14, [4] FIELD_12, [3] FIELD_24, [5:1] FIELD_8, [0] FIELD_31
0x2C REG_11 — Register 11
  [34:31] FIELD_7, [31:29] FIELD_9, [27] FIELD_8, [29:27] FIELD_11, [26:23] FIELD_12, [19] FIELD_10, [18:16] FIELD_14, [14:12] FIELD_1, [13:9] FIELD_6, [12:8] FIELD_17, [9:7] FIELD_5, [8:7] FIELD_16, [10:6] FIELD_13, [4] FIELD_15, [6:3] FIELD_2, [4:2] FIELD_3, [5:2] FIELD_4
0x30 REG_12 — Register 12
  [35:31] FIELD_17, [33:29] FIELD_8, [28] FIELD_5, [23] FIELD_16, [24:22] FIELD_4, [26:22] FIELD_7, [22:20] FIELD_9, [22:19] FIELD_1, [22:19] FIELD_15, [22:18] FIELD_3, [17] FIELD_19, [18:16] FIELD_10, [19:15] FIELD_12, [13:9] FIELD_11, [12:8] FIELD_14, [9:6] FIELD_6, [6:4] FIELD_2, [5:1] FIELD_18, [1:0] FIELD_13
0x34 REG_13 — Register 13
  [34:31] FIELD_1, [34:31] FIELD_6, [31] FIELD_7, [30] FIELD_12, [32:29] FIELD_2, [29:28] FIELD_8, [29:28] FIELD_11, [27:26] FIELD_9, [24] FIELD_22, [24:23] FIELD_16, [23] FIELD_18, [19:18] FIELD_4, [15:14] FIELD_13, [16:14] FIELD_15, [16:14] FIELD_19, [10:9] FIELD_14, [8:7] FIELD_5, [7:5] FIELD_21, [4:3] FIELD_17, [4:3] FIELD_20, [5:2] FIELD_10, [2:1] FIELD_3
0x38 REG_14 — Register 14
  [32:31] FIELD_2, [32:31] FIELD_22, [30] FIELD_5, [33:30] FIELD_18, [26:25] FIELD_15, [27:23] FIELD_9, [24:22] FIELD_21, [24:21] FIELD_8, [22:21] FIELD_10, [19] FIELD_3, [21:19] FIELD_19, [19:18] FIELD_6, [18:16] FIELD_14, [14:13] FIELD_4, [13] FIELD_16, [13:12] FIELD_13, [12:11] FIELD_17, [9:5] FIELD_1, [5] FIELD_12, [4] FIELD_7, [5:3] FIELD_11, [4:2] FIELD_20
0x3C REG_15 — Register 15
  [31:30] FIELD_15, [30:27] FIELD_26, [28:24] FIELD_5, [26:23] FIELD_3, [23:22] FIELD_24, [23:20] FIELD_19, [22:19] FIELD_17, [17] FIELD_4, [18:17] FIELD_9, [20:16] FIELD_7, [15] FIELD_12, [19:15] FIELD_18, [15] FIELD_20, [17:15] FIELD_27, [15:14] FIELD_21, [15:14] FIELD_29, [14] FIELD_30, [15:13] FIELD_25, [15:11] FIELD_16, [11] FIELD_22, [13:9] FIELD_6, [11:9] FIELD_23, [6] FIELD_2, [5] FIELD_8, [7:4] FIELD_1, [6:4] FIELD_11, [5:4] FIELD_13, [4:3] FIELD_10, [2] FIELD_31, [1] FIELD_28, [2:0] FIELD_14
0x40 REG_16 — Register 16
  [31:29] FIELD_15, [26] FIELD_10, [28:25] FIELD_23, [27:24] FIELD_8, [23] FIELD_4, [26:23] FIELD_18, [22:21] FIELD_12, [20] FIELD_3, [24:20] FIELD_17, [23:20] FIELD_22, [19:18] FIELD_5, [18] FIELD_7, [16] FIELD_16, [18:15] FIELD_6, [16:13] FIELD_11, [14:12] FIELD_20, [12:11] FIELD_19, [14:10] FIELD_9, [14:10] FIELD_13, [10] FIELD_14, [9] FIELD_1, [12:9] FIELD_2, [5:1] FIELD_21
