# LargeDummyDevice register map
File version: 1.0
Registers are 32-bit, read-write, no defined reset value unless marked. A register's access mark holds for its fields unless they carry their own. Offsets are from the block's base; [hi:lo] are bit positions.

## PERIPHERAL_83
Base 0x40052000
0x04 REG_1 — Register 1
  [33:31] FIELD_14, [32:29] FIELD_15, [26] FIELD_11, [30:26] FIELD_20, [28:25] FIELD_22, [27:24] FIELD_19, [25:22] FIELD_2, [22:19] FIELD_1, [22:18] FIELD_5, [20:16] FIELD_24, [16:15] FIELD_10, [18:15] FIELD_12, [18:15] FIELD_17, [17:14] FIELD_9, [14] FIELD_21, [14:13] FIELD_23, [12] FIELD_18, [10:8] FIELD_16, [11:7] FIELD_3, [11:7] FIELD_4, [7] FIELD_8, [7:6] FIELD_6, [2:1] FIELD_7, [5:1] FIELD_13
0x08 REG_2 — Register 2
  [30:26] FIELD_2, [29:26] FIELD_5, [22:21] FIELD_6, [20:18] FIELD_3, [13] FIELD_7, [12:11] FIELD_8, [10:8] FIELD_1, [0] FIELD_4
0x0C REG_3 — Register 3
  [29:25] FIELD_10, [24] FIELD_7, [24:23] FIELD_1, [26:23] FIELD_3, [25:23] FIELD_13, [23:20] FIELD_15, [16:15] FIELD_12, [17:14] FIELD_6, [15:13] FIELD_14, [13:12] FIELD_17, [12:10] FIELD_5, [9:7] FIELD_2, [9:7] FIELD_8, [4:3] FIELD_9, [7:3] FIELD_11, [2:1] FIELD_16, [4:0] FIELD_4
0x10 REG_4 — Register 4
  [29] FIELD_13, [30:29] FIELD_17, [28:27] FIELD_7, [28:26] FIELD_10, [26:25] FIELD_18, [23] FIELD_23, [25:21] FIELD_11, [25:21] FIELD_28, [24:21] FIELD_29, [21:18] FIELD_4, [20:18] FIELD_6, [20:16] FIELD_19, [19:16] FIELD_26, [18:15] FIELD_2, [18:15] FIELD_20, [15] FIELD_24, [10] FIELD_27, [12:9] FIELD_14, [12:9] FIELD_21, [8:7] FIELD_12, [9:7] FIELD_15, [6:5] FIELD_16, [8:5] FIELD_22, [8:4] FIELD_1, [4] FIELD_9, [5:4] FIELD_25, [5:3] FIELD_8, [3:1] FIELD_3, [1:0] FIELD_5
0x14 REG_5 — Register 5
  [32:30] FIELD_5, [34:30] FIELD_9, [31:28] FIELD_4, [26:23] FIELD_7, [24:20] FIELD_6, [15:14] FIELD_3, [14:13] FIELD_12, [12] FIELD_10, [14:12] FIELD_11, [9:7] FIELD_1, [7:5] FIELD_8, [4:3] FIELD_2
0x18 REG_6 — Register 6
  [33:29] FIELD_5, [32:29] FIELD_17, [30:29] FIELD_19, [29:27] FIELD_12, [23] FIELD_9, [23] FIELD_15, [24:23] FIELD_16, [18:16] FIELD_10, [19:15] FIELD_18, [12] FIELD_2, [12] FIELD_4, [11] FIELD_11, [14:10] FIELD_14, [8] FIELD_13, [7:6] FIELD_1, [9:6] FIELD_7, [5:2] FIELD_8, [1] FIELD_6, [4:0] FIELD_3
0x1C REG_7 — Register 7
  [31:28] FIELD_1, [21:19] FIELD_4, [17:16] FIELD_6, [11:10] FIELD_3, [14:10] FIELD_5, [8:7] FIELD_2
0x20 REG_8 — Register 8
  [32:31] FIELD_17, [32:30] FIELD_7, [27] FIELD_9, [28:26] FIELD_6, [26:25] FIELD_1, [28:25] FIELD_10, [25:23] FIELD_2, [22] FIELD_12, [24:22] FIELD_24, [24:21] FIELD_11, [18:17] FIELD_3, [18:17] FIELD_15, [19:17] FIELD_25, [18:17] FIELD_26, [21:17] FIELD_27, [17] FIELD_30, [17:16] FIELD_13, [17:16] FIELD_20, [17:14] FIELD_18, [14] FIELD_22, [17:13] FIELD_8, [16:13] FIELD_23, [13:12] FIELD_21, [14:11] FIELD_19, [12:11] FIELD_29, [8] FIELD_5, [8:7] FIELD_16, [8:4] FIELD_4, [8:4] FIELD_28, [5:2] FIELD_14
0x24 REG_9 — Register 9
  [32:28] FIELD_3, [28:25] FIELD_5, [24:23] FIELD_1, [21:20] FIELD_7, [14:12] FIELD_2, [15:12] FIELD_6, [11:9] FIELD_4
0x28 REG_10 — Register 10
  [34:31] FIELD_7, [33:30] FIELD_19, [32:29] FIELD_4, [31:29] FIELD_8, [28:27] FIELD_1, [26] FIELD_2, [27:23] FIELD_5, [25:22] FIELD_12, [21] FIELD_16, [21] FIELD_18, [20] FIELD_3, [19] FIELD_22, [19:17] FIELD_20, [19:16] FIELD_11, [14:13] FIELD_15, [12:10] FIELD_10, [9] FIELD_14, [9] FIELD_17, [9:5] FIELD_6, [7:3] FIELD_9, [5:3] FIELD_13, [3:1] FIELD_21
0x2C REG_11 — Register 11
  [33:29] FIELD_4, [29] FIELD_6, [31:29] FIELD_12, [30:29] FIELD_25, [28] FIELD_24, [25:24] FIELD_20, [25:23] FIELD_2, [26:22] FIELD_7, [25:22] FIELD_14, [26:22] FIELD_21, [24:20] FIELD_18, [21:17] FIELD_15, [18:14] FIELD_10, [16:13] FIELD_5, [12] FIELD_9, [13:10] FIELD_3, [11:10] FIELD_17, [12:9] FIELD_1, [8:6] FIELD_8, [6] FIELD_22, [9:5] FIELD_23, [4] FIELD_13, [5:3] FIELD_26, [2] FIELD_11, [6:2] FIELD_16, [3:2] FIELD_19
0x30 REG_12 — Register 12
  [32:28] FIELD_2, [26:22] FIELD_1, [14:12] FIELD_3, [9:6] FIELD_4
0x34 REG_13 — Register 13
  [27:25] FIELD_3, [28:25] FIELD_4, [22:21] FIELD_2, [4:1] FIELD_1
0x38 REG_14 — Register 14
  [29] FIELD_3, [31:28] FIELD_1, [25:24] FIELD_2, [19:18] FIELD_4
0x3C REG_15 — Register 15
  [29] FIELD_8, [29:28] FIELD_9, [19] FIELD_1, [17:14] FIELD_6, [18:14] FIELD_12, [13:9] FIELD_7, [10:8] FIELD_4, [7:6] FIELD_10, [5:4] FIELD_2, [4] FIELD_3, [2] FIELD_5, [3:2] FIELD_11, [3:2] FIELD_13
0x40 REG_16 — Register 16
  [35:31] FIELD_5, [33:31] FIELD_6, [32:31] FIELD_10, [32:29] FIELD_11, [27] FIELD_8, [27:25] FIELD_20, [25:23] FIELD_14, [19:16] FIELD_17, [12] FIELD_12, [15:11] FIELD_3, [12:9] FIELD_15, [7] FIELD_9, [5] FIELD_2, [7:5] FIELD_13, [5] FIELD_16, [5:4] FIELD_7, [6:4] FIELD_19, [3:2] FIELD_4, [5:1] FIELD_18, [4:0] FIELD_1
0x44 REG_17 — Register 17
  [32:31] FIELD_1, [29:28] FIELD_3, [21:20] FIELD_4, [14:10] FIELD_2
0x48 REG_18 — Register 18
  [33:29] FIELD_19, [26] FIELD_8, [28:25] FIELD_20, [24] FIELD_17, [22] FIELD_14, [23:19] FIELD_18, [22:18] FIELD_24, [18:17] FIELD_6, [17:16] FIELD_1, [15] FIELD_2, [19:15] FIELD_3, [19:15] FIELD_10, [13] FIELD_16, [15:11] FIELD_23, [10] FIELD_13, [9:7] FIELD_9, [11:7] FIELD_15, [8:6] FIELD_5, [7:3] FIELD_4, [7:3] FIELD_7, [6:3] FIELD_12, [6:2] FIELD_11, [2:1] FIELD_21, [4:0] FIELD_22
0x4C REG_19 — Register 19
  [29] FIELD_2, [31:29] FIELD_4, [26:25] FIELD_3, [25:21] FIELD_7, [17:16] FIELD_1, [17:14] FIELD_5, [12:11] FIELD_6, [8:6] FIELD_9, [4:2] FIELD_8
0x50 REG_20 — Register 20
  [34:30] FIELD_16, [30:26] FIELD_6, [26:25] FIELD_3, [28:25] FIELD_10, [27:24] FIELD_9, [26:23] FIELD_4, [26:23] FIELD_14, [20:19] FIELD_12, [18:17] FIELD_8, [18:15] FIELD_1, [13:12] FIELD_11, [5:4] FIELD_7, [4:3] FIELD_2, [5:3] FIELD_15, [6:2] FIELD_13, [4:0] FIELD_5
0x54 REG_21 — Register 21
  [33:31] FIELD_13, [32:31] FIELD_24, [31:30] FIELD_7, [33:30] FIELD_16, [32:29] FIELD_5, [30:29] FIELD_25, [31:28] FIELD_28, [29:25] FIELD_17, [25:24] FIELD_14, [27:24] FIELD_22, [27:23] FIELD_27, [22:21] FIELD_2, [20:18] FIELD_1, [21:18] FIELD_11, [21:18] FIELD_29, [18:16] FIELD_3, [18:16] FIELD_4, [18:15] FIELD_26, [12:8] FIELD_8, [7] FIELD_10, [9:7] FIELD_20, [9:7] FIELD_21, [11:7] FIELD_30, [9:5] FIELD_12, [7:3] FIELD_6, [6:3] FIELD_9, [6:3] FIELD_18, [3] FIELD_23, [4:1] FIELD_15, [3:1] FIELD_19
