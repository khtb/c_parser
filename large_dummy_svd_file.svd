# LargeDummyDevice register map
File version: 1.0
Registers are 32-bit, read-write, no defined reset value unless marked. A register's access mark holds for its fields unless they carry their own. Offsets are from the block's base; [hi:lo] are bit positions.

## PERIPHERAL_62
Base 0x4003D000
0x04 REG_1 — Register 1
  [26:25] FIELD_9, [23] FIELD_3, [18:17] FIELD_2, [15:13] FIELD_1, [11] FIELD_6, [6:5] FIELD_5, [2] FIELD_8, [4:2] FIELD_10, [5:1] FIELD_7, [4:0] FIELD_4, [1:0] FIELD_11
0x08 REG_2 — Register 2
  [34:30] FIELD_2, [33:29] FIELD_12, [31:27] FIELD_8, [31:27] FIELD_10, [28:27] FIELD_20, [28:24] FIELD_15, [24:23] FIELD_13, [26:22] FIELD_7, [24:21] FIELD_19, [23:20] FIELD_3, [22:20] FIELD_11, [20:18] FIELD_22, [19:16] FIELD_14, [18:15] FIELD_1, [17:13] FIELD_21, [12] FIELD_4, [14:10] FIELD_25, [13:9] FIELD_23, [11:8] FIELD_16, [8:7] FIELD_9, [5:4] FIELD_5, [6:4] FIELD_6, [2:1] FIELD_17, [1] FIELD_24, [3:0] FIELD_18
0x0C REG_3 — Register 3
  [33:31] FIELD_2, [31:29] FIELD_20, [30:28] FIELD_12, [30:28] FIELD_27, [27] FIELD_5, [29:26] FIELD_17, [26:25] FIELD_1, [27:25] FIELD_3, [27:25] FIELD_8, [25:23] FIELD_16, [23] FIELD_18, [26:23] FIELD_28, [18] FIELD_19, [18] FIELD_21, [17] FIELD_11, [19:16] FIELD_15, [16] FIELD_24, [18:15] FIELD_22, [19:15] FIELD_25, [16:13] FIELD_9, [13:10] FIELD_4, [13:10] FIELD_13, [13:10] FIELD_14, [12:9] FIELD_6, [10:9] FIELD_10, [9:8] FIELD_26, [7:5] FIELD_7, [3:0] FIELD_23
0x10 REG_4 — Register 4
  [33:31] FIELD_23, [34:30] FIELD_13, [28:27] FIELD_10, [26:22] FIELD_1, [24:21] FIELD_4, [24:20] FIELD_8, [24:20] FIELD_11, [22:20] FIELD_20, [23:19] FIELD_7, [20:19] FIELD_22, [21:19] FIELD_24, [19:18] FIELD_18, [17:16] FIELD_21, [18:14] FIELD_16, [14] FIELD_19, [14:11] FIELD_6, [14:11] FIELD_15, [12:8] FIELD_17, [7:5] FIELD_14, [4] FIELD_3, [5:3] FIELD_2, [4:2] FIELD_5, [5:2] FIELD_12, [4:0] FIELD_9
0x14 REG_5 — Register 5
  [34:31] FIELD_15, [31] FIELD_19, [34:30] FIELD_6, [29:25] FIELD_11, [24] FIELD_3, [25:22] FIELD_5, [25:22] FIELD_10, [24:22] FIELD_18, [25:21] FIELD_14, [22:18] FIELD_9, [20:18] FIELD_12, [22:18] FIELD_13, [17] FIELD_1, [19:17] FIELD_8, [20:16] FIELD_7, [8] FIELD_2, [9:7] FIELD_4, [7] FIELD_17, [9:6] FIELD_16
0x18 REG_6 — Register 6
  [34:31] FIELD_4, [31] FIELD_16, [32:30] FIELD_8, [30] FIELD_24, [28] FIELD_11, [26:25] FIELD_12, [29:25] FIELD_18, [25:23] FIELD_5, [23:22] FIELD_17, [22] FIELD_23, [20] FIELD_3, [24:20] FIELD_7, [22:20] FIELD_14, [22:19] FIELD_10, [20:18] FIELD_1, [22:18] FIELD_2, [18:14] FIELD_20, [17:14] FIELD_22, [11:9] FIELD_9, [10:9] FIELD_13, [3:2] FIELD_15, [4:2] FIELD_19, [5:2] FIELD_21, [3:0] FIELD_6
0x1C REG_7 — Register 7
  [33:30] FIELD_11, [32:30] FIELD_12, [28:24] FIELD_2, [22] FIELD_7, [20:19] FIELD_9, [15] FIELD_1, [13] FIELD_8, [14:12] FIELD_14, [10:6] FIELD_3, [5] FIELD_4, [6:3] FIELD_13, [3:2] FIELD_5, [3:1] FIELD_6, [1:0] FIELD_10
0x20 REG_8 — Register 8
  [29:28] FIELD_5, [32:28] FIELD_14, [31:27] FIELD_13, [28:26] FIELD_20, [26:24] FIELD_6, [24:22] FIELD_7, [24:22] FIELD_10, [23:22] FIELD_16, [25:21] FIELD_1, [23:20] FIELD_21, [22:19] FIELD_2, [20:19] FIELD_9, [15:13] FIELD_4, [15:12] FIELD_3, [11] FIELD_11, [10:8] FIELD_15, [9:8] FIELD_17, [6:5] FIELD_12, [2:1] FIELD_8, [1] FIELD_19, [1:0] FIELD_18
0x24 REG_9 — Register 9
  [30] FIELD_18, [31:29] FIELD_4, [31:28] FIELD_22, [28:27] FIELD_17, [24] FIELD_5, [26:24] FIELD_20, [25:24] FIELD_24, [25:23] FIELD_10, [23:22] FIELD_16, [24:20] FIELD_6, [23:19] FIELD_26, [21:18] FIELD_12, [19:17] FIELD_13, [16] FIELD_21, [17:15] FIELD_8, [14] FIELD_23, [13] FIELD_15, [13:10] FIELD_2, [9] FIELD_29, [12:8] FIELD_19, [11:8] FIELD_28, [9:6] FIELD_1, [10:6] FIELD_11, [6:3] FIELD_3, [4:3] FIELD_7, [3] FIELD_9, [6:2] FIELD_27, [1:0] FIELD_14, [1:0] FIELD_25
0x28 REG_10 — Register 10
  [31] FIELD_13, [34:30] FIELD_4, [33:29] FIELD_20, [28] FIELD_3, [31:28] FIELD_17, [30:27] FIELD_15, [26] FIELD_6, [27:26] FIELD_23, [24:22] FIELD_2, [22:21] FIELD_7, [18] FIELD_8, [22:18] FIELD_19, [19:17] FIELD_14, [17:14] FIELD_1, [14:13] FIELD_5, [17:13] FIELD_9, [16:13] FIELD_18, [12:8] FIELD_21, [9:8] FIELD_22, [9:6] FIELD_10, [7:5] FIELD_16, [7:5] FIELD_24, [7:3] FIELD_12, [3:1] FIELD_11
