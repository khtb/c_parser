# LargeDummyDevice register map
File version: 1.0
Registers are 32-bit, read-write, no defined reset value unless marked. A register's access mark holds for its fields unless they carry their own. Offsets are from the block's base; [hi:lo] are bit positions.

## PERIPHERAL_58
Base 0x40039000
0x04 REG_1 — Register 1
  [29] FIELD_5, [30:28] FIELD_4, [29:26] FIELD_2, [24:23] FIELD_6, [21:19] FIELD_7, [21:19] FIELD_8, [19:15] FIELD_9, [10] FIELD_3, [9:6] FIELD_1
0x08 REG_2 — Register 2
  [35:31] FIELD_18, [33:29] FIELD_4, [28:27] FIELD_17, [28:25] FIELD_16, [26:22] FIELD_3, [22:21] FIELD_2, [22:18] FIELD_19, [17:16] FIELD_5, [16] FIELD_10, [16] FIELD_13, [16:14] FIELD_8, [13:11] FIELD_21, [12:10] FIELD_1, [12:9] FIELD_6, [9] FIELD_7, [10:8] FIELD_14, [8:6] FIELD_20, [6:4] FIELD_9, [3:1] FIELD_15, [2:0] FIELD_11, [2:0] FIELD_12
0x0C REG_3 — Register 3
  [34:30] FIELD_2, [33:30] FIELD_18, [30:29] FIELD_9, [27] FIELD_15, [28:25] FIELD_4, [27:25] FIELD_12, [28:24] FIELD_10, [25:24] FIELD_11, [24:23] FIELD_1, [23:21] FIELD_3, [22:21] FIELD_16, [19] FIELD_29, [22:18] FIELD_13, [20:18] FIELD_19, [21:17] FIELD_21, [17] FIELD_27, [17] FIELD_30, [15:14] FIELD_20, [13:10] FIELD_6, [12:10] FIELD_14, [11:8] FIELD_25, [7:6] FIELD_22, [10:6] FIELD_24, [7:5] FIELD_8, [7:5] FIELD_26, [6:4] FIELD_23, [6:4] FIELD_28, [4:2] FIELD_5, [6:2] FIELD_17, [0] FIELD_7
0x10 REG_4 — Register 4
  [29] FIELD_7, [31:29] FIELD_9, [26:23] FIELD_10, [17] FIELD_11, [16] FIELD_5, [18:16] FIELD_13, [18:15] FIELD_6, [14:11] FIELD_14, [11:10] FIELD_8, [9:8] FIELD_12, [4:3] FIELD_4, [4:2] FIELD_3, [2:1] FIELD_1, [2:0] FIELD_2
0x14 REG_5 — Register 5
  [34:30] FIELD_1
0x18 REG_6 — Register 6
  [32:31] FIELD_5, [32:31] FIELD_15, [30] FIELD_12, [34:30] FIELD_18, [33:29] FIELD_29, [30:27] FIELD_7, [29:26] FIELD_17, [29:26] FIELD_24, [24:22] FIELD_26, [25:22] FIELD_30, [23:22] FIELD_31, [24:22] FIELD_32, [24:21] FIELD_3, [22:21] FIELD_10, [24:20] FIELD_20, [22:19] FIELD_28, [20:18] FIELD_19, [17:16] FIELD_8, [16:12] FIELD_16, [16:12] FIELD_21, [15:12] FIELD_25, [9] FIELD_27, [8] FIELD_13, [8:7] FIELD_23, [5] FIELD_2, [5] FIELD_9, [5:4] FIELD_11, [5:3] FIELD_4, [4:2] FIELD_14, [3:2] FIELD_22, [5:1] FIELD_1, [0] FIELD_6
0x1C REG_7 — Register 7
  [28] FIELD_12, [29:27] FIELD_6, [26:24] FIELD_13, [23] FIELD_7, [21] FIELD_9, [22:20] FIELD_4, [15:14] FIELD_25, [12] FIELD_26, [13:10] FIELD_10, [10:9] FIELD_20, [13:9] FIELD_22, [12:8] FIELD_8, [9:8] FIELD_17, [11:7] FIELD_2, [9:7] FIELD_5, [7] FIELD_11, [8:7] FIELD_15, [9:7] FIELD_19, [4] FIELD_3, [8:4] FIELD_14, [5:4] FIELD_16, [8:4] FIELD_24, [4:2] FIELD_1, [2] FIELD_18, [4:1] FIELD_21, [4:1] FIELD_23
0x20 REG_8 — Register 8
  [34:30] FIELD_4, [31:29] FIELD_1, [29] FIELD_13, [28] FIELD_10, [26] FIELD_16, [24:20] FIELD_11, [20] FIELD_15, [23:19] FIELD_12, [19:15] FIELD_14, [12:9] FIELD_5, [11:9] FIELD_7, [12:9] FIELD_8, [12:8] FIELD_17, [6:2] FIELD_2, [4:0] FIELD_3, [3:0] FIELD_6, [4:0] FIELD_9
0x24 REG_9 — Register 9
  [35:31] FIELD_26, [28:25] FIELD_18, [26:24] FIELD_7, [25:21] FIELD_3, [23:21] FIELD_6, [22:19] FIELD_25, [18] FIELD_11, [21:17] FIELD_20, [19:16] FIELD_1, [19:16] FIELD_10, [16:15] FIELD_4, [16:15] FIELD_23, [13] FIELD_19, [9] FIELD_21, [12:8] FIELD_8, [11:8] FIELD_12, [9:8] FIELD_22, [10:7] FIELD_16, [11:7] FIELD_24, [10:6] FIELD_14, [6] FIELD_17, [5] FIELD_13, [7:4] FIELD_27, [3] FIELD_9, [3:1] FIELD_15, [4:0] FIELD_2, [4:0] FIELD_5
0x28 REG_10 — Register 10
  [31:29] FIELD_25, [31:28] FIELD_11, [28] FIELD_15, [30:27] FIELD_6, [29:27] FIELD_22, [28:25] FIELD_18, [27:23] FIELD_1, [20] FIELD_23, [18] FIELD_16, [19:18] FIELD_19, [18:16] FIELD_24, [16:15] FIELD_2, [15] FIELD_10, [14:13] FIELD_17, [13:12] FIELD_26, [13:11] FIELD_4, [13:11] FIELD_9, [13:10] FIELD_21, [9] FIELD_7, [11:9] FIELD_12, [7:6] FIELD_14, [9:5] FIELD_8, [6:4] FIELD_13, [7:4] FIELD_20, [6:2] FIELD_3, [3:0] FIELD_5
0x2C REG_11 — Register 11
  [35:31] FIELD_6, [32:29] FIELD_2, [29] FIELD_13, [30:28] FIELD_8, [23] FIELD_5, [22] FIELD_7, [26:22] FIELD_14, [25:21] FIELD_3, [20:19] FIELD_11, [18] FIELD_12, [9:8] FIELD_1, [3] FIELD_4, [3:1] FIELD_9, [4:1] FIELD_10, [4:0] FIELD_15
0x30 REG_12 — Register 12
  [33:30] FIELD_10, [32:29] FIELD_1, [31:29] FIELD_7, [32:28] FIELD_9, [23:22] FIELD_12, [23:21] FIELD_8, [22:20] FIELD_3, [18:16] FIELD_2, [18:15] FIELD_11, [15:13] FIELD_13, [10] FIELD_4, [10] FIELD_14, [12:9] FIELD_5, [4:2] FIELD_6
0x34 REG_13 — Register 13
  [32:31] FIELD_5, [35:31] FIELD_15, [35:31] FIELD_20, [31:30] FIELD_14, [31:29] FIELD_6, [28:27] FIELD_12, [25] FIELD_18, [23:21] FIELD_21, [19:18] FIELD_9, [18] FIELD_13, [19:16] FIELD_1, [17:16] FIELD_11, [16] FIELD_19, [18:15] FIELD_4, [11] FIELD_16, [10:8] FIELD_10, [7] FIELD_2, [4:3] FIELD_8, [6:2] FIELD_3, [1] FIELD_17, [0] FIELD_7
0x38 REG_14 — Register 14
  [27:26] FIELD_3, [18] FIELD_1, [20:17] FIELD_2, [17:15] FIELD_4, [10] FIELD_5
0x3C REG_15 — Register 15
  [32:30] FIELD_20, [29:26] FIELD_2, [25] FIELD_18, [28:25] FIELD_21, [26:23] FIELD_17, [24:21] FIELD_5, [25:21] FIELD_8, [23:20] FIELD_16, [18:16] FIELD_11, [14] FIELD_6, [15:14] FIELD_13, [15:13] FIELD_10, [15:12] FIELD_22, [11:10] FIELD_4, [12:8] FIELD_1, [7] FIELD_7, [9:7] FIELD_9, [7:4] FIELD_12, [4:3] FIELD_14, [4:2] FIELD_15, [2:1] FIELD_3, [0] FIELD_19
0x40 REG_16 — Register 16
  [29] FIELD_5, [30:29] FIELD_8, [25:24] FIELD_6, [26:23] FIELD_4, [23:19] FIELD_1, [14:13] FIELD_3, [15:11] FIELD_2, [5:1] FIELD_7
0x44 REG_17 — Register 17
  [33:31] FIELD_5, [34:31] FIELD_20, [30:29] FIELD_6, [30:27] FIELD_1, [26] FIELD_19, [24:23] FIELD_14, [25:22] FIELD_16, [23:21] FIELD_3, [23:20] FIELD_11, [23:19] FIELD_22, [21:17] FIELD_18, [16] FIELD_4, [18:16] FIELD_21, [17:14] FIELD_12, [15:12] FIELD_13, [15:12] FIELD_17, [12:9] FIELD_2, [9:8] FIELD_15, [7:5] FIELD_8, [4] FIELD_7, [7:3] FIELD_10, [3:1] FIELD_23, [2:0] FIELD_9, [4:0] FIELD_24
0x48 REG_18 — Register 18
  [23] FIELD_4, [21:20] FIELD_7, [17:16] FIELD_5, [15:11] FIELD_8, [12:10] FIELD_1, [10:9] FIELD_3, [9:8] FIELD_2, [6] FIELD_6
0x4C REG_19 — Register 19
  [34:31] FIELD_29, [31:30] FIELD_18, [31:28] FIELD_5, [26] FIELD_9, [24:23] FIELD_8, [26:23] FIELD_15, [24:23] FIELD_19, [24:23] FIELD_28, [24:22] FIELD_21, [22:21] FIELD_3, [19] FIELD_7, [18:17] FIELD_12, [18:17] FIELD_27, [17:16] FIELD_13, [20:16] FIELD_16, [16] FIELD_24, [18:16] FIELD_25, [16:14] FIELD_4, [15:13] FIELD_6, [14:12] FIELD_14, [15:12] FIELD_20, [12] FIELD_23, [12:11] FIELD_10, [11] FIELD_11, [12:10] FIELD_17, [8:5] FIELD_22, [7:3] FIELD_1, [5:3] FIELD_26, [3:2] FIELD_2
0x50 REG_20 — Register 20
  [25:24] FIELD_3, [22:19] FIELD_5, [21:17] FIELD_1, [11:7] FIELD_2, [3:0] FIELD_4
0x54 REG_21 — Register 21
  [26:24] FIELD_2, [21:19] FIELD_5, [13] FIELD_9, [15:11] FIELD_1, [12:10] FIELD_4, [9] FIELD_10, [12:8] FIELD_8, [7:6] FIELD_7, [5] FIELD_3, [2:1] FIELD_6
