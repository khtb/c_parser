# LargeDummyDevice register map
File version: 1.0
Registers are 32-bit, read-write, no defined reset value unless marked. A register's access mark holds for its fields unless they carry their own. Offsets are from the block's base; [hi:lo] are bit positions.

## PERIPHERAL_25
Base 0x40018000
0x04 REG_1 — Register 1
  [21] FIELD_2, [21:18] FIELD_5, [20:17] FIELD_6, [19:17] FIELD_9, [12:9] FIELD_8, [11:8] FIELD_1, [8:4] FIELD_7, [5:3] FIELD_4, [4:0] FIELD_3
0x08 REG_2 — Register 2
  [30:26] FIELD_5, [27:26] FIELD_6, [23:21] FIELD_3, [14:10] FIELD_1, [12:10] FIELD_2, [7:6] FIELD_4
0x0C REG_3 — Register 3
  [30:28] FIELD_2, [28:24] FIELD_3, [3:2] FIELD_1
0x10 REG_4 — Register 4
  [30:26] FIELD_2, [27:24] FIELD_5, [27:23] FIELD_4, [24:23] FIELD_10, [24:22] FIELD_9, [26:22] FIELD_13, [20] FIELD_12, [20:19] FIELD_8, [18:17] FIELD_1, [18:17] FIELD_14, [17:15] FIELD_7, [11:10] FIELD_15, [9] FIELD_3, [9] FIELD_16, [10:8] FIELD_11, [9:6] FIELD_6
0x14 REG_5 — Register 5
  [33:31] FIELD_6, [35:31] FIELD_22, [33:30] FIELD_5, [30:28] FIELD_10, [29:25] FIELD_13, [26:25] FIELD_27, [28:24] FIELD_8, [27:24] FIELD_19, [25:23] FIELD_3, [25:22] FIELD_18, [24:21] FIELD_4, [21:19] FIELD_11, [21:19] FIELD_14, [23:19] FIELD_17, [19:18] FIELD_21, [14] FIELD_1, [14:13] FIELD_26, [14:12] FIELD_15, [11:9] FIELD_25, [11:7] FIELD_23, [10:6] FIELD_7, [4:3] FIELD_2, [7:3] FIELD_20, [5:2] FIELD_9, [5:2] FIELD_12, [2:0] FIELD_16, [2:0] FIELD_24
0x18 REG_6 — Register 6
  [21] FIELD_7, [17:14] FIELD_3, [15:11] FIELD_4, [10:7] FIELD_5, [7:6] FIELD_1, [6:5] FIELD_2, [5:2] FIELD_6
0x1C REG_7 — Register 7
  [35:31] FIELD_8, [31:30] FIELD_10, [30:26] FIELD_18, [26:22] FIELD_17, [21:20] FIELD_1, [15] FIELD_9, [18:14] FIELD_5, [16:14] FIELD_7, [9] FIELD_2, [8] FIELD_3, [11:8] FIELD_12, [6] FIELD_14, [7:6] FIELD_16, [6:5] FIELD_4, [7:5] FIELD_15, [4] FIELD_6, [7:4] FIELD_11, [2] FIELD_13
0x20 REG_8 — Register 8
  [31:30] FIELD_24, [30:27] FIELD_5, [29:27] FIELD_12, [26:25] FIELD_3, [25] FIELD_4, [25] FIELD_7, [25:24] FIELD_13, [28:24] FIELD_23, [26:23] FIELD_6, [27:23] FIELD_11, [22:21] FIELD_18, [16] FIELD_19, [16:13] FIELD_14, [10:9] FIELD_20, [8] FIELD_15, [10:7] FIELD_2, [7] FIELD_21, [8:6] FIELD_22, [9:5] FIELD_8, [9:5] FIELD_9, [7:3] FIELD_1, [3] FIELD_17, [4:1] FIELD_10, [2:1] FIELD_16
0x24 REG_9 — Register 9
  [35:31] FIELD_3, [31] FIELD_8, [35:31] FIELD_12, [33:31] FIELD_17, [30:27] FIELD_11, [20] FIELD_10, [16:15] FIELD_18, [14:12] FIELD_4, [15:12] FIELD_13, [12] FIELD_16, [10] FIELD_5, [12:10] FIELD_6, [12:9] FIELD_14, [10:7] FIELD_2, [6] FIELD_9, [6:2] FIELD_7, [2:1] FIELD_19, [1:0] FIELD_1, [1:0] FIELD_15
0x28 REG_10 — Register 10
  [34:30] FIELD_5, [33:30] FIELD_14, [33:30] FIELD_20, [30:29] FIELD_17, [29:27] FIELD_13, [29:26] FIELD_1, [25:23] FIELD_12, [23] FIELD_22, [22:21] FIELD_6, [24:20] FIELD_9, [22:20] FIELD_15, [17:15] FIELD_11, [14:13] FIELD_2, [13:12] FIELD_19, [14:10] FIELD_8, [10:8] FIELD_18, [8:6] FIELD_3, [8:6] FIELD_4, [8:4] FIELD_10, [5:2] FIELD_16, [6:2] FIELD_21, [5:1] FIELD_7
0x2C REG_11 — Register 11
  [34:31] FIELD_15, [33:29] FIELD_16, [30:28] FIELD_1, [25] FIELD_20, [27:24] FIELD_14, [25:23] FIELD_3, [27:23] FIELD_18, [26:22] FIELD_4, [24:22] FIELD_13, [25:21] FIELD_5, [24:21] FIELD_12, [19:18] FIELD_6, [19:18] FIELD_11, [16:12] FIELD_9, [12:10] FIELD_10, [11:10] FIELD_19, [7:6] FIELD_7, [8:4] FIELD_2, [1:0] FIELD_8, [3:0] FIELD_17
0x30 REG_12 — Register 12
  [35:31] FIELD_11, [34:30] FIELD_1, [30:28] FIELD_7, [29:26] FIELD_8, [24:22] FIELD_10, [21:17] FIELD_3, [17:16] FIELD_13, [15:13] FIELD_9, [12:8] FIELD_4, [5] FIELD_6, [5] FIELD_12, [4:2] FIELD_5, [2:1] FIELD_2, [1] FIELD_14
0x34 REG_13 — Register 13
  [31:30] FIELD_8, [30] FIELD_11, [31:29] FIELD_14, [29:28] FIELD_13, [31:27] FIELD_3, [25:22] FIELD_7, [23:20] FIELD_1, [20] FIELD_5, [19:18] FIELD_16, [17:16] FIELD_4, [17:14] FIELD_15, [15:11] FIELD_12, [10:7] FIELD_6, [6] FIELD_10, [5:2] FIELD_2, [2:1] FIELD_17, [2:0] FIELD_9
0x38 REG_14 — Register 14
  [31:29] FIELD_15, [28] FIELD_6, [28] FIELD_9, [24:21] FIELD_11, [24:20] FIELD_2, [19:16] FIELD_1, [18:16] FIELD_8, [13] FIELD_3, [13:11] FIELD_12, [10:9] FIELD_7, [11:8] FIELD_5, [8:7] FIELD_10, [10:6] FIELD_13, [9:5] FIELD_14, [3] FIELD_4
0x3C REG_15 — Register 15
  [34:31] FIELD_7, [32:30] FIELD_19, [33:30] FIELD_21, [32:30] FIELD_25, [29:28] FIELD_10, [28] FIELD_24, [27] FIELD_1, [31:27] FIELD_28, [28:26] FIELD_22, [28:25] FIELD_6, [25] FIELD_18, [23:20] FIELD_16, [21:20] FIELD_26, [21:18] FIELD_23, [19:16] FIELD_12, [19:16] FIELD_17, [17:16] FIELD_27, [19:15] FIELD_3, [15:14] FIELD_15, [15:12] FIELD_14, [14:11] FIELD_2, [10] FIELD_5, [11:9] FIELD_13, [8] FIELD_9, [7:5] FIELD_20, [6:4] FIELD_8, [8:4] FIELD_11, [3] FIELD_4
0x40 REG_16 — Register 16
  [30] FIELD_17, [31:27] FIELD_21, [27:25] FIELD_14, [25:23] FIELD_9, [22] FIELD_2, [26:22] FIELD_15, [18] FIELD_23, [18:16] FIELD_6, [16] FIELD_22, [19:15] FIELD_1, [16:15] FIELD_4, [16:15] FIELD_16, [17:14] FIELD_7, [18:14] FIELD_13, [14:13] FIELD_11, [16:12] FIELD_19, [15:11] FIELD_10, [12:11] FIELD_12, [12:11] FIELD_18, [14:11] FIELD_20, [11:9] FIELD_25, [11:9] FIELD_26, [9:5] FIELD_8, [9:5] FIELD_24, [7:3] FIELD_3, [2] FIELD_5
0x44 REG_17 — Register 17
  [35:31] FIELD_1, [22:18] FIELD_4, [21:17] FIELD_6, [12:11] FIELD_3, [14:10] FIELD_5, [3:0] FIELD_2
0x48 REG_18 — Register 18
  [35:31] FIELD_9, [32:31] FIELD_15, [32:30] FIELD_11, [31:29] FIELD_8, [30:28] FIELD_20, [28:26] FIELD_1, [25:24] FIELD_10, [26:23] FIELD_21, [25:21] FIELD_12, [24:20] FIELD_24, [20:17] FIELD_23, [15] FIELD_22, [18:14] FIELD_14, [17:14] FIELD_16, [15:14] FIELD_19, [16:13] FIELD_7, [10:9] FIELD_5, [7] FIELD_25, [9:6] FIELD_18, [9:5] FIELD_13, [6:4] FIELD_6, [3] FIELD_3, [6:2] FIELD_17, [2:0] FIELD_2, [1:0] FIELD_4
0x4C REG_19 — Register 19
  [32:31] FIELD_10, [29:27] FIELD_11, [27:26] FIELD_4, [24:20] FIELD_1, [20] FIELD_7, [20:19] FIELD_3, [21:17] FIELD_8, [17:13] FIELD_9, [9:5] FIELD_2, [5:3] FIELD_5, [5:2] FIELD_6
0x50 REG_20 — Register 20
  [32:30] FIELD_2, [33:30] FIELD_18, [34:30] FIELD_22, [31:27] FIELD_26, [27:26] FIELD_17, [27:23] FIELD_5, [25:23] FIELD_6, [22] FIELD_13, [16:15] FIELD_10, [18:14] FIELD_19, [18:14] FIELD_21, [13] FIELD_25, [16:12] FIELD_12, [13:12] FIELD_15, [13:11] FIELD_7, [13:11] FIELD_16, [12:11] FIELD_20, [12:10] FIELD_1, [10:8] FIELD_4, [8:7] FIELD_3, [8:7] FIELD_9, [7:5] FIELD_14, [5:4] FIELD_8, [5:4] FIELD_11, [6:4] FIELD_24, [3:2] FIELD_23
0x54 REG_21 — Register 21
  [34:30] FIELD_9, [32:29] FIELD_3, [28] FIELD_8, [31:28] FIELD_13, [26] FIELD_14, [21:19] FIELD_10, [19:18] FIELD_4, [21:18] FIELD_5, [21:18] FIELD_11, [18:16] FIELD_19, [16:14] FIELD_17, [14:11] FIELD_23, [10:9] FIELD_1, [13:9] FIELD_6, [13:9] FIELD_22, [9:6] FIELD_7, [7:5] FIELD_2, [6:5] FIELD_12, [8:4] FIELD_18, [5:2] FIELD_20, [2] FIELD_21, [1:0] FIELD_15, [4:0] FIELD_16
0x58 REG_22 — Register 22
  [31] FIELD_9, [30] FIELD_1, [32:30] FIELD_11, [32:28] FIELD_16, [27:26] FIELD_7, [29:26] FIELD_23, [25] FIELD_15, [25:22] FIELD_17, [24:20] FIELD_6, [22:19] FIELD_21, [19:15] FIELD_13, [15:12] FIELD_4, [11] FIELD_8, [15:11] FIELD_22, [12:10] FIELD_10, [11:10] FIELD_19, [11:8] FIELD_12, [9:8] FIELD_18, [11:7] FIELD_20, [9:5] FIELD_14, [4:2] FIELD_3, [2] FIELD_5, [3:1] FIELD_2
0x5C REG_23 — Register 23
  [34:30] FIELD_4, [13] FIELD_5, [13:11] FIELD_1, [11:8] FIELD_3, [6:4] FIELD_2
0x60 REG_24 — Register 24
  [28] FIELD_6, [28:26] FIELD_12, [27:25] FIELD_14, [21] FIELD_11, [19:16] FIELD_3, [14] FIELD_5, [16:12] FIELD_4, [12:11] FIELD_8, [9] FIELD_9, [11:8] FIELD_1, [10:6] FIELD_2, [8:4] FIELD_13, [4:2] FIELD_10, [2:1] FIELD_7, [5:1] FIELD_15
0x64 REG_25 — Register 25
  [27:26] FIELD_1
0x68 REG_26 — Register 26
  [19:17] FIELD_1
0x6C REG_27 — Register 27
  [29:28] FIELD_17, [27] FIELD_25, [29:26] FIELD_28, [28:25] FIELD_23, [24] FIELD_20, [24:23] FIELD_1, [23:22] FIELD_10, [22] FIELD_29, [21] FIELD_26, [24:20] FIELD_16, [22:19] FIELD_19, [20:18] FIELD_6, [19:17] FIELD_3, [16] FIELD_4, [19:16] FIELD_7, [18:16] FIELD_30, [17:14] FIELD_9, [16:13] FIELD_14, [14:12] FIELD_8, [11] FIELD_21, [12:9] FIELD_5, [7:6] FIELD_18, [8:5] FIELD_12, [5] FIELD_24, [4] FIELD_11, [5:2] FIELD_2, [2] FIELD_22, [2] FIELD_27, [3:1] FIELD_13, [4:1] FIELD_15
0x70 REG_28 — Register 28
  [10:7] FIELD_1
0x74 REG_29 — Register 29
  [31:27] FIELD_14, [25:24] FIELD_15, [23] FIELD_4, [25:23] FIELD_7, [21] FIELD_2, [22:20] FIELD_12, [20:16] FIELD_6, [15:13] FIELD_10, [10:9] FIELD_5, [9:8] FIELD_9, [9:8] FIELD_13, [11:8] FIELD_16, [11:7] FIELD_3, [9:7] FIELD_11, [8:5] FIELD_8, [4:3] FIELD_1, [4:3] FIELD_17
0x78 REG_30 — Register 30
  [35:31] FIELD_7, [32:31] FIELD_8, [31:30] FIELD_15, [33:29] FIELD_18, [30:26] FIELD_2, [27:23] FIELD_20, [23:19] FIELD_10, [23:19] FIELD_23, [16] FIELD_6, [18:16] FIELD_11, [17:15] FIELD_1, [16:13] FIELD_24, [12:11] FIELD_16, [10] FIELD_5, [7:6] FIELD_13, [5] FIELD_14, [5:4] FIELD_12, [4:3] FIELD_9, [6:3] FIELD_17, [3:1] FIELD_4, [3:1] FIELD_19, [3:1] FIELD_22, [0] FIELD_3, [2:0] FIELD_21
0x7C REG_31 — Register 31
  [32:30] FIELD_1, [28] FIELD_26, [26] FIELD_2, [29:25] FIELD_19, [25:24] FIELD_16, [24:23] FIELD_9, [20] FIELD_7, [19:18] FIELD_22, [21:17] FIELD_14, [18:14] FIELD_11, [13:12] FIELD_13, [15:12] FIELD_21, [11] FIELD_3, [15:11] FIELD_8, [10] FIELD_5, [10] FIELD_25, [10:9] FIELD_24, [9:7] FIELD_12, [10:7] FIELD_23, [6] FIELD_20, [4] FIELD_10, [7:3] FIELD_4, [6:3] FIELD_15, [3:2] FIELD_17, [1] FIELD_18, [0] FIELD_6
0x80 REG_32 — Register 32
  [35:31] FIELD_31, [34:30] FIELD_16, [32:29] FIELD_1, [27] FIELD_9, [31:27] FIELD_11, [28:25] FIELD_3, [29:25] FIELD_10, [25] FIELD_21, [28:25] FIELD_27, [24] FIELD_26, [19:18] FIELD_15, [21:18] FIELD_18, [18] FIELD_20, [18:17] FIELD_8, [16] FIELD_24, [16:15] FIELD_13, [14] FIELD_23, [17:13] FIELD_12, [17:13] FIELD_14, [14:12] FIELD_19, [15:12] FIELD_32, [9:8] FIELD_4, [12:8] FIELD_7, [8:7] FIELD_5, [9:7] FIELD_30, [7:4] FIELD_2, [5:3] FIELD_17, [3] FIELD_29, [3:2] FIELD_25, [6:2] FIELD_28, [4:1] FIELD_22, [3:0] FIELD_6
