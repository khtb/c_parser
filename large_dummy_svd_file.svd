# LargeDummyDevice register map
File version: 1.0
Registers are 32-bit, read-write, no defined reset value unless marked. A register's access mark holds for its fields unless they carry their own. Offsets are from the block's base; [hi:lo] are bit positions.

## PERIPHERAL_76
Base 0x4004B000
0x04 REG_1 — Register 1
  [29] FIELD_13, [29] FIELD_25, [28:27] FIELD_23, [31:27] FIELD_28, [28:26] FIELD_15, [26] FIELD_20, [22] FIELD_22, [22:21] FIELD_27, [22:19] FIELD_29, [16] FIELD_24, [18:15] FIELD_2, [17:15] FIELD_5, [16:15] FIELD_11, [18:15] FIELD_14, [18:14] FIELD_1, [17:13] FIELD_10, [14:12] FIELD_17, [14:10] FIELD_16, [14:10] FIELD_21, [12:9] FIELD_6, [7:6] FIELD_8, [8:6] FIELD_18, [9:5] FIELD_12, [3] FIELD_7, [4:3] FIELD_19, [4:3] FIELD_26, [4:2] FIELD_3, [4:0] FIELD_4, [4:0] FIELD_9
0x08 REG_2 — Register 2
  [26] FIELD_8, [26:22] FIELD_4, [18:17] FIELD_2, [14:11] FIELD_3, [12:11] FIELD_6, [11:10] FIELD_7, [9:7] FIELD_1, [8:6] FIELD_9, [3:2] FIELD_5
0x0C REG_3 — Register 3
  [31] FIELD_11, [30:29] FIELD_5, [29:26] FIELD_21, [29:25] FIELD_2, [21] FIELD_3, [22:20] FIELD_1, [20] FIELD_14, [23:19] FIELD_16, [22:19] FIELD_18, [18:16] FIELD_13, [17:16] FIELD_17, [19:15] FIELD_6, [18:14] FIELD_4, [16:14] FIELD_10, [13:12] FIELD_19, [14:11] FIELD_9, [11:9] FIELD_12, [5] FIELD_20, [5:4] FIELD_15, [3:2] FIELD_7, [2:1] FIELD_8
0x10 REG_4 — Register 4
  [26:24] FIELD_2, [17:15] FIELD_4, [17:13] FIELD_3, [4:3] FIELD_1
0x14 REG_5 — Register 5
  [31] FIELD_6, [28:27] FIELD_3, [26:22] FIELD_5, [22:20] FIELD_1, [16:14] FIELD_4, [15:11] FIELD_2
0x18 REG_6 — Register 6
  [31] FIELD_1, [34:30] FIELD_10, [31:29] FIELD_16, [30:27] FIELD_2, [31:27] FIELD_9, [26] FIELD_12, [25:24] FIELD_18, [23:22] FIELD_8, [25:21] FIELD_7, [23:21] FIELD_20, [24:21] FIELD_23, [21:19] FIELD_5, [19] FIELD_26, [18:16] FIELD_25, [17:15] FIELD_15, [18:14] FIELD_17, [17:14] FIELD_27, [15:13] FIELD_19, [13] FIELD_24, [14:12] FIELD_3, [12:10] FIELD_14, [11:8] FIELD_4, [12:8] FIELD_6, [9:8] FIELD_21, [7:6] FIELD_13, [7:6] FIELD_22, [5:1] FIELD_11
0x1C REG_7 — Register 7
  [30:28] FIELD_1, [32:28] FIELD_14, [28] FIELD_21, [28:26] FIELD_5, [28:26] FIELD_16, [26:25] FIELD_10, [25:24] FIELD_8, [26:24] FIELD_11, [27:23] FIELD_6, [25:22] FIELD_7, [25:22] FIELD_24, [23:22] FIELD_25, [24:21] FIELD_22, [18] FIELD_23, [18:17] FIELD_9, [21:17] FIELD_19, [15:13] FIELD_13, [12:11] FIELD_20, [12:9] FIELD_2, [11:7] FIELD_12, [7] FIELD_18, [9:6] FIELD_15, [9:5] FIELD_3, [3:1] FIELD_4, [3:1] FIELD_17
0x20 REG_8 — Register 8
  [35:31] FIELD_10, [33:30] FIELD_13, [29] FIELD_17, [30:28] FIELD_1, [27] FIELD_22, [27:23] FIELD_23, [18] FIELD_3, [19:18] FIELD_5, [19:17] FIELD_14, [20:17] FIELD_16, [20:16] FIELD_6, [16] FIELD_7, [16:15] FIELD_2, [17:14] FIELD_21, [13] FIELD_24, [16:12] FIELD_11, [16:12] FIELD_15, [11:10] FIELD_9, [11:10] FIELD_19, [14:10] FIELD_26, [7] FIELD_12, [8:4] FIELD_4, [2] FIELD_20, [4:2] FIELD_25, [5:1] FIELD_8, [4:0] FIELD_18
0x24 REG_9 — Register 9
  [35:31] FIELD_6, [33:29] FIELD_5, [29:25] FIELD_4, [23:19] FIELD_1, [20:19] FIELD_9, [22:18] FIELD_3, [19:15] FIELD_7, [15] FIELD_8, [14:10] FIELD_2
0x28 REG_10 — Register 10
  [32:29] FIELD_6, [33:29] FIELD_8, [25] FIELD_15, [27:24] FIELD_4, [27:24] FIELD_11, [26:24] FIELD_12, [24:22] FIELD_1, [24:22] FIELD_9, [25:22] FIELD_17, [21:20] FIELD_20, [19] FIELD_5, [20:17] FIELD_7, [18:16] FIELD_19, [16:13] FIELD_3, [15:13] FIELD_16, [13:10] FIELD_13, [13:9] FIELD_2, [10:7] FIELD_10, [6] FIELD_18, [8:5] FIELD_21, [5] FIELD_22, [6:2] FIELD_14
0x2C REG_11 — Register 11
  [18:16] FIELD_1
0x30 REG_12 — Register 12
  [30:29] FIELD_20, [32:28] FIELD_10, [32:28] FIELD_27, [31:27] FIELD_4, [27:26] FIELD_3, [28:25] FIELD_6, [25] FIELD_17, [28:25] FIELD_25, [27:24] FIELD_30, [23] FIELD_9, [26:22] FIELD_14, [25:22] FIELD_18, [22:20] FIELD_23, [22:19] FIELD_7, [19:18] FIELD_21, [21:18] FIELD_24, [20:17] FIELD_2, [16] FIELD_22, [20:16] FIELD_28, [19:15] FIELD_26, [16:15] FIELD_29, [17:14] FIELD_5, [15:14] FIELD_16, [15:13] FIELD_15, [14:13] FIELD_31, [15:12] FIELD_8, [14:10] FIELD_13, [10:9] FIELD_19, [5:1] FIELD_1, [1:0] FIELD_11, [0] FIELD_12
0x34 REG_13 — Register 13
  [33:31] FIELD_20, [28:27] FIELD_12, [28:24] FIELD_14, [24] FIELD_15, [25:23] FIELD_2, [24:23] FIELD_4, [24:21] FIELD_9, [21:18] FIELD_1, [22:18] FIELD_8, [20:17] FIELD_3, [17:15] FIELD_7, [16:14] FIELD_6, [18:14] FIELD_16, [18:14] FIELD_18, [15:13] FIELD_5, [15:13] FIELD_13, [15:12] FIELD_19, [11:9] FIELD_10, [10:9] FIELD_21, [10:6] FIELD_11, [1] FIELD_17
0x38 REG_14 — Register 14
  [34:30] FIELD_4, [30] FIELD_17, [28] FIELD_7, [30:26] FIELD_5, [26:24] FIELD_21, [26:22] FIELD_20, [25:21] FIELD_8, [20] FIELD_19, [22:18] FIELD_6, [20:18] FIELD_27, [19:17] FIELD_2, [18:17] FIELD_9, [19:17] FIELD_11, [21:17] FIELD_22, [18:16] FIELD_24, [17:14] FIELD_3, [17:14] FIELD_14, [18:14] FIELD_28, [11] FIELD_15, [14:11] FIELD_18, [13:11] FIELD_26, [12:10] FIELD_25, [9] FIELD_23, [11:8] FIELD_1, [9:8] FIELD_13, [9:8] FIELD_29, [10:7] FIELD_16, [7] FIELD_30, [2:0] FIELD_10, [1:0] FIELD_12
0x3C REG_15 — Register 15
  [34:31] FIELD_14, [31:28] FIELD_16, [28:27] FIELD_5, [26:22] FIELD_1, [23:22] FIELD_9, [23:22] FIELD_15, [20] FIELD_10, [20:19] FIELD_3, [16:15] FIELD_8, [18:14] FIELD_4, [12] FIELD_6, [13:11] FIELD_13, [9:5] FIELD_17, [7:3] FIELD_12, [4:2] FIELD_11, [3:1] FIELD_7, [4:0] FIELD_2
0x40 REG_16 — Register 16
  [28] FIELD_5, [29:25] FIELD_3, [10] FIELD_2, [7:6] FIELD_4, [5:3] FIELD_1
0x44 REG_17 — Register 17
  [32:30] FIELD_4, [33:29] FIELD_2, [33:29] FIELD_5, [27:23] FIELD_6, [24:23] FIELD_11, [25:21] FIELD_9, [20:16] FIELD_10, [18:14] FIELD_7, [12] FIELD_3, [14:11] FIELD_12, [12:10] FIELD_13, [10:9] FIELD_14, [8] FIELD_1, [7:3] FIELD_8
0x48 REG_18 — Register 18
  [33:30] FIELD_13, [30:29] FIELD_3, [30:27] FIELD_6, [29:27] FIELD_18, [29:25] FIELD_17, [25:22] FIELD_12, [21] FIELD_16, [20] FIELD_19, [23:19] FIELD_10, [23:19] FIELD_14, [16] FIELD_8, [18:16] FIELD_15, [18:14] FIELD_4, [16:14] FIELD_7, [14:12] FIELD_21, [11] FIELD_2, [10:9] FIELD_1, [12:8] FIELD_11, [6:2] FIELD_9, [3:1] FIELD_5, [5:1] FIELD_20
0x4C REG_19 — Register 19
  [30] FIELD_4, [28:25] FIELD_12, [24] FIELD_16, [25:22] FIELD_8, [21:19] FIELD_9, [22:18] FIELD_10, [15] FIELD_7, [18:14] FIELD_13, [17:13] FIELD_14, [12:9] FIELD_11, [12:8] FIELD_5, [12:8] FIELD_6, [7:6] FIELD_2, [7:6] FIELD_3, [7:3] FIELD_1, [3:0] FIELD_15
0x50 REG_20 — Register 20
  [29:27] FIELD_4, [20:18] FIELD_1, [19:18] FIELD_8, [20:17] FIELD_5, [17:15] FIELD_7, [6:5] FIELD_2, [6:4] FIELD_3, [0] FIELD_6
0x54 REG_21 — Register 21
  [34:31] FIELD_10, [30:28] FIELD_1, [28:27] FIELD_13, [28:24] FIELD_9, [28:24] FIELD_12, [27:24] FIELD_14, [27:23] FIELD_8, [25:21] FIELD_19, [20:19] FIELD_3, [20:18] FIELD_2, [17] FIELD_7, [19:17] FIELD_21, [18:15] FIELD_20, [14] FIELD_16, [16:12] FIELD_18, [11] FIELD_6, [10:6] FIELD_17, [6:4] FIELD_5, [8:4] FIELD_11, [5:3] FIELD_4, [4:2] FIELD_15
0x58 REG_22 — Register 22
  [33:31] FIELD_7, [31] FIELD_12, [31] FIELD_17, [34:30] FIELD_3, [30] FIELD_5, [29:28] FIELD_1, [29:28] FIELD_10, [27] FIELD_15, [28:27] FIELD_18, [29:26] FIELD_8, [27:25] FIELD_21, [26:23] FIELD_11, [25:21] FIELD_19, [22:19] FIELD_13, [16] FIELD_14, [19:16] FIELD_16, [18:16] FIELD_24, [17:13] FIELD_6, [16:13] FIELD_20, [8] FIELD_2, [5] FIELD_4, [5] FIELD_9, [5] FIELD_22, [6:2] FIELD_23, [6:2] FIELD_25
0x5C REG_23 — Register 23
  [33:31] FIELD_3, [35:31] FIELD_16, [32:30] FIELD_2, [29] FIELD_26, [32:28] FIELD_11, [31:27] FIELD_4, [31:27] FIELD_22, [26:25] FIELD_14, [29:25] FIELD_23, [29:25] FIELD_30, [28:25] FIELD_32, [24:23] FIELD_24, [24:22] FIELD_21, [24:21] FIELD_5, [25:21] FIELD_28, [21:20] FIELD_12, [22:20] FIELD_29, [22:19] FIELD_7, [19:15] FIELD_1, [16:15] FIELD_9, [15:14] FIELD_6, [14] FIELD_8, [12:10] FIELD_13, [9:8] FIELD_15, [9:8] FIELD_17, [10:8] FIELD_18, [11:8] FIELD_19, [7:6] FIELD_10, [5:4] FIELD_31, [2] FIELD_20, [4:1] FIELD_25, [1:0] FIELD_27
