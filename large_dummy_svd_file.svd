# LargeDummyDevice register map
File version: 1.0
Registers are 32-bit, read-write, no defined reset value unless marked. A register's access mark holds for its fields unless they carry their own. Offsets are from the block's base; [hi:lo] are bit positions.

## PERIPHERAL_99
Base 0x40062000
0x04 REG_1 — Register 1
  [31:30] FIELD_18, [32:29] FIELD_8, [31:29] FIELD_15, [32:29] FIELD_16, [28:27] FIELD_5, [28:26] FIELD_7, [27:25] FIELD_21, [26:24] FIELD_17, [23:22] FIELD_19, [19:15] FIELD_10, [17:15] FIELD_20, [17:14] FIELD_6, [17:13] FIELD_3, [17:13] FIELD_11, [17:13] FIELD_12, [11:9] FIELD_2, [8] FIELD_1, [6:2] FIELD_14, [3:1] FIELD_13, [3:0] FIELD_4, [1:0] FIELD_9
0x08 REG_2 — Register 2
  [29] FIELD_6, [29] FIELD_10, [31:29] FIELD_20, [31:29] FIELD_28, [29:28] FIELD_1, [31:28] FIELD_27, [29:26] FIELD_2, [25] FIELD_21, [27:25] FIELD_22, [27:24] FIELD_4, [27:24] FIELD_9, [26:23] FIELD_5, [23:21] FIELD_13, [21:20] FIELD_17, [23:19] FIELD_8, [22:19] FIELD_18, [21:18] FIELD_14, [16:15] FIELD_16, [14] FIELD_7, [13] FIELD_24, [13:11] FIELD_11, [12:9] FIELD_26, [8:7] FIELD_3, [5:4] FIELD_29, [3] FIELD_12, [3:1] FIELD_15, [5:1] FIELD_25, [2:0] FIELD_19, [4:0] FIELD_23
0x0C REG_3 — Register 3
  [24:22] FIELD_1, [18:16] FIELD_3, [6] FIELD_2, [10:6] FIELD_4, [7:6] FIELD_5
0x10 REG_4 — Register 4
  [26] FIELD_5, [17] FIELD_1, [14:10] FIELD_6, [9:6] FIELD_3, [7:5] FIELD_4, [5:3] FIELD_2, [3] FIELD_7
0x14 REG_5 — Register 5
  [30] FIELD_1, [22:21] FIELD_7, [23:19] FIELD_4, [18] FIELD_2, [20:16] FIELD_5, [18:16] FIELD_6, [9] FIELD_3
0x18 REG_6 — Register 6
  [28:26] FIELD_1
0x1C REG_7 — Register 7
  [32:31] FIELD_1, [31] FIELD_7, [30] FIELD_4, [27] FIELD_3, [23:20] FIELD_2, [22:18] FIELD_6, [13:10] FIELD_5
0x20 REG_8 — Register 8
  [35:31] FIELD_5, [34:31] FIELD_31, [32:30] FIELD_1, [31:30] FIELD_12, [31:28] FIELD_3, [29:28] FIELD_23, [26] FIELD_4, [28:26] FIELD_7, [24] FIELD_2, [23:22] FIELD_10, [24:20] FIELD_19, [18] FIELD_14, [21:18] FIELD_20, [20:18] FIELD_29, [20:18] FIELD_30, [16] FIELD_6, [17:16] FIELD_9, [20:16] FIELD_26, [14] FIELD_8, [15:12] FIELD_17, [12:11] FIELD_18, [8:7] FIELD_21, [11:7] FIELD_22, [10:7] FIELD_24, [5] FIELD_11, [5] FIELD_13, [5] FIELD_16, [9:5] FIELD_25, [7:3] FIELD_27, [2:1] FIELD_28, [1:0] FIELD_15
0x24 REG_9 — Register 9
  [30] FIELD_8, [32:28] FIELD_6, [30:27] FIELD_5, [29:25] FIELD_7, [23] FIELD_10, [20] FIELD_1, [16] FIELD_4, [16:13] FIELD_9, [12:11] FIELD_12, [10:9] FIELD_2, [3] FIELD_11, [3:2] FIELD_3
0x28 REG_10 — Register 10
  [34:31] FIELD_19, [31:28] FIELD_27, [26] FIELD_7, [29:26] FIELD_9, [26] FIELD_23, [23] FIELD_12, [25:23] FIELD_21, [21:20] FIELD_6, [19] FIELD_18, [18] FIELD_22, [21:17] FIELD_1, [18:17] FIELD_5, [16:15] FIELD_8, [19:15] FIELD_11, [19:15] FIELD_24, [14:11] FIELD_10, [15:11] FIELD_25, [13:10] FIELD_26, [9] FIELD_2, [10:9] FIELD_3, [13:9] FIELD_15, [6] FIELD_14, [9:6] FIELD_16, [8:4] FIELD_4, [6:4] FIELD_13, [6:4] FIELD_17, [2:1] FIELD_20
0x2C REG_11 — Register 11
  [31:30] FIELD_6, [31:30] FIELD_8, [32:28] FIELD_12, [28:27] FIELD_9, [29:25] FIELD_1, [23:22] FIELD_20, [24:21] FIELD_3, [20:17] FIELD_19, [18:16] FIELD_5, [13:12] FIELD_23, [11:10] FIELD_13, [10] FIELD_17, [14:10] FIELD_21, [13:9] FIELD_10, [5] FIELD_7, [8:5] FIELD_18, [5:4] FIELD_11, [4] FIELD_14, [5:3] FIELD_2, [5:1] FIELD_22, [4:0] FIELD_4, [1:0] FIELD_15, [1:0] FIELD_16
0x30 REG_12 — Register 12
  [35:31] FIELD_10, [32:28] FIELD_11, [31:28] FIELD_15, [27:26] FIELD_14, [26:24] FIELD_9, [23] FIELD_4, [25:23] FIELD_5, [25:21] FIELD_3, [24:20] FIELD_19, [21:17] FIELD_8, [17:16] FIELD_20, [15:14] FIELD_16, [13] FIELD_17, [15:12] FIELD_7, [12] FIELD_12, [14:11] FIELD_13, [9:7] FIELD_1, [10:7] FIELD_6, [10:6] FIELD_18, [5:4] FIELD_21, [3:2] FIELD_2
0x34 REG_13 — Register 13
  [22:21] FIELD_6, [12:11] FIELD_3, [12:10] FIELD_1, [11:9] FIELD_2, [3:2] FIELD_4, [4:0] FIELD_5
0x38 REG_14 — Register 14
  [32:30] FIELD_6, [25:23] FIELD_8, [23:22] FIELD_4, [24:20] FIELD_3, [18:15] FIELD_5, [16:15] FIELD_9, [14] FIELD_2, [16:13] FIELD_11, [10:6] FIELD_12, [8:5] FIELD_7, [3] FIELD_1, [4:3] FIELD_10
0x3C REG_15 — Register 15
  [32:31] FIELD_2, [26] FIELD_12, [26:25] FIELD_14, [27:23] FIELD_1, [25:23] FIELD_9, [24:22] FIELD_5, [26:22] FIELD_13, [20:19] FIELD_3, [18] FIELD_4, [18] FIELD_7, [13:11] FIELD_6, [14:11] FIELD_11, [9] FIELD_8, [5:3] FIELD_10
0x40 REG_16 — Register 16
  [33:30] FIELD_5, [31:27] FIELD_4, [19:15] FIELD_1, [14:13] FIELD_8, [14:10] FIELD_7, [5:3] FIELD_2, [2] FIELD_6, [1] FIELD_3
