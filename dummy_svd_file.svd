# DummyDevice register map
File version: 1.0
A large dummy SVD file for testing purposes
Registers are 32-bit, read-write, no defined reset value unless marked. A register's access mark holds for its fields unless they carry their own. Offsets are from the block's base; lines under a group give offsets from that group; [hi:lo] are bit positions; {n}, {i} and the like mark numbered series; 'fields as' and 'values as' point back to an identical list; <NAME> marks a mode.

## Memory map
0x40000000 PERIPHERAL_1 — Peripheral 1 description
0x40001000 PERIPHERAL_2 — Peripheral 2 description

## PERIPHERAL_1 — Peripheral 1 description
Base 0x40000000
0x00 REG_1_1 — Register 1.1
0x04 REG_1_2 ro — Register 1.2
0x08 REG_1_3 wo — Register 1.3
0x0C REG_1_4 — Register 1.4

## PERIPHERAL_2 — Peripheral 2 description
Base 0x40001000
0x00 REG_2_1 — Register 2.1
0x04 REG_2_2 ro — Register 2.2
